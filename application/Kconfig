## bsp/artinchip/drv/spinand/Kconfig.dev
```kconfig
#-----------------------------
# spinand local parameter
#-----------------------------

menuconfig AIC_QSPI0_DEVICE_SPINAND
    bool "SPI0 Devices: SPINAND"
    depends on AIC_USING_QSPI0
    select LPKG_USING_SPINAND
    select AIC_SPINAND_DRV
    default n

if AIC_QSPI0_DEVICE_SPINAND
    config AIC_QSPI0_DEVICE_SPINAND_FREQ
        int "SPINAND bus frequency(Hz)"
	default 100000000

    config AIC_QSPI0_DEVICE_SPINAND_CONT_READ
        bool "Continuous Read Mode Enable"
	select AIC_SPINAND_CONT_READ
	default n
endif

menuconfig AIC_QSPI1_DEVICE_SPINAND
    bool "SPI1 Devices: SPINAND"
    depends on AIC_USING_QSPI1
    select LPKG_USING_SPINAND
    select AIC_SPINAND_DRV
    default n

if AIC_QSPI1_DEVICE_SPINAND
    config AIC_QSPI1_DEVICE_SPINAND_FREQ
        int "SPINAND bus frequency(Hz)"
	default 100000000

    config AIC_QSPI1_DEVICE_SPINAND_CONT_READ
        bool "Continuous Read Mode Enable"
	select AIC_SPINAND_CONT_READ
	default n

endif

menuconfig AIC_QSPI2_DEVICE_SPINAND
    bool "SPI2 Devices: SPINAND"
    depends on AIC_USING_QSPI2
    select LPKG_USING_SPINAND
    select AIC_SPINAND_DRV
    default n

if AIC_QSPI2_DEVICE_SPINAND
    config AIC_QSPI2_DEVICE_SPINAND_FREQ
        int "SPINAND bus frequency(Hz)"
	default 100000000

    config AIC_QSPI2_DEVICE_SPINAND_CONT_READ
        bool "Continuous Read Mode Enable"
	select AIC_SPINAND_CONT_READ
	default n

endif

menuconfig AIC_QSPI3_DEVICE_SPINAND
    bool "SPI3 Devices: SPINAND"
    depends on AIC_USING_QSPI3
    select LPKG_USING_SPINAND
    select AIC_SPINAND_DRV
    default n

if AIC_QSPI3_DEVICE_SPINAND
    config AIC_QSPI3_DEVICE_SPINAND_FREQ
        int "SPINAND bus frequency(Hz)"
	default 100000000

    config AIC_QSPI3_DEVICE_SPINAND_CONT_READ
        bool "Continuous Read Mode Enable"
	select AIC_SPINAND_CONT_READ
	default n

endif

menuconfig AIC_QSPI4_DEVICE_SPINAND
    bool "SPI4 Devices: SPINAND"
    depends on AIC_USING_QSPI4
    select LPKG_USING_SPINAND
    select AIC_SPINAND_DRV
    default n

if AIC_QSPI4_DEVICE_SPINAND
    config AIC_QSPI4_DEVICE_SPINAND_FREQ
        int "SPINAND bus frequency(Hz)"
	default 100000000

    config AIC_QSPI4_DEVICE_SPINAND_CONT_READ
        bool "Continuous Read Mode Enable"
	select AIC_SPINAND_CONT_READ
	default n

endif

menuconfig AIC_SPINAND_BLOCK_CACHE
    bool "spinand block device cache"
    depends on LPKG_USING_SPINAND
    select AIC_SPINAND_DRV
    default y

if AIC_SPINAND_BLOCK_CACHE
    config AIC_SPINAND_BLOCK_CACHE_SIZE
        int "spinand block device cache size"
    default 512

    config AIC_SPINAND_BLOCK_CACHE_NUM
        int "spinand block device cache number"
    default 4

endif
```

## bsp/artinchip/drv/tsen/Kconfig.dev
```kconfig
#-----------------------------
# Tsensor devices local parameter
#-----------------------------

menu "TSEN_CPU Parameter"
    depends on AIC_USING_TSEN_CPU

    choice
        prompt "obtaning data mode"
        default AIC_TSEN0_SOFT_MODE_SINGLE_INTER
        help
            Select the obtaning data mode

        config AIC_TSEN0_SOFT_MODE_SINGLE_INTER
            bool "single interrupt mode"
        config AIC_TSEN0_SOFT_MODE_SINGLE_POLL
            bool "polling mode"

    endchoice

    config AIC_TSEN0_SOFT_MODE
        int
        default 0     if AIC_TSEN0_SOFT_MODE_SINGLE_INTER
        default 1     if AIC_TSEN0_SOFT_MODE_PERIOD_INTER
        default 2     if AIC_TSEN0_SOFT_MODE_SINGLE_POLL

    config AIC_TSEN0_MODE
        int
        default 0     if AIC_TSEN0_SOFT_MODE_SINGLE_INTER
        default 1     if AIC_TSEN0_SOFT_MODE_PERIOD_INTER
        default 0     if AIC_TSEN0_SOFT_MODE_SINGLE_POLL

endmenu

menu "TSEN_GPAI Parameter"
    depends on AIC_USING_TSEN_GPAI

    choice
        prompt "obtaning data mode"
        default AIC_TSEN1_SOFT_MODE_SINGLE_INTER
        help
            Select the obtaning data mode

        config AIC_TSEN1_SOFT_MODE_SINGLE_INTER
            bool "single interrupt mode"
        config AIC_TSEN1_SOFT_MODE_SINGLE_POLL
            bool "polling mode"

    endchoice

    config AIC_TSEN1_SOFT_MODE
        int
        default 0     if AIC_TSEN1_SOFT_MODE_SINGLE_INTER
        default 1     if AIC_TSEN1_SOFT_MODE_PERIOD_INTER
        default 2     if AIC_TSEN1_SOFT_MODE_SINGLE_POLL

    config AIC_TSEN1_MODE
        int
        default 0     if AIC_TSEN1_SOFT_MODE_SINGLE_INTER
        default 1     if AIC_TSEN1_SOFT_MODE_PERIOD_INTER
        default 0     if AIC_TSEN1_SOFT_MODE_SINGLE_POLL

endmenu
```

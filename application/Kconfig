## bsp/peripheral/Kconfig
```kconfig
source "bsp/peripheral/spinand/Kconfig"
source "bsp/peripheral/spinor_sfud/Kconfig"
source "bsp/peripheral/nftl/Kconfig"
source "bsp/peripheral/bt/Kconfig"
source "bsp/peripheral/camera/Kconfig"
#--------------------------------------------
# touch panel driver global option
#--------------------------------------------

menuconfig AIC_USING_TOUCH
    bool "Touch Panel Support"

if AIC_USING_TOUCH
    choice
        prompt "Select touch device"
            default AIC_USING_CTP

        config AIC_USING_CTP
            bool "CTP"

        config AIC_USING_RTP
            bool "RTP"
            select AIC_RTP_DRV
    endchoice

if AIC_USING_CTP
    source "bsp/peripheral/touch/Kconfig"
endif

if AIC_USING_RTP
    source "bsp/peripheral/touch/rtp/Kconfig"
endif
endif

#--------------------------------------------
# External RTC Driver Option
#--------------------------------------------

menuconfig AIC_USING_EXTERNAL_RTC
    bool "External RTC Driver Option"

if AIC_USING_EXTERNAL_RTC
    source "bsp/peripheral/rtc/Kconfig"
endif

#--------------------------------------------
# Audio Codec driver option
#--------------------------------------------

menu "External Audio Codec Support"
source "bsp/peripheral/codec/Kconfig"
endmenu
```

## bsp/peripheral/camera/Kconfig
```kconfig
config AIC_USING_CAMERA
    bool "Camera device support"
    depends on AIC_USING_DVP && AIC_I2C_DRV
    default n

choice
    prompt "Select camera device"
    default AIC_USING_CAMERA_OV5640
    depends on AIC_USING_CAMERA

    config AIC_USING_CAMERA_OV7670
        bool "Using camera OV7670"

    config AIC_USING_CAMERA_OV5640
        bool "Using camera OV5640"

    config AIC_USING_CAMERA_OV2659
        bool "Using camera OV2659"

    config AIC_USING_CAMERA_OV2640
        bool "Using camera OV2640"

    config AIC_USING_CAMERA_GC0308
        bool "Using camera GC0308"

    config AIC_USING_CAMERA_GC032A
        bool "Using camera GC032A"

    config AIC_USING_CAMERA_GM7150
        bool "Using camera GM7150"

    config AIC_USING_CAMERA_SC030IOT
        bool "Using camera SC030IOT"

    config AIC_USING_CAMERA_SC031GS
        bool "Using camera SC031GS"

    config AIC_USING_CAMERA_SC035HGS
        bool "Using camera SC035HGS"

    config AIC_USING_CAMERA_TP2825
        bool "Using camera TP2825"
endchoice

config AIC_CAMERA_I2C_CHAN
    int "The No. of I2C channel"
    depends on AIC_USING_CAMERA && AIC_I2C_DRV
    default 0

config AIC_CAMERA_RST_PIN
    string "The reset pin of Camera"
    depends on AIC_USING_CAMERA
    default "PE.14"

config AIC_CAMERA_PWDN_PIN
    string "The power down pin of Camera"
    depends on AIC_USING_CAMERA
    default "PE.15"
```

## bsp/peripheral/codec/Kconfig
```kconfig
config AIC_I2S_CODEC_SELECT
    bool "Select external audio codec"
    default n

config AIC_I2S_CODEC_ES8388
    bool "es8388"
    depends on AIC_I2S_CODEC_SELECT

config AIC_I2S_CODEC_TLV320
    bool "tlv320aic3101"
    default y if AIC_I2S_CODEC_SELECT
    depends on AIC_I2S_CODEC_SELECT

config AIC_I2S_CODEC_CS4344
    bool "cs4344"
    depends on AIC_I2S_CODEC_SELECT

if AIC_I2S_CODEC_ES8388
source "bsp/peripheral/codec/es8388/Kconfig"
endif

if AIC_I2S_CODEC_TLV320
source "bsp/peripheral/codec/tlv320aic3101/Kconfig"
endif

if AIC_I2S_CODEC_CS4344
source "bsp/peripheral/codec/cs4344/Kconfig"
endif

config AIC_I2S_CODEC_PA_PIN
    string "PA shutdown pin"
    default "PA.13"
    depends on AIC_I2S_CODEC_SELECT

if AIC_I2S_CODEC_SELECT
    choice
        prompt "Select PA enable level"
        default AIC_I2S_CODEC_PA_ENABLE_HIGH

        config  AIC_I2S_CODEC_PA_ENABLE_HIGH
            bool "high level Active"

        config  AIC_I2S_CODEC_PA_ENABLE_LOW
            bool "low level Active"
    endchoice
endif
```

## bsp/peripheral/codec/cs4344/Kconfig
```kconfig
menu "CS4344 codec options"

config AIC_I2S_CODEC_MCLK_NFS
    int "MCLK NFS"
    default 256

config AIC_I2S_CODEC_SCLK_NFS
    int "SCLK NFS"
    default 64

endmenu
```

## bsp/peripheral/codec/es8388/Kconfig
```kconfig
menu "ES8388 codec options"

config AIC_I2S_CODEC_ES8388_I2C
    string "es8388 i2c port select"
    default "i2c1"

config AIC_I2S_CODEC_MCLK_NFS
    int "MCLK NFS"
    default 256

config AIC_I2S_CODEC_SCLK_NFS
    int "SCLK NFS"
    default 64

endmenu
```

## bsp/peripheral/codec/tlv320aic3101/Kconfig
```kconfig
menu "TLV320AIC3101 codec options"

config AIC_I2S_CODEC_TLV320_I2C
    string "tlv320 i2c port select"
    default "i2c1"

config AIC_I2S_CODEC_MCLK_NFS
    int "MCLK NFS"
    default 256

config AIC_I2S_CODEC_SCLK_NFS
    int "SCLK NFS"
    default 64

endmenu
```

## bsp/peripheral/encoder/Kconfig
```kconfig
choice
    prompt "Select encoder device"
    default AIC_ENCODER_HEC40
    depends on AIC_USING_ENCODER

    config AIC_ENCODER_HEC40
        bool "HEC40"
endchoice

config AIC_ENCODER_PIN_A
        string "Encoder A-end pin"
        default "PA.8"
        depends on AIC_USING_ENCODER

config AIC_ENCODER_PIN_B
        string "Encoder B-end pin"
        default "PA.9"
        depends on AIC_USING_ENCODER

config AIC_ENCODER_NAME
    string
    default "hec40"  if AIC_ENCODER_HEC40
    depends on AIC_USING_ENCODER
```

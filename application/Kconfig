## application/baremetal/bootloader/Kconfig
```kconfig
menu "Bootloader options"

config AIC_BOOTLOADER
    bool
    default y
    select AIC_CONSOLE_BARE_DRV
    select AIC_PRINTF_BARE_DRV
    select AIC_USING_UMM_HEAP

menu "Memory"
    config AIC_BOOTLOADER_MEM_AUTO
        bool "Bootloader memory auto config"
        default y

    config AIC_BOOTLOADER_TEXT_BASE
        hex "BootLoader link address"
        default 0
        depends on !AIC_BOOTLOADER_MEM_AUTO
    config AIC_BOOTLOADER_TEXT_SIZE
        hex "BootLoader code memory size"
        default 0x3FF00

    config AIC_BOOTLOADER_HEAP_BASE
        hex "BootLoader heap address"
        default 0
        depends on !AIC_BOOTLOADER_MEM_AUTO
    config AIC_BOOTLOADER_HEAP_SIZE
        hex "BootLoader heap size"
        default 0xC0000
endmenu

menu "Console"
    config AIC_BOOTLOADER_CONSOLE_UART
        int "Console UART ID"
        range 0 8
        default 0
endmenu

menu "Drivers"
    config AIC_BOOTLOADER_MMC_SUPPORT
        bool "MMC boot support"
        default n
        select AIC_SDMC_DRV_TEST

    config AIC_BOOTLOADER_SPINOR_SUPPORT
        bool "SPI NOR boot support"
        default y
        select AIC_SPINOR_DRV

    config AIC_BOOTLOADER_SPINAND_SUPPORT
        bool "SPI NAND boot support"
        default y
        select AIC_SPINAND_DRV

    config AIC_BOOTLOADER_PSRAM_EN
        bool "PSRAM support"
        default n
        select AIC_XSPI_DRV
        source bsp/artinchip/drv_bare/psram/Kconfig.dev

    config AIC_BOOTLOADER_AXICFG_SUPPORT
        bool "AXICFG support"
        default n
        select AIC_AXICFG_DRV
        source bsp/artinchip/hal/axicfg/Kconfig.dev

endmenu # "Drivers"

menu "Components"
    config AIC_BOOTLOADER_FATFS_SUPPORT
        bool "Fatfs for bootloader"
        default n

endmenu # "Components"

menu "Upgrading"
    config AICUPG_SINGLE_TRANS_BURN_CRC32_VERIFY
        bool "CRC32 verify transfer data"
        default n

    config AICUPG_FORCE_UPGRADE_SUPPORT
        bool "Force upgrading check during boot"
        default n

    config AICUPG_UART_ENABLE
        bool "Upgrading by UART"
        default n
        select LPKG_USING_CHERRYUSB
        select AIC_UART_DRV

    config AICUPG_USB_ENABLE
        bool "Upgrading by USB"
        default y
        select LPKG_USING_CHERRYUSB
        select LPKG_CHERRYUSB_OTG
        select LPKG_CHERRYUSB_DEVICE
        select LPKG_CHERRYUSB_DEVICE_CLASS_AIC
        select LPKG_CHERRYUSB_DEVICE_AICUPG_FOR_USB
        select AIC_USING_USB0
        select AIC_USING_USB0_OTG

    config AICUPG_HID_ENABLE
        bool "Upgrading by HID"
        default n
        select LPKG_USING_CHERRYUSB
        select LPKG_CHERRYUSB_OTG
        select LPKG_CHERRYUSB_DEVICE
        select LPKG_CHERRYUSB_DEVICE_HID
        select LPKG_CHERRYUSB_DEVICE_AICUPG_FOR_HID
        select AIC_USING_USB0
        select AIC_USING_USB0_OTG

    config AICUPG_SDCARD_ENABLE
        bool "Upgrading by SD Card"
        default n
        select AIC_BOOTLOADER_MMC_SUPPORT
        select AIC_BOOTLOADER_FATFS_SUPPORT

    config AICUPG_SDCARD_CONTROLLER_ID
        int  "SDMC controller id for SD Card"
        default 1
        depends on AICUPG_SDCARD_ENABLE

    config AICUPG_UDISK_ENABLE
        bool "Upgrading by UDISK"
        default n
        select LPKG_USING_CHERRYUSB
        select LPKG_CHERRYUSB_OTG
        select LPKG_CHERRYUSB_HOST
        select LPKG_CHERRYUSB_HOST_MSC
        select LPKG_CHERRYUSB_HOST_AICUPG_FOR_UDISK
        select AIC_USING_USB0
        select AIC_USING_USB0_OTG
        select AIC_BOOTLOADER_FATFS_SUPPORT

    config AICUPG_USB_USE_CONTROLLER_ID_1
        bool  "USB ID 1 to be used for udisk"
        default n
        select AIC_USING_USB1
        depends on AICUPG_UDISK_ENABLE

    config AICUPG_MMC_ARTINCHIP
        bool "Write to MMC support"
        default y
        depends on AIC_BOOTLOADER_MMC_SUPPORT

    config AICUPG_NAND_ARTINCHIP
        bool "Write to NAND support"
        default y
        depends on AIC_BOOTLOADER_SPINAND_SUPPORT

    config AICUPG_NOR_ARTINCHIP
        bool "Write to NOR support"
        default y
        depends on AIC_BOOTLOADER_SPINOR_SUPPORT
    config AICUPG_LOG_BUFFER_SUPPORT
        bool "Support to get log buffer from device"
        default y
    if AICUPG_LOG_BUFFER_SUPPORT
        config AICUPG_LOG_BUFFER_ADDR
            hex "Log buffer start address"
            default 0x100000 if AIC_CHIP_D21X
            default 0x30040000 if AIC_CHIP_D12X
            default 0x30040000 if AIC_CHIP_D13X
        config AICUPG_LOG_BUFFER_SIZE
            hex "Log buffer size"
            default 0x3000 if AIC_CHIP_D21X
            default 0x3000 if AIC_CHIP_D12X
            default 0x3000 if AIC_CHIP_D13X
    endif
endmenu # "Upgrading settings"

menu "Commands"
    config AIC_BOOTLOADER_CMD_NOR_BOOT
        bool "nor boot"
        default y
        depends on AIC_BOOTLOADER_SPINOR_SUPPORT

    config AIC_BOOTLOADER_CMD_XIP_BOOT
        bool "xip boot"
        default n
        depends on AIC_BOOTLOADER_SPINOR_SUPPORT

    config AIC_BOOTLOADER_CMD_NAND_BOOT
        bool "nand boot"
        default y
        depends on AIC_BOOTLOADER_SPINAND_SUPPORT

    config AIC_BOOTLOADER_CMD_MMC_BOOT
        bool "mmc boot"
        default n

    config AIC_BOOTLOADER_CMD_SPI_NOR
        bool "spinor"
        default y
        depends on AIC_BOOTLOADER_SPINOR_SUPPORT

    config AIC_BOOTLOADER_CMD_SPI_NAND
        bool "spinand"
        default y
        depends on AIC_BOOTLOADER_SPINAND_SUPPORT

    config AIC_BOOTLOADER_CMD_MTD
        bool "mtd read/write"
        default y
        depends on AIC_BOOTLOADER_SPINAND_SUPPORT || AIC_BOOTLOADER_SPINOR_SUPPORT
        select AIC_MTD_BARE_TEST

    config AIC_BOOTLOADER_CMD_MEM
        bool "mem"
        default y

    config AIC_BOOTLOADER_CMD_PART
        bool "part"
        default y

    config AIC_BOOTLOADER_CMD_PROGRESS_BAR
        bool "boot progress bar"
        depends on AIC_DE_DRV
        default n

    config AIC_BOOTLOADER_CMD_FB_CONSOLE
        bool "fb console support"
        default y
        depends on AIC_BOOTLOADER_CMD_PROGRESS_BAR

    config AIC_BOOTLOADER_CMD_ONLY_FB_CONSOLE
        bool "only fb console"
        default n
        depends on AIC_BOOTLOADER_CMD_FB_CONSOLE

    config AIC_BOOTLOADER_CMD_PSRAM_TEST
        bool "psram memory test"
        depends on AIC_XSPI_DRV
        default n
endmenu # "Commands"

menu "Debug"
    config AICUPG_DEBUG
        bool "aicupg debug log"
        default n

    config AICUPG_UART_DEBUG
        bool "aicupg uart debug log"
        default n

    config AIC_SHOW_BOOT_TIME
        bool "show boot time"
        default n

endmenu # "Debug"

endmenu # "Bootloader options"
```

## bsp/artinchip/drv/cap/Kconfig
```kconfig
#-----------------------------
# CAP devices local parameter
#-----------------------------

# CAP0 parameter

menu "CAP0 Parameter"
    depends on AIC_USING_CAP0

    config AIC_CAP0_FLT_SEL
        int "CAP0 filter seclect"
        range 0 15
        default 0
endmenu

# CAP1 parameter

menu "CAP1 Parameter"
    depends on AIC_USING_CAP1

    config AIC_CAP1_FLT_SEL
        int "CAP1 filter seclect"
        range 0 15
        default 0
endmenu

# CAP2 parameter

menu "CAP2 Parameter"
    depends on AIC_USING_CAP2

    config AIC_CAP2_FLT_SEL
        int "CAP2 filter seclect"
        range 0 15
        default 0
endmenu

# CAP3 parameter

menu "CAP3 Parameter"
    depends on AIC_USING_CAP3

    config AIC_CAP3_FLT_SEL
        int "CAP3 filter seclect"
        range 0 15
        default 0
endmenu

# CAP4 parameter

menu "CAP4 Parameter"
    depends on AIC_USING_CAP4

    config AIC_CAP4_FLT_SEL
        int "CAP4 filter seclect"
        range 0 15
        default 0
endmenu

# CAP5 parameter

menu "CAP5 Parameter"
    depends on AIC_USING_CAP5

    config AIC_CAP5_FLT_SEL
        int "CAP5 filter seclect"
        range 0 15
        default 0
endmenu

# common parameter
```

## bsp/artinchip/drv/display/Kconfig
```kconfig
config AIC_DISPLAY_DRV
    bool
    default y if AIC_DE_DRV

config AIC_DISP_PQ_TOOL
    bool "Ai PQ Tool Support"
    default n
    depends on AIC_DISPLAY_DRV
    select AIC_FB_DRV_DEBUG

config AIC_DISP_DE_DRV
    bool
    default y
    depends on AIC_DISPLAY_DRV && AIC_DE_DRV

config AIC_DISP_RGB_DRV
    bool
    default n
    depends on AIC_DE_DRV

config AIC_DISP_LVDS_DRV
    bool
    default n
    depends on AIC_DE_DRV

config AIC_DISP_MIPI_DSI_DRV
    bool
    default n
    depends on AIC_DE_DRV

choice
    prompt "select Display interface"
    default AIC_DISP_RGB
    depends on AIC_DISPLAY_DRV

config AIC_DISP_RGB
    bool "Display RGB interface"
    select AIC_DISP_RGB_DRV
    depends on AIC_DE_DRV_V10 || AIC_DE_DRV_V11 || AIC_DE_DRV_V12

config AIC_DISP_LVDS
    bool "Display LVDS interface"
    select AIC_DISP_LVDS_DRV
    depends on AIC_DE_DRV_V10 || AIC_DE_DRV_V11

config AIC_DISP_MIPI_DSI
    bool "Display MIPI-DSI interface"
    select AIC_DISP_MIPI_DSI_DRV
    depends on AIC_DE_DRV_V10 || AIC_DE_DRV_V11

config AIC_DISP_MIPI_DBI
    bool "Display MIPI-DBI interface"
    select AIC_DISP_MIPI_DBI_DRV
    depends on AIC_DE_DRV_V10 || AIC_DE_DRV_V11 || AIC_DE_DRV_V12
endchoice

config AIC_DI_TYPE
    int
    default 1 if AIC_DISP_RGB
    default 2 if AIC_DISP_LVDS
    default 3 if AIC_DISP_MIPI_DSI
    default 4 if AIC_DISP_MIPI_DBI

if AIC_DISP_PQ_TOOL
config AIC_DSI_SIMPLE_PANEL
    bool
    default y
    depends on AIC_DISP_MIPI_DSI
endif

if AIC_DISP_LVDS && !AIC_DISP_PQ_TOOL
source "bsp/artinchip/drv/display/Kconfig.lvds"
endif

if AIC_DISP_RGB && !AIC_DISP_PQ_TOOL
source "bsp/artinchip/drv/display/Kconfig.rgb"
endif

choice
    prompt "select framebuffer format"
    default AICFB_ARGB8888
    depends on AIC_DISPLAY_DRV

config AICFB_ARGB8888
    bool "argb8888"

config AICFB_ABGR8888
    bool "abgr8888"

config AICFB_XRGB8888
    bool "xrgb8888"

config AICFB_RGB888
    bool "rgb888"

config AICFB_RGB565
    bool "rgb565"

config AICFB_ARGB1555
    bool "argb1555"
endchoice

config AICFB_FORMAT
    hex
    default 0x00  if AICFB_ARGB8888
    default 0x01  if AICFB_ABGR8888
    default 0x04  if AICFB_XRGB8888
    default 0x08  if AICFB_RGB888
    default 0x0e  if AICFB_RGB565
    default 0x0a  if AICFB_ARGB1555

config AIC_PAN_DISPLAY
    bool "Support double framebuffer"
    default n
    depends on AIC_DISPLAY_DRV

config AIC_DISP_COLOR_BLOCK
    bool "Display color block"
    default y
    depends on AIC_DISPLAY_DRV

config AIC_DISPLAY_DITHER
    bool
    depends on (AIC_LVDS_JEIDA_18BIT  || AIC_PRGB_18BIT_LD || \
                AIC_PRGB_18BIT_HD     || AIC_PRGB_16BIT_LD || \
                AIC_PRGB_16BIT_HD     || AICFB_ARGB8888    || \
                AICFB_ABGR8888        || AICFB_XRGB8888    || \
                AICFB_RGB888)         && (!AICFB_RGB565    && !AICFB_ARGB1555)

config AIC_DISABLE_DITHER
    bool "Disable Display Dither"
    default n
    depends on AIC_DISPLAY_DITHER

choice
    prompt "framebuffer rotation degree"
    default AICFB_ROTATE_0
    depends on AIC_DISPLAY_DRV

config AICFB_ROTATE_0
    bool "0"

config AICFB_ROTATE_90
    bool "90"

config AICFB_ROTATE_180
    bool "180"

config AICFB_ROTATE_270
    bool "270"
endchoice

config AIC_FB_ROTATE_EN
    bool
    default y
    depends on AICFB_ROTATE_90 || AICFB_ROTATE_180 || AICFB_ROTATE_270

config AIC_FB_ROTATE_DEGREE
    int
    default 0 if AICFB_ROTATE_0
    default 90 if AICFB_ROTATE_90
    default 180 if AICFB_ROTATE_180
    default 270 if AICFB_ROTATE_270

choice
    prompt "select Output depth"
    default AIC_OUTPUT_DEPTH_16
    depends on AIC_DISPLAY_DITHER

config AIC_OUTPUT_DEPTH_16
    bool "Dither rgb565 Output depth 16"

config AIC_OUTPUT_DEPTH_18
    bool "Dither rgb666 Output depth 18"
endchoice

config AIC_DISP_OUTPUT_DEPTH
    int
    default 1 if AIC_OUTPUT_DEPTH_16
    default 2 if AIC_OUTPUT_DEPTH_18

if AIC_DISPLAY_DRV
source "bsp/artinchip/drv/display/panel/Kconfig"
endif

if !AIC_DISP_PQ_TOOL

choice
    prompt "panel backlight control"
    default AIC_GPIO_BACKLIGHT
    depends on AIC_DISPLAY_DRV

    config AIC_PWM_BACKLIGHT
    bool "pwm"
    depends on AIC_PWM_DRV

    config AIC_GPIO_BACKLIGHT
    bool "gpio"
endchoice

if AIC_GPIO_BACKLIGHT
    config AIC_PANEL_ENABLE_GPIO
        string "panel backlight enable pin"
        default "PE.19"

    config AIC_PANEL_ENABLE_GPIO_LOW
        bool "panel backlight enable pin low active"
        default n
endif

if AIC_PWM_BACKLIGHT
    config AIC_PWM_BACKLIGHT_CHANNEL
        int "pwm backlight channel"
        default 3

    config AIC_PWM_BRIGHTNESS_LEVEL
        int "default brightness level"
        default 80
        range 0 100

    config AIC_PWM_BACKLIGHT_BYPASS
        bool
        default n
endif
endif

config AIC_PANEL_SPI_EMULATION
    bool
    default n

config AIC_SCREEN_CROP
    bool "Enable screen crop"
    default n
    depends on AIC_DISPLAY_DRV
    help
        Some LCD screen need to be cropped, the effective area displayed is less
        than the timing signal.
        If unsure select "N".

if AIC_SCREEN_CROP
    config AIC_SCREEN_CROP_POS_X
        int "screen crop x position of pixels"
        default 0
    config AIC_SCREEN_CROP_POS_Y
        int "screen crop y position of pixels"
        default 0
    config AIC_SCREEN_CROP_WIDTH
        int "screen crop width"
        default 0
    config AIC_SCREEN_CROP_HEIGHT
        int "screen crop height"
        default 0
endif
```

## bsp/artinchip/drv/efuse/Kconfig.dev
```kconfig
#-----------------------------
# eFuse/SID devices local parameter
#-----------------------------
menu "SID Parameter"
    depends on AIC_USING_SID

    config EFUSE_WRITE_SUPPORT
	bool "support efuse write"
	default n

    config EFUSE_MAX_WORD
	int "set efuse max word"
	default 16 if AIC_CHIP_D12X
	default 64 if AIC_CHIP_D21X || AIC_CHIP_D13X || AIC_CHIP_G73X

    config EFUSE_TIMING_VALUE
	hex "set timing value"
	default 0x0402FFD8 if AIC_CHIP_D21X
	default 0x0402FFD8 if AIC_CHIP_D13X || AIC_CHIP_G73X
	default 0x04021FF1 if AIC_CHIP_D12X
	default 0x04021FF1 if AIC_CHIP_AIC1606SE
endmenu
```

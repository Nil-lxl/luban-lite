## bsp/artinchip/drv/epwm/Kconfig.dev
```kconfig
#-----------------------------
# EPWM devices local parameter
#-----------------------------

# EPWM0 parameter

menu "EPWM0 Parameter"
    depends on AIC_USING_EPWM0

config AIC_EPWM0_SYNC
    int "Using EPWM0 sync mode"
    range 0 1
    default 0
    help
        set 0 to unuse sync mode, set 1 to use sync mode

endmenu

# EPWM1 parameter

menu "EPWM1 Parameter"
    depends on AIC_USING_EPWM1

config AIC_EPWM1_SYNC
    int "Using EPWM1 sync mode"
    range 0 1
    default 0
    help
        set 0 to unuse sync mode, set 1 to use sync mode

endmenu

# EPWM2 parameter

menu "EPWM2 Parameter"
    depends on AIC_USING_EPWM2

config AIC_EPWM2_SYNC
    int "Using EPWM2 sync mode"
    range 0 1
    default 0
    help
        set 0 to unuse sync mode, set 1 to use sync mode

endmenu

# EPWM3 parameter

menu "EPWM3 Parameter"
    depends on AIC_USING_EPWM3

config AIC_EPWM3_SYNC
    int "Using EPWM3 sync mode"
    range 0 1
    default 0
    help
        set 0 to unuse sync mode, set 1 to use sync mode

endmenu

# EPWM4 parameter

menu "EPWM4 Parameter"
    depends on AIC_USING_EPWM4

config AIC_EPWM4_SYNC
    int "Using EPWM4 sync mode"
    range 0 1
    default 0
    help
        set 0 to unuse sync mode, set 1 to use sync mode

endmenu

# EPWM5 parameter

menu "EPWM5 Parameter"
    depends on AIC_USING_EPWM5

config AIC_EPWM5_SYNC
    int "Using EPWM5 sync mode"
    range 0 1
    default 0
    help
        set 0 to unuse sync mode, set 1 to use sync mode

endmenu

# EPWM6 parameter

menu "EPWM6 Parameter"
    depends on AIC_USING_EPWM6

config AIC_EPWM6_SYNC
    int "Using EPWM6 sync mode"
    range 0 1
    default 0
    help
        set 0 to unuse sync mode, set 1 to use sync mode

endmenu

# EPWM7 parameter

menu "EPWM7 Parameter"
    depends on AIC_USING_EPWM7

config AIC_EPWM7_SYNC
    int "Using EPWM7 sync mode"
    range 0 1
    default 0
    help
        set 0 to unuse sync mode, set 1 to use sync mode

endmenu

# EPWM8 parameter

menu "EPWM8 Parameter"
    depends on AIC_USING_EPWM8

config AIC_EPWM8_SYNC
    int "Using EPWM8 sync mode"
    range 0 1
    default 0
    help
        set 0 to unuse sync mode, set 1 to use sync mode

endmenu

# EPWM9 parameter

menu "EPWM9 Parameter"
    depends on AIC_USING_EPWM9

config AIC_EPWM9_SYNC
    int "Using EPWM9 sync mode"
    range 0 1
    default 0
    help
        set 0 to unuse sync mode, set 1 to use sync mode

endmenu

# EPWM10 parameter

menu "EPWM10 Parameter"
    depends on AIC_USING_EPWM10

config AIC_EPWM10_SYNC
    int "Using EPWM10 sync mode"
    range 0 1
    default 0
    help
        set 0 to unuse sync mode, set 1 to use sync mode

endmenu

# EPWM11 parameter

menu "EPWM11 Parameter"
    depends on AIC_USING_EPWM11

config AIC_EPWM11_SYNC
    int "Using EPWM11 sync mode"
    range 0 1
    default 0
    help
        set 0 to unuse sync mode, set 1 to use sync mode

endmenu

# common parameter
```

## bsp/artinchip/drv/i2c/Kconfig.dev
```kconfig
#-----------------------------
# i2c devices local parameter
#-----------------------------

# soft_i2c parameter

menu "SOFT_I2C Parameter"
    depends on AIC_USING_SOFT_I2C

    config AIC_SOFT_I2C_SCL_PIN
        string "SOFT_I2C SCL PIN"
        default "PD.6"

    config AIC_SOFT_I2C_SDA_PIN
        string "SOFT_I2C SDA PIN"
        default "PD.7"

    config AIC_DEV_SOFT_I2C_DELAY_TIME
        int "Setting SOFT_I2C GPIO Level Change Delay Time(us)"
        default 5

endmenu

# i2c0 parameter

menu "I2C0 Parameter"
    depends on AIC_USING_I2C0

    config AIC_DEV_I2C0_ADDR_BIT
        bool "Using I2C0 10-bit Addr(default 7-bit addr)"
        default n

    config AIC_DEV_I2C0_10BIT
       int
       default 1     if AIC_DEV_I2C0_ADDR_BIT
       default 0

    config AIC_DEV_I2C0_SPEED
        int "Setting I2C0 Transfer Speed"
        default 400000

    config AIC_DEV_I2C0_BUS_MODE
        bool "Using I2C0 Slave Mode(default master mode)"
        default n

    config AIC_DEV_I2C0_SLAVE_MODE
       int
       default 1     if AIC_DEV_I2C0_BUS_MODE
       default 0

    if AIC_DEV_I2C0_BUS_MODE
        config AIC_DEV_I2C0_SLAVE_ADDR
            int "I2C0 Slave Addr"
    endif

endmenu

# i2c1 parameter

menu "I2C1 Parameter"
    depends on AIC_USING_I2C1

    config AIC_DEV_I2C1_ADDR_BIT
        bool "Using I2C1 10-bit Addr(default 7-bit addr)"
        default n

    config AIC_DEV_I2C1_10BIT
       int
       default 1     if AIC_DEV_I2C1_ADDR_BIT
       default 0

    config AIC_DEV_I2C1_SPEED
        int "Setting I2C1 Transfer Speed"
        default 400000

    config AIC_DEV_I2C1_BUS_MODE
        bool "Using I2C1 Slave Mode(default master mode)"
        default n

    config AIC_DEV_I2C1_SLAVE_MODE
       int
       default 1     if AIC_DEV_I2C1_BUS_MODE
       default 0

    if AIC_DEV_I2C1_BUS_MODE
        config AIC_DEV_I2C1_SLAVE_ADDR
            int "I2C1 Slave Addr"
    endif

endmenu

# i2c2 parameter

menu "I2C2 Parameter"
    depends on AIC_USING_I2C2

    config AIC_DEV_I2C2_ADDR_BIT
        bool "Using I2C2 10-bit Addr(default 7-bit addr)"
        default n

    config AIC_DEV_I2C2_10BIT
       int
       default 1     if AIC_DEV_I2C2_ADDR_BIT
       default 0

    config AIC_DEV_I2C2_SPEED
        int "Setting I2C2 Transfer Speed"
        default 400000

    config AIC_DEV_I2C2_BUS_MODE
        bool "Using I2C2 Slave Mode(default master mode)"
        default n

    config AIC_DEV_I2C2_SLAVE_MODE
       int
       default 1     if AIC_DEV_I2C2_BUS_MODE
       default 0

    if AIC_DEV_I2C2_BUS_MODE
        config AIC_DEV_I2C2_SLAVE_ADDR
            int "I2C2 Slave Addr"
    endif

endmenu

# i2c3 parameter

menu "I2C3 Parameter"
    depends on AIC_USING_I2C3

    config AIC_DEV_I2C3_ADDR_BIT
        bool "Using I2C3 10-bit Addr(default 7-bit addr)"
        default n

    config AIC_DEV_I2C3_10BIT
       int
       default 1     if AIC_DEV_I2C3_ADDR_BIT
       default 0

    config AIC_DEV_I2C3_SPEED
        int "Setting I2C3 Transfer Speed"
        default 400000

    config AIC_DEV_I2C3_BUS_MODE
        bool "Using I2C3 Slave Mode(default master mode)"
        default n

    config AIC_DEV_I2C3_SLAVE_MODE
       int
       default 1     if AIC_DEV_I2C3_BUS_MODE
       default 0

    if AIC_DEV_I2C3_BUS_MODE
        config AIC_DEV_I2C3_SLAVE_ADDR
            int "I2C3 Slave Addr"
    endif

endmenu

menu "I2C4 Parameter"
    depends on AIC_USING_I2C4

    config AIC_DEV_I2C4_ADDR_BIT
        bool "Using I2C4 10-bit Addr(default 7-bit addr)"
        default n

    config AIC_DEV_I2C4_10BIT
       int
       default 1     if AIC_DEV_I2C4_ADDR_BIT
       default 0

    config AIC_DEV_I2C4_SPEED
        int "Setting I2C4 Transfer Speed"
        default 400000

    config AIC_DEV_I2C4_BUS_MODE
        bool "Using I2C4 Slave Mode(default master mode)"
        default n

    config AIC_DEV_I2C4_SLAVE_MODE
       int
       default 1     if AIC_DEV_I2C4_BUS_MODE
       default 0

    if AIC_DEV_I2C4_BUS_MODE
        config AIC_DEV_I2C4_SLAVE_ADDR
            int "I2C4 Slave Addr"
    endif

endmenu

menu "SP_I2C Parameter"
    depends on AIC_USING_SP_I2C

    config AIC_DEV_SP_I2C_ADDR_BIT
        bool "Using SP-I2C 10-bit Addr(default 7-bit addr)"
        default n

    config AIC_DEV_SP_I2C_10BIT
       int
       default 1     if AIC_DEV_SP_I2C_ADDR_BIT
       default 0

    config AIC_DEV_SP_I2C_SPEED
        int "Setting SP-I2C Transfer Speed"
        default 400000

    config AIC_DEV_SP_I2C_BUS_MODE
        bool "Using SP-I2C Slave Mode(default master mode)"
        default n

    config AIC_DEV_SP_I2C_SLAVE_MODE
       int
       default 1     if AIC_DEV_SP_I2C_BUS_MODE
       default 0

    if AIC_DEV_SP_I2C_BUS_MODE
        config AIC_DEV_SP_I2C_SLAVE_ADDR
            int "SP-I2C Slave Addr"
    endif

endmenu

menu "R_I2C0 Parameter"
    depends on AIC_USING_R_I2C0

    config AIC_DEV_R_I2C0_ADDR_BIT
        bool "Using R-I2C0 10-bit Addr(default 7-bit addr)"
        default n

    config AIC_DEV_R_I2C0_10BIT
       int
       default 1     if AIC_DEV_R_I2C0_ADDR_BIT
       default 0

    config AIC_DEV_SP_I2C_SPEED
        int "Setting R-I2C0 Transfer Speed"
        default 400000

    config AIC_DEV_R_I2C0_BUS_MODE
        bool "Using R-I2C0 Slave Mode(default master mode)"
        default n

    config AIC_DEV_R_I2C0_SLAVE_MODE
       int
       default 1     if AIC_DEV_R_I2C0_BUS_MODE
       default 0

    if AIC_DEV_R_I2C0_BUS_MODE
        config AIC_DEV_R_I2C0_SLAVE_ADDR
            int "R-I2C0 Slave Addr"
    endif

endmenu

menu "R_I2C1 Parameter"
    depends on AIC_USING_R_I2C1

    config AIC_DEV_R_I2C1_ADDR_BIT
        bool "Using R-I2C1 10-bit Addr(default 7-bit addr)"
        default n

    config AIC_DEV_R_I2C1_10BIT
       int
       default 1     if AIC_DEV_R_I2C1_ADDR_BIT
       default 0

    config AIC_DEV_SP_I2C_SPEED
        int "Setting R-I2C1 Transfer Speed"
        default 400000

    config AIC_DEV_R_I2C1_BUS_MODE
        bool "Using R-I2C1 Slave Mode(default master mode)"
        default n

    config AIC_DEV_R_I2C1_SLAVE_MODE
       int
       default 1     if AIC_DEV_R_I2C1_BUS_MODE
       default 0

    if AIC_DEV_R_I2C1_BUS_MODE
        config AIC_DEV_R_I2C1_SLAVE_ADDR
            int "R-I2C1 Slave Addr"
    endif

endmenu

# common parameter
```

## bsp/artinchip/drv/i2c/Kconfig.drv
```kconfig
#-----------------------------
# i2c driver local parameter
#-----------------------------

config AIC_I2C_INTERRUPT_MODE
    bool "Support I2c Dev Interrupt Mode"
    default n
```

## bsp/artinchip/drv/pm/Kconfig
```kconfig
#-----------------------------
# devices local parameter
#-----------------------------

menu "PM configure"
    depends on AIC_USING_PM

    choice
        prompt "Select default sleep mode"
        default AIC_PM_POWER_DEFAULT_DEEP_MODE

        config AIC_PM_POWER_DEFAULT_LIGHT_MODE
            bool "light sleep mode"

        config AIC_PM_POWER_DEFAULT_DEEP_MODE
            bool "deep sleep mode"
    endchoice

    config AIC_BOARD_LEVEL_POWER_PIN
        string "PM board level power switch"
        default ""

endmenu
```

## bsp/artinchip/drv/qspi/Kconfig.dev
```kconfig
#-----------------------------
# SPI devices local parameter
#-----------------------------

config AIC_SUPPORT_SPI_IN_BIT_MODE
    bool "Enable SPI bit mode"
    default n
    depends on AIC_QSPI_DRV

config AIC_SUPPORT_SPI_X_WIRE_IN_BIT_MODE
    int "SPI bit mode is 3-WIRE or STD"
    depends on AIC_SUPPORT_SPI_IN_BIT_MODE
    default 3
    range 3 4

source "bsp/artinchip/drv/spinor/Kconfig.dev"
source "bsp/artinchip/drv/spinand/Kconfig.dev"
```

## bsp/artinchip/drv/sdmc/Kconfig
```kconfig
#-----------------------------
# SDMC devices local parameter
#-----------------------------

config AIC_SDMC_IRQ_MODE
    bool "Enable the interrupt of SDMC"
    default n
    depends on AIC_USING_SDMC0 || AIC_USING_SDMC1 || AIC_USING_SDMC2

# SDMC0 parameter

menu "SDMC0 Parameter"
    depends on AIC_USING_SDMC0

choice
    prompt "Select SDMC0 BUSWIDTH"
    default AIC_SDMC0_BUSWIDTH4
    config AIC_SDMC0_BUSWIDTH1
        bool "sdmc 1-bit mode"
    config AIC_SDMC0_BUSWIDTH4
        bool "sdmc 4-bit mode"
    config AIC_SDMC0_BUSWIDTH8
        bool "sdmc 8-bit mode"
endchoice

    config AIC_SDMC0_DDR_MODE
        bool "Using DDR mode"
        default n

    config AIC_SDMC0_IS_SDIO
        bool "SDMC0 connect to a SDIO device"
        select AIC_SDMC_IRQ_MODE
        default n

    config AIC_SDMC0_DRV_PHASE
        int "SDMC0 driver phase"
        range 0 3
        default 3

    config AIC_SDMC0_SMP_PHASE
        int "SDMC0 sample phase"
        range 0 3
        default 0

    config AIC_SDMC0_CLK_FREQ
        int "SDMC0 CMU clock frequency"
        range 31500000 200000000
        default 100000000

endmenu

# SDMC1 parameter

menu "SDMC1 Parameter"
    depends on AIC_USING_SDMC1

choice
    prompt "Select SDMC1 BUSWIDTH"
    default AIC_SDMC1_BUSWIDTH4
    config AIC_SDMC1_BUSWIDTH1
        bool "sdmc 1-bit mode"
    config AIC_SDMC1_BUSWIDTH4
        bool "sdmc 4-bit mode"
endchoice

    config AIC_SDMC1_USING_HOTPLUG
        bool "Using SDcard hotplug detection"
        default n

    config AIC_SDMC1_HOTPLUG_PIN
        string "sdcard hotplug gpio"
        default "PC.6"
        depends on AIC_SDMC1_USING_HOTPLUG

    config AIC_SDMC1_IS_SDIO
        bool "SDMC1 connect to a SDIO device"
        select AIC_SDMC_IRQ_MODE
        default n

    config AIC_SDMC1_DRV_PHASE
        int "SDMC1 driver phase"
        range 0 3
        default 3

    config AIC_SDMC1_SMP_PHASE
        int "SDMC1 sample phase"
        range 0 3
        default 0

    config AIC_SDMC1_CLK_FREQ
        int "SDMC1 CMU clock frequency"
        range 31500000 200000000
        default 100000000

endmenu

# SDMC2 parameter

menu "SDMC2 Parameter"
    depends on AIC_USING_SDMC2

choice
    prompt "Select SDMC2 BUSWIDTH"
    default AIC_SDMC2_BUSWIDTH4
    config AIC_SDMC2_BUSWIDTH1
        bool "sdmc 1-bit mode"
    config AIC_SDMC2_BUSWIDTH4
        bool "sdmc 4-bit mode"
endchoice

    config AIC_SDMC2_IS_SDIO
        bool "SDMC2 connect to a SDIO device"
        select AIC_SDMC_IRQ_MODE
        default n

    config AIC_SDMC2_DRV_PHASE
        int "SDMC2 driver phase"
        range 0 3
        default 3

    config AIC_SDMC2_SMP_PHASE
        int "SDMC2 sample phase"
        range 0 3
        default 0

    config AIC_SDMC2_CLK_FREQ
        int "SDMC2 CMU clock frequency"
        range 31500000 200000000
        default 100000000

endmenu

# common parameter
```

## bsp/artinchip/drv/spienc/Kconfig
```kconfig
#-----------------------------
# devices local parameter
#-----------------------------

if AIC_USING_SPIENC

config AIC_SPIENC_BYPASS_IN_UPGMODE
    bool "Bypass during bootloader burn image"
    default n
    depends on AIC_BOOTLOADER

config AIC_SPIENC_QSPI0
    bool "Enc qspi0"
    default n
    select AIC_QSPI_DRV
    depends on AIC_USING_QSPI0

config AIC_SPIENC_QSPI0_TWEAK
    int "set qspi0 tweak"
    default 0
    depends on AIC_SPIENC_QSPI0

config AIC_SPIENC_QSPI1
    bool "Enc qspi1"
    default n
    select AIC_QSPI_DRV
    depends on AIC_USING_QSPI1

config AIC_SPIENC_QSPI1_TWEAK
    int "set qspi1 tweak"
    default 0
    depends on AIC_SPIENC_QSPI1

config AIC_SPIENC_SE_SPI
    bool "Enc se spi"
    default n
    select AIC_QSPI_DRV
    depends on AIC_USING_SE_SPI

config AIC_SPIENC_SE_SPI_TWEAK
    int "set se spi tweak"
    default 0
    depends on AIC_SPIENC_SE_SPI

endif
```

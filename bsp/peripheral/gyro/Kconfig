## packages/third-party/ffmpeg/Kconfig
```kconfig
menuconfig LPKG_USING_FFMPEG
    bool "FFmpeg is a collection of libraries and tools to process multimedia content"
    default n

config LPKG_FFMPEG_MEM_USING_CMA
    bool "Enable ffmpeg private data memory using cma"
    default n
    depends on LPKG_USING_FFMPEG
```

## packages/third-party/freetype/Kconfig
```kconfig
menuconfig LPKG_USING_FREETYPE
    bool "freetype"
    default n

if LPKG_USING_FREETYPE
    config LPKG_USING_FREETYPE_STATIC
        bool "Compile using FREETYPE static link library"
        default n

    config TT_DISABLE_LOAD_HDMX
        bool "Disable loading hdmx table"
        default n

if AIC_PSRAM_SW_SIZE > 0 && AIC_CHIP_D13X
    config TT_USE_MEM_PSRAM_SW_HEAP
        bool "FreeType using Psram SW Heap"
        default n
endif

endif
```

## packages/third-party/gif/Kconfig
```kconfig
# Kconfig file for gif
menuconfig LPKG_USING_GIF
    bool "GIF: decode giff image"
    default n

if LPKG_USING_GIF

choice
    prompt "select gif color format "
    default GIF_COLOR_FORMAT_RGB565

    config GIF_COLOR_FORMAT_ARGB8888
        bool "argb8888"

    config GIF_COLOR_FORMAT_RGB565
        bool "rgb565"
endchoice

    config GIF_COLOR_FORMAT
        int
        default 0   if GIF_COLOR_FORMAT_ARGB8888
        default 14  if GIF_COLOR_FORMAT_RGB565

    config GIF_USING_SAMPLES
        bool "Enable gif  samples"
        default n

endif
```

## packages/third-party/levelx/Kconfig
```kconfig
# Kconfig file for package LevelX
menuconfig LPKG_USING_LEVELX
    bool "LevelX: A high-performance embedded file layer"
    default n

if LPKG_USING_LEVELX
        config AIC_LX_SECTOR_MAPPING_CACHE_SIZE
            int "lx nor sector mapping cache size"
            default 256

endif
```

## packages/third-party/libFLAC/Kconfig
```kconfig
menuconfig LPKG_USING_LIBFLAC
    bool "FLAC: Free Lossless Audio Codec."
    default n

if LPKG_USING_LIBFLAC

    config LPKG_LIBFLAC_DECODER_DEMO
        bool "libFLAC decoder demo."
        default n

endif
```

## packages/third-party/libmodbus/Kconfig
```kconfig
# Kconfig file for package libmodbus
menuconfig LPKG_USING_LIBMODBUS
    bool "libmodbus: A Modbus library for RT-Thread"
    default n
    select RT_USING_LIBC     if RT_VER_NUM < 0x40100
    select RT_USING_DFS      if RT_VER_NUM < 0x40100
    select RT_USING_POSIX    if RT_VER_NUM < 0x40100
    select RT_USING_POSIX_FS if RT_VER_NUM >= 0x40100

if LPKG_USING_LIBMODBUS

    config LPKG_LIBMODBUS_PATH
        string
        default "/packages/third-party/libmodbus"

    config LPKG_USING_LIBMODBUS_RTU
        bool "Enable libmodbus rtu mode"
        default n
        select RT_USING_POSIX_TERMIOS
        select RT_USING_POSIX_SELECT

    if LPKG_USING_LIBMODBUS_RTU
        config HAVE_DECL_TIOCSRS485
            int
            default 1

        config HAVE_DECL_TIOCM_RTS
            int
            default 1

        config LPKG_USING_LIBMODBUS_RTU_EXAMPLE
            bool "Enable rtu example"
            default n
    endif

    config LPKG_USING_LIBMODBUS_TCP
        bool "Enable libmodbus tcp mode"
        default n
        select RT_USING_SAL             if RT_VER_NUM < 0x40100
        select SAL_USING_POSIX          if RT_VER_NUM < 0x40100
        select RT_USING_POSIX_FS        if RT_VER_NUM >= 0x40100
        select RT_USING_POSIX_SOCKET    if RT_VER_NUM >= 0x40100

    if LPKG_USING_LIBMODBUS_TCP
        config LPKG_USING_LIBMODBUS_TCP_EXAMPLE
            bool "Enable tcp example"
            default n
    endif

    choice
        prompt "Version"
        default LPKG_USING_LIBMODBUS_LATEST_VERSION
        help
            Select the package version

        config LPKG_USING_LIBMODBUS_LATEST_VERSION
            bool "latest"
    endchoice

    config LPKG_LIBMODBUS_VER
       string
       default "v1.0.0"    if LPKG_USING_LIBMODBUS_V100
       default "latest"    if LPKG_USING_LIBMODBUS_LATEST_VERSION

    config PKG_LIBMODBUS_VER_NUM
        hex
        default 0x99999    if LPKG_USING_LIBMODBUS_LATEST_VERSION
        default 0x10000    if LPKG_USING_LIBMODBUS_V100
endif
```

## packages/third-party/llm_chat/Kconfig
```kconfig
menuconfig LPKG_USING_LLMCHAT
    bool "Large Language Models for RT-Thread"
    default n

if LPKG_USING_LLMCHAT

    menuconfig LPKG_LLM_API_KEY_SELECT
        bool "Select LLM API Key"
        default n
        help
            Choose predefined API keys for LLM service

    if LPKG_LLM_API_KEY_SELECT
        choice
            prompt "API Key Options"
            default LPKG_LLM_API_KEY_OPTION1

            config LPKG_LLM_API_KEY_OPTION1
                bool "Deepseek"

            config LPKG_LLM_API_KEY_OPTION2
                bool "DouBao"

            config LPKG_LLM_API_KEY_OPTION3
                bool "Qwen"

            config LPKG_LLM_API_KEY_INPUT
                bool "Input API key"

        endchoice

        if LPKG_LLM_API_KEY_INPUT
            config LPKG_LLM_API_KEY_INPUT_PRIVATE
                string "Input the api Key"
                default ""
                help
                    Enter your API key here
        endif

        config LPKG_LLM_API_KEY
            string
            default "sk-59c5a6f506fa4c01b87f91c983497197"   if LPKG_LLM_API_KEY_OPTION1
            default "e888522a-1771-42c2-b3b5-b6d27d456dc5"  if LPKG_LLM_API_KEY_OPTION2
            default "sk-xheizvzayhbxgqvycgfhfteaqbzndofkvlggvmxflyhxeepl"   if LPKG_LLM_API_KEY_OPTION3
            default LPKG_LLM_API_KEY_INPUT_PRIVATE if LPKG_LLM_API_KEY_INPUT
    endif

    menuconfig LPKG_LLM_MODEL_SELECT
        bool "Select LLM Model"
        default n
        help
            Choose available language models

    if LPKG_LLM_MODEL_SELECT
        choice
            prompt "Model Options"
            default LPKG_LLM_MODEL_OPTION1

            config LPKG_LLM_MODEL_OPTION1
                bool "Deepseek V3"

            config LPKG_LLM_MODEL_OPTION2
                bool "DouBao-1.5 Pro"

            config LPKG_LLM_MODEL_OPTION3
                bool "Qwen2.5"

            config LPKG_LLM_MODEL_INPUT
                bool "Input Model Name"

        endchoice

        if LPKG_LLM_MODEL_INPUT
            config LPKG_LLM_MODEL_INPUT_PRIVATE
                string "Input the model name"
                default ""
                help
                    Enter your model name here
        endif

        config LPKG_LLM_MODEL_NAME
            string
            default "deepseek-chat"              if LPKG_LLM_MODEL_OPTION1
            default "doubao-1-5-pro-256k-250115" if LPKG_LLM_MODEL_OPTION2
            default "Qwen/Qwen2.5-7B-Instruct"   if LPKG_LLM_MODEL_OPTION3
            default LPKG_LLM_MODEL_INPUT_PRIVATE if LPKG_LLM_MODEL_INPUT
    endif

    menuconfig LPKG_LLM_API_URL_SELECT
        bool "Select API Endpoint"
        default n
        help
            Choose API service endpoint

    if LPKG_LLM_API_URL_SELECT
        choice
            prompt "API URL Options"
            default LPKG_LLM_API_URL_OPTION1

            config LPKG_LLM_API_URL_OPTION1
                bool "DeepSeek API URL"

            config LPKG_LLM_API_URL_OPTION2
                bool "DouBao API URL"

            config LPKG_LLM_API_URL_OPTION3
                bool "QWEN API URL"

            config LPKG_LLM_API_URL_INPUT
                bool "Input the api url"

        endchoice

        if LPKG_LLM_API_URL_INPUT
            config LPKG_LLM_API_URL_INPUT_PRIVATE
                string "Input the api url"
                default ""
                help
                    Enter your api url here
        endif

        config LPKG_LLM_DEEPSEEK_API_URL
            string
            default "https://api.deepseek.com/chat/completions" if LPKG_LLM_API_URL_OPTION1
            default "https://ark.cn-beijing.volces.com/api/v3/chat/completions" if LPKG_LLM_API_URL_OPTION2
            default "https://api.siliconflow.cn/v1/chat/completions" if LPKG_LLM_API_URL_OPTION3
            default LPKG_LLM_API_URL_INPUT_PRIVATE if LPKG_LLM_API_URL_INPUT
    endif

    config LPKG_LLM_THREAD_STACK_SIZE
        int "LLM THREAD SIZE"
        default "10240"

    config LPKG_LLM_CMD_BUFFER_SIZE
        int "LLM CMD INPUT BUFFER SIZE"
        default "256"

    config LPKG_WEB_SORKET_BUFSZ
        int "LLM CMD SESSION BUFFER SIZE"
        default "4096"

    config LPKG_LLMCHAT_STREAM
        bool "Enable llmchat http stream"
        default n

    config LPKG_LLMCHAT_DBG
        bool "Enable llmchat debug"
        default n

endif
```

## packages/third-party/micropython-1.13.0/Kconfig
```kconfig
# Kconfig file for package Micropython
menuconfig LPKG_USING_MICROPYTHON
    bool "MCP: Micropython for RT-Thread"
    default n
```

## bsp/peripheral/gyro/Kconfig
```kconfig
choice
    prompt "Select gyro device"
    default AIC_GYRO_SC7A20H
    depends on AIC_USING_GYRO

    config AIC_GYRO_SC7A20H
        bool "SC7A20H"
endchoice

config AIC_GYRO_HPF_ENABLE
    bool "Enable gyro hpf"
    default n
    depends on AIC_USING_GYRO

config AIC_GYRO_FIFO_ENABLE
    bool "Enable gyro fifo"
    default n
    depends on AIC_USING_GYRO

config AIC_GYRO_INT_ENABLE
    bool "Enable gyro int"
    default y
    depends on AIC_USING_GYRO

config AIC_GYRO_I2C_CHAN_NAME
    string "Using I2C channel index"
    default "i2c3"
    depends on AIC_USING_GYRO

config AIC_GYRO_DEBUG_ENABLE
    bool "Enable gyro debug"
    default n
    depends on AIC_USING_GYRO

config AIC_GYRO_X_INVERT
    bool "Gyro x invert"
    default n
    depends on AIC_USING_GYRO

config AIC_GYRO_Y_INVERT
    bool "Gyro y invert"
    default n
    depends on AIC_USING_GYRO

config AIC_GYRO_Z_INVERT
    bool "Gyro z invert"
    default n
    depends on AIC_USING_GYRO

config AIC_GYRO_TILT_THRESHOLD_DEG
    int "Gyro tilt threshold setting"
    default 10
    depends on AIC_USING_GYRO

config AIC_GYRO_STABILITY_CHECK_COUNT
    int "Gyro stability count setting"
    default 3
    depends on AIC_USING_GYRO

config AIC_GYRO_NAME
    string
    default "sc7a20h"  if AIC_GYRO_SC7A20H
    depends on AIC_USING_GYRO
```

## bsp/peripheral/rtc/Kconfig
```kconfig
choice
    prompt "Select RTC Device"
    default AIC_RTC_PCF8563
    depends on AIC_USING_EXTERNAL_RTC

    config AIC_RTC_PCF8563
        bool "PCF8563"

    config AIC_RTC_RX8010
        bool "RX8010"
endchoice

config AIC_RTC_I2C_CHAN
    string "RTC Using I2C channel index"
    default "i2c0"
    depends on AIC_USING_EXTERNAL_RTC
```

## bsp/peripheral/spinor_sfud/Kconfig
```kconfig
# Kconfig file for package ramdisk
menuconfig LPKG_USING_SFUD
    bool "SPINOR Driver SFUD: Serial Flash Universal Driver"
    default n
    help
        An using JEDEC's SFDP standard serial (SPI) flash universal driver library

if LPKG_USING_SFUD
    config SFUD_USING_SECURITY_REGISTER
        bool "SFUD: Using Security Registers"
        default n
        help
            Support read/write/erase security registers for spinor
endif

# only for bootloader, rtos use RT_SFUD_USING_FLASH_INFO_TABLE
if LPKG_USING_SFUD && AIC_BOOTLOADER
    config BOOTLOADER_SFUD_USING_FLASH_INFO_TABLE
        bool "Using defined supported flash chip information table"
        default y
endif
```

## bsp/peripheral/touch/rtp/Kconfig
```kconfig
config AIC_RTP_PERIOD_MS
    int "The sample period of RTP(in cycle mode)"
    range 18 1000
    default 18
    depends on AIC_USING_RTP

config AIC_RTP_MAX_PRESSURE
    int "The pressure threshold of RTP"
    default 800
    depends on AIC_USING_RTP

config AIC_RTP_X_PLATE
    int "The X-plate value of RTP touchscreen"
    default 235
    depends on AIC_USING_RTP

config AIC_RTP_Y_PLATE
    int "The Y-plate value of RTP touchscreen"
    default 665
    depends on AIC_USING_RTP

config AIC_RTP_DELAY
    hex "The precharge delay of RTP"
    range 0 0xffffffff
    default 0x4f00004f
    depends on AIC_USING_RTP

config AIC_TOUCH_PANEL_NAME
    string
    default "aic-rtp"  if AIC_USING_RTP
```

## bsp/peripheral/wireless/atbm603x/Kconfig.dev
```kconfig
#-----------------------------
# atbm603x wlan devices local parameter
#-----------------------------

# wlan0 parameter

menu "Wlan0 Parameter"

    config AIC_DEV_ATBM603X_WLAN0_PWR_GPIO
        string "atbm603x wlan0 power on gpio"

    config AIC_DEV_ATBM603X_WLAN0_RST_GPIO
        string "atbm603x wlan0 reset gpio"

endmenu
```

## kernel/ucos-ii/Kconfig.kernel
```kconfig
menu "uC/OS-II Kernel"

menu "Tasks"

config UCOS_TICKS_PER_SEC
    int "Frequency of the RTOS tick interrupt (Hz)"
    default 500
    ---help---
    The tick interrupt is used to measure time. Therefore a higher tick frequency means time can
    be measured to a higher resolution. However, a high tick frequency also means that the RTOS
    kernel will use more CPU time so be less efficient. The RTOS demo applications all use a tick
    rate of 1000Hz. This is used to test the RTOS kernel and is higher than would normally be
    required.
    More than one task can share the same priority. The RTOS scheduler will share processor time
    between tasks of the same priority by switching between the tasks during each RTOS tick. A high
    tick rate frequency will therefore also have the effect of reducing the 'time slice' given to
    each task.

config UCOS_LOWEST_PRIO
    int "The lowest priority that can be assigned"
    default 63
    range 2 254

config UCOS_MAX_TASKS
    int "Max number of tasks in your application"
    default 62
    range 2 254

config UCOS_MAIN_THREAD_STACK_SIZE
    int "Set main thread stack size (# of OS_STK wide entries) "
    default 1024

config UCOS_MAIN_THREAD_PRIORITY
    int "Set main thread priority"
    default 10

config UCOS_TASK_TMR_STK_SIZE
    int "The timer task stack size (# of OS_STK wide entries) "
    default 512

config UCOS_TASK_STAT_STK_SIZE
    int "The Statistics task stack size (# of OS_STK wide entries) "
    default 512

config UCOS_TASK_IDLE_STK_SIZE
    int "The Idle task stack size (# of OS_STK wide entries) "
    default 128

endmenu

menu "Inter-Task Communication"

config UCOS_MAX_EVENTS
    int "Max number of event control blocks in your application"
    default 10

config UCOS_MAX_FLAGS
    int "Max number of Event Flag Groups in your application"
    default 10

config UCOS_MAX_MEM_PART
    int "Max number of memory partitions"
    default 10

config UCOS_MAX_QS
    int "Max number of queue control blocks in your application"
    default 10

endmenu

endmenu
```

## packages/artinchip/Kconfig
```kconfig
menu "ArtInChip packages options"

source "packages/artinchip/mpp/Kconfig"
source "packages/artinchip/env/Kconfig"
source "packages/artinchip/userid/Kconfig"
source "packages/artinchip/pinmux-check/Kconfig"
source "packages/artinchip/ota/Kconfig"
source "packages/artinchip/burn-in/Kconfig"
source "packages/artinchip/aic-authorization/Kconfig"
source "packages/artinchip/ipmanager/Kconfig"
source "packages/artinchip/barcode/Kconfig"

endmenu
```

## packages/artinchip/aic-authorization/Kconfig
```kconfig
menuconfig LPKG_USING_AIC_AUTHORIZATION
    bool "aic-authorization"
    depends on AIC_CE_DRV
    default n

if LPKG_USING_AIC_AUTHORIZATION

config AIC_AUTHORIZATION_TEST
    bool "aic authorization test"
    depends on LPKG_USING_AIC_AUTHORIZATION
    default n

endif
```

## packages/artinchip/barcode/Kconfig
```kconfig
menuconfig AIC_USING_BARCODE_DEMO
    bool "ArtInChip Barcode Demo"
    default n

if AIC_USING_BARCODE_DEMO
    config AIC_BARCODE_DEMO_LED
        bool "barcode backlight enable"
        default y

    if AIC_BARCODE_DEMO_LED
        config BARCODE_DEMO_LED_GPIO
            string "barcode backlight  pin"
            depends on AIC_BARCODE_DEMO_LED
            default "PA.5"
    endif

    config AIC_BARCODE_JTAG_DEBUG
        bool "barcode jtag debug"
        default y

    config AIC_BARCODE_BEEP
        bool "barcode beep"
        default y

endif
```

## packages/artinchip/burn-in/Kconfig
```kconfig
# Kconfig file for package adbd
menuconfig LPKG_BURN_IN
    bool "burn-in test"
    default n

if LPKG_BURN_IN
    config LPKG_BURN_IN_PLAYER_ENABLE
        bool "test player"
        default n
        depends on AIC_MPP_PLAYER_INTERFACE
    if LPKG_BURN_IN_PLAYER_ENABLE
        config LPKG_BURN_IN_PLAYER_LOOP
            int "set play file/dir loop num"
            default 10000000
        config LPKG_BURN_IN_PLAYER_LOG_TO_SERIAL
            bool "output log to serial interface"
            default y
    endif
endif
```

## packages/artinchip/ipmanager/Kconfig
```kconfig
menuconfig AIC_USING_IPMANAGER
    bool "ArtInChip IP manager for Ethernet"
    default n
    select LPKG_USING_LWIP
    select LPKG_LWIP_DHCP
    select LPKG_USING_CJSON

    if AIC_USING_IPMANAGER

        config AIC_IPMANAGER_SAVE_FILE
            string "IP manager configure file"
            default "/data/ipconfig.cfg"

    endif
```

## packages/artinchip/uds/Kconfig
```kconfig
config AIC_UDS_INTERFACE
    bool "Enable UDS interface"
    default n
    depends on AIC_CAN_DRV
```

## packages/artinchip/userid/Kconfig
```kconfig
menuconfig LPKG_USING_USERID
    bool "aic-userid"
    default n

if LPKG_USING_USERID
choice
	prompt "Location of UserID"
config USERID_IN_SPINAND
	bool "UserID in SPINAND"
	help
	  Define this if you have a NAND device which you want to use for the
	  ArtInChip UserID.

	  - CONFIG_USERID_OFFSET:
	  - CONFIG_USERID_SIZE:

	  These two #defines specify the offset and size of the userid
	  area within the first NAND device.  CONFIG_USERID_OFFSET must be
	  aligned to an erase block boundary.

config USERID_IN_SPINOR
	bool "UserID in SPINOR"
	help
	  Define this if you have a SPINOR device which you want to use for the
	  ArtInChip UserID.

	  - CONFIG_USERID_OFFSET:
	  - CONFIG_USERID_SIZE:

	  These two #defines specify the offset and size of the userid
	  area within the first SPINOR device.  CONFIG_USERID_OFFSET must be
	  aligned to an erase block boundary.

config USERID_IN_MMC
	bool "UserID in MMC"
	help
	  Define this if you have a MMC device which you want to use for the
	  ArtInChip UserID.

	  - CONFIG_USERID_OFFSET:
	  - CONFIG_USERID_SIZE:

	  These two #defines specify the offset and size of the userid
	  area within the first MMC device.  CONFIG_USERID_OFFSET must be
	  aligned to an block boundary.
endchoice

config USERID_PARTITION_NAME
	string "UserID partition name"
	default "userid"
	help
	   partition name which used to save userid

endif
```

## packages/third-party/Kconfig
```kconfig
menu "Third-party packages options"

source "packages/third-party/bonnie/Kconfig"
source "packages/third-party/cpu_usage/Kconfig"
source "packages/third-party/ramdisk/Kconfig"
source "packages/third-party/cherryusb/Kconfig"
source "packages/third-party/adbd/Kconfig"
source "packages/third-party/awtk-ui/Kconfig"
source "packages/third-party/lwip/Kconfig"
source "packages/third-party/littlefs/Kconfig"
source "packages/third-party/benchmark/Kconfig"
source "packages/third-party/FreeRTOS-Wrapper/Kconfig"
source "packages/third-party/i2c-tools/Kconfig"
source "packages/third-party/beep/Kconfig"
source "packages/third-party/memleak/Kconfig"
source "packages/third-party/webclient/Kconfig"
source "packages/third-party/ota_downloader/Kconfig"
source "packages/third-party/protobuf-c/Kconfig"
source "packages/third-party/freetype/Kconfig"
source "packages/third-party/rtt_auto_exe_cmd/Kconfig"
source "packages/third-party/netutils/Kconfig"
source "packages/third-party/libmodbus/Kconfig"
source "packages/third-party/ptpd/Kconfig"
source "packages/third-party/cJSON-1.7.16/Kconfig"
source "packages/third-party/mbedtls/Kconfig"
source "packages/third-party/at24cxx/Kconfig"
source "packages/third-party/zlib/Kconfig"
source "packages/third-party/sqlite/Kconfig"
# for baremetal mode
source "packages/third-party/dfs/Kconfig"
source "packages/third-party/minimp3/Kconfig"
source "packages/third-party/libFLAC/Kconfig"
source "packages/third-party/ffmpeg/Kconfig"
source "packages/third-party/fdtlib/Kconfig"
source "packages/third-party/gif/Kconfig"
source "packages/third-party/micropython-1.13.0/Kconfig"

endmenu
```

## packages/third-party/at24cxx/Kconfig
```kconfig
# Kconfig file for package at24cxx
menuconfig LPKG_USING_AT24CXX
    bool "at24cxx: eeprom at24cxx driver library."
    default n

if LPKG_USING_AT24CXX

    config LPKG_AT24CXX_PATH
        string
        default "/packages/third-party/at24cxx"

    choice
        prompt "Version"
        default LPKG_USING_AT24CXX_LATEST_VERSION
        help
            Select the package version

        config LPKG_USING_AT24CXX_LATEST_VERSION
            bool "latest"
    endchoice

    config LPKG_AT24CXX_VER
       string
       default "latest"    if LPKG_USING_AT24CXX_LATEST_VERSION

endif
```

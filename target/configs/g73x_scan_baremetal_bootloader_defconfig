## target/configs/g73x_scan_baremetal_bootloader_defconfig
```kconfig
CONFIG_PRJ_DEFCONFIG_FILENAME="g73x_scan_baremetal_bootloader_defconfig"
CONFIG_PRJ_CHIP="g73x"
CONFIG_PRJ_BOARD="scan"
CONFIG_PRJ_KERNEL="baremetal"
CONFIG_PRJ_APP="bootloader"
CONFIG_PRJ_CUSTOM_LDS="application/baremetal/bootloader/ldscript/g73x_bootloader_gcc.ld"
CONFIG_AIC_USING_UART0=y
CONFIG_AIC_USING_QSPI0=y
CONFIG_AIC_QSPI0_DEVICE_SPINOR=y
CONFIG_AIC_DISP_MIPI_DBI=y
CONFIG_AICFB_RGB565=y
CONFIG_AIC_PANEL_DBI_ILI9341=y
CONFIG_AIC_PANEL_ENABLE_GPIO="PE.13"
# CONFIG_AIC_USING_GE is not set
# CONFIG_AIC_USING_VE is not set
CONFIG_AIC_USING_DMA=y
CONFIG_AIC_USING_WRI=y
CONFIG_AIC_USING_RTC=y
CONFIG_AIC_USING_WDT=y
CONFIG_AIC_BOOTLOADER_RESERVE_SIZE=0x0
CONFIG_AIC_PSRAM_SIZE=0x400000
CONFIG_AIC_PSRAM_SW_SIZE=0x0
CONFIG_AIC_INTERRUPTSTACK_SIZE=8192
CONFIG_AIC_USING_SID=y
CONFIG_AIC_SYSCFG_SIP_FLASH_ENABLE=y
CONFIG_AIC_NORMALSTACK_SIZE=8192
CONFIG_AIC_BOOTLOADER_TEXT_SIZE=0x7FF00
CONFIG_AIC_BOOTLOADER_HEAP_SIZE=0x80000
CONFIG_AIC_BOOTLOADER_MMC_SUPPORT=y
# CONFIG_AIC_BOOTLOADER_SPINAND_SUPPORT is not set
CONFIG_AIC_BOOTLOADER_PSRAM_EN=y
CONFIG_AIC_BOOTLOADER_FATFS_SUPPORT=y
CONFIG_AICUPG_UART_ENABLE=y
CONFIG_AICUPG_MMC_ARTINCHIP=y
CONFIG_AICUPG_NOR_ARTINCHIP=y
CONFIG_AICUPG_LOG_BUFFER_ADDR=0x30040000
CONFIG_AICUPG_LOG_BUFFER_SIZE=0x3000
CONFIG_AIC_BOOTLOADER_CMD_NOR_BOOT=y
CONFIG_AIC_BOOTLOADER_CMD_SPI_NOR=y
CONFIG_AIC_BOOTLOADER_CMD_MTD=y
CONFIG_AIC_BOOTLOADER_CMD_PART=y
CONFIG_AIC_BOOTLOADER_CMD_PROGRESS_BAR=y
CONFIG_AIC_BOOTLOADER_CMD_FB_CONSOLE=y
CONFIG_LPKG_CHERRYUSB_DEVICE_CLASS_AIC_SINGLE=y
CONFIG_LPKG_CHERRYUSB_HOST=y
CONFIG_LPKG_CHERRYUSB_HOST_MSC=y
CONFIG_LPKG_CHERRYUSB_HOST_AICUPG_FOR_UDISK=y
# CONFIG_LPKG_MPP is not set
# CONFIG_LPKG_USING_ENV is not set
CONFIG_LPKG_USING_SFUD=y
CONFIG_AIC_SPINOR_DRV_TEST=y
CONFIG_AIC_MTD_BARE_TEST=y
```

## target/configs/g73x_scan_rt-thread_helloworld_defconfig
```kconfig
CONFIG_PRJ_DEFCONFIG_FILENAME="g73x_scan_rt-thread_helloworld_defconfig"
CONFIG_PRJ_CHIP="g73x"
CONFIG_PRJ_BOARD="scan"
CONFIG_PRJ_KERNEL="rt-thread"
CONFIG_PRJ_APP="helloworld"
CONFIG_AIC_USING_FS_IMAGE_1=y
CONFIG_AIC_FS_IMAGE_DIR_1="packages/artinchip/barcode/resource/"
CONFIG_AIC_FS_IMAGE_NAME_1="data.lfs"
CONFIG_AIC_LITTLEFS_PAGE_SIZE_FOR_1=32
CONFIG_AIC_USING_UART0=y
CONFIG_AIC_USING_I2C2=y
CONFIG_AIC_USING_PWM1=y
CONFIG_AIC_USING_USB0=y
CONFIG_AIC_USING_QSPI0=y
CONFIG_AIC_QSPI0_DEVICE_SPINOR=y
CONFIG_AIC_DISP_MIPI_DBI=y
CONFIG_AICFB_RGB565=y
CONFIG_AIC_PANEL_DBI_ST7789=y
CONFIG_ST7789_V3=y
CONFIG_AIC_PANEL_ENABLE_GPIO="PD.20"
CONFIG_AIC_GE_CMDQ=y
CONFIG_AIC_USING_DVP=y
CONFIG_AIC_USING_DMA=y
CONFIG_AIC_USING_WRI=y
CONFIG_AIC_USING_RTC=y
CONFIG_AIC_USING_WDT=y
CONFIG_AIC_BOOTLOADER_RESERVE_SIZE=0x0
CONFIG_AIC_PSRAM_SIZE=0x400000
CONFIG_AIC_PSRAM_SW_SIZE=0x0
CONFIG_AIC_SEC_TEXT_PSRAM=y
CONFIG_AIC_SEC_RODATA_PSRAM=y
CONFIG_AIC_SEC_BSS_SRAM_S0=y
CONFIG_AIC_INTERRUPTSTACK_SIZE=4096
CONFIG_AIC_CLK_PLL_FRA0_FREQ=792000000
CONFIG_AIC_CLK_PLL_FRA2_FREQ=1188000000
CONFIG_AIC_USING_CLK_OUT1=y
CONFIG_AIC_USING_SID=y
CONFIG_AIC_SYSCFG_SIP_FLASH_ENABLE=y
CONFIG_IDLE_THREAD_STACK_SIZE=1024
# CONFIG_RT_KSERVICE_USING_STDLIB is not set
# CONFIG_RT_DEBUG is not set
CONFIG_RT_USING_MEMHEAP_AS_HEAP=y
# CONFIG_RT_USING_MEMHEAP_AUTO_BINDING is not set
CONFIG_RT_USING_MEMTRACE=y
CONFIG_RT_CONSOLE_DEVICE_NAME="uart0"
CONFIG_RT_USING_LEGACY=y
CONFIG_FINSH_HISTORY_LINES=1
CONFIG_DFS_FILESYSTEMS_MAX=8
CONFIG_RT_USING_DFS_MNTTABLE=y
CONFIG_RT_USING_DFS_ELMFAT=y
CONFIG_RT_DFS_ELM_USE_EXFAT=y
CONFIG_RT_DFS_ELM_MAX_SECTOR_SIZE=4096
CONFIG_RT_USING_DFS_ROMFS=y
CONFIG_RT_USING_FAL=y
# CONFIG_FAL_DEBUG_CONFIG is not set
CONFIG_FAL_USING_SFUD_PORT=y
# CONFIG_FAL_BLK_DEVICE_RDONLY is not set
CONFIG_RT_USING_ADC=y
CONFIG_RT_USING_PM=y
CONFIG_PM_USING_CUSTOM_CONFIG=y
CONFIG_PM_ENABLE_SUSPEND_SLEEP_MODE=y
CONFIG_PM_ENABLE_THRESHOLD_SLEEP_MODE=y
CONFIG_RT_MMCSD_STACK_SIZE=8192
CONFIG_RT_SFUD_USING_QSPI=y
CONFIG_RT_USING_AUDIO=y
CONFIG_RT_USING_SENSOR=y
CONFIG_RT_USING_TOUCH=y
CONFIG_RT_TOUCH_PIN_IRQ=y
CONFIG_RT_USING_POSIX_CLOCK=y
CONFIG_RT_USING_ULOG=y
CONFIG_ULOG_OUTPUT_LVL_I=y
CONFIG_ULOG_TIME_USING_TIMESTAMP=y
CONFIG_ULOG_USING_FILTER=y
CONFIG_LPKG_USING_CPU_USAGE=y
CONFIG_LPKG_USING_CHERRYUSB=y
CONFIG_LPKG_CHERRYUSB_DEVICE=y
CONFIG_LPKG_CHERRYUSB_DEVICE_HID=y
CONFIG_LPKG_CHERRYUSB_DEVICE_HID_KEYBOARD_TEMPLATE=y
CONFIG_LPKG_USING_LITTLEFS=y
# CONFIG_LPKG_USING_FDTLIB is not set
CONFIG_AIC_MPP_VIN=y
CONFIG_AIC_MPP_FB_TEST=y
# CONFIG_LPKG_USING_ENV is not set
CONFIG_LPKG_USING_PINMUX_CHECHK=y
CONFIG_AIC_PINMUX_CHECK=y
CONFIG_AIC_USING_BARCODE_DEMO=y
# CONFIG_AIC_BARCODE_JTAG_DEBUG is not set
CONFIG_AIC_GPIO_IRQ_DRV_EN=y
CONFIG_AIC_USING_CAMERA=y
CONFIG_AIC_USING_CAMERA_SC035HGS=y
CONFIG_AIC_CAMERA_I2C_CHAN=2
CONFIG_AIC_CAMERA_RST_PIN="PD.9"
CONFIG_AIC_CAMERA_PWDN_PIN="PD.10"
CONFIG_AIC_CAMERA_DRV_TEST=y
```

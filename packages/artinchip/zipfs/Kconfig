## packages/artinchip/zipfs/Kconfig
```kconfig
# Kconfig file for package zipfs
menuconfig LPKG_USING_ZIPFS
    bool "zipfs: A file system for zip file"
    select LPKG_USING_MINIZ
    default n
    depends on PRJ_KERNEL="rt-thread"

if LPKG_USING_ZIPFS

    config LPKG_ZIPFS_DEMO
        bool "Enable zipfs demo"
        default n

endif
```

## packages/third-party/cpu_load/Kconfig
```kconfig
# Kconfig file for package cpu_load
config LPKG_USING_CPU_LOAD
    bool "CPU_LOAD: Rt-Thread CPU usage statistics tool for thread."
    default n
```

## packages/third-party/fdtlib/Kconfig
```kconfig
# Kconfig file for package FDTLIB
menuconfig LPKG_USING_FDTLIB
    bool "fdtlib: fdt parse lib"
    default y


if LPKG_USING_FDTLIB
config LPKG_USING_FDTLIB_CRC32_VERIFY
    bool "enable payload crc32 verification"
    default y
endif # LPKG_USING_FDTLIB
```

## packages/third-party/libopus/Kconfig
```kconfig
menuconfig PKG_USING_LIBOPUS
    bool "Enable libopus"
    default n


if PKG_USING_LIBOPUS

config LPKG_USING_LIBOPUS_STATIC
    bool "Build libopus as static library (.a)"
    default y
    depends on PKG_USING_LIBOPUS
    help
        Build libopus into a standalone static library (libOPUS.a) under
        packages/third-party/libopus/, then link it into the final image.

config LPKG_USING_LIBOPUS_PREBUILT
    bool "Use prebuilt libOPUS.a (do not compile libopus sources)"
    default y
    depends on PKG_USING_LIBOPUS && LPKG_USING_LIBOPUS_STATIC
    help
        Link existing packages/third-party/libopus/libOPUS.a directly.
        In this mode, SCons will not compile libopus source files.

endif # PKG_USING_LIBOPUS
```

## packages/third-party/marc_chacha20/Kconfig
```kconfig
# Kconfig file for package marc_chacha20
config LPKG_USING_MARC_CHACHA20
    bool "ChaCha20 Encryption Algorithm."
    default n
```

## packages/third-party/mhz/Kconfig
```kconfig
menuconfig LPKG_USING_MHZ
    bool "mhz: calculate clock rate and megahertz"
    default n
```

## packages/third-party/miniz/Kconfig
```kconfig
# Kconfig file for package miniz
menuconfig LPKG_USING_MINIZ
    bool "miniz: data compression library."
    default n

if LPKG_USING_MINIZ

    config LPKG_MINIZ_DEMO
       bool "Enable miniz demo."
       default n

endif
```

## packages/third-party/pahomqtt/Kconfig
```kconfig
menuconfig LPKG_USING_PAHOMQTT
    bool "Paho MQTT: Eclipse Paho MQTT C/C++ client for Embedded platforms"
    default n

if LPKG_USING_PAHOMQTT

    choice
        prompt "MQTT mode"
        help
            Select the MQTT Implementation

        config LPKG_PAHOMQTT_PIPE_MODE
            bool "Pipe mode: high performance and depends on DFS"
            select RT_USING_DEVICE_IPC
            #select RT_USING_SAL             if RT_VER_NUM < 0x40100
            #select SAL_USING_POSIX          if RT_VER_NUM < 0x40100
            select RT_USING_POSIX_FS        if RT_VER_NUM >= 0x40100
            select RT_USING_POSIX_SOCKET    if RT_VER_NUM >= 0x40100
            select RT_USING_POSIX_PIPE      if RT_VER_NUM >= 0x40100

        config LPKG_PAHOMQTT_UDP_MODE
            bool "UDP mode: small footprint, need net supported loopback"
            select RT_LWIP_NETIF_LOOPBACK
    endchoice

    config LPKG_USING_PAHOMQTT_EXAMPLE
        bool "Enable MQTT example"
        default n

    config LPKG_USING_PAHOMQTT_TEST
        bool "Enable MQTT test"
        default n

    config MQTT_USING_TLS
        bool "Enable support tls protocol"
        default n
        select LPKG_USING_MBEDTLS

    config RT_LPKG_MQTT_THREAD_STACK_SIZE
        int "Set MQTT thread stack size"
        default 4096

    config LPKG_PAHOMQTT_SUBSCRIBE_HANDLERS
        int "Max pahomqtt subscribe topic handlers"
        default 1
        help
            Max pahomqtt subscribe topic handlers

    config MQTT_DEBUG
        bool "Enable debug log output"
        default y

    config LPKG_PAHOMQTT_PATH
        string
        default "/packages/iot/pahomqtt"

    choice
        prompt "version"
        help
            Select the pahomqtt version
        default LPKG_USING_PAHOMQTT_V110 if RT_VER_NUM  < 0x40100
        default LPKG_USING_PAHOMQTT_LATEST if RT_VER_NUM >= 0x40100

        config LPKG_USING_PAHOMQTT_V110
            bool "v1.1.0" if RT_VER_NUM < 0x40100

        config LPKG_USING_PAHOMQTT_V100
            bool "v1.0.0" if RT_VER_NUM < 0x40100

        ### Notice, the posix/libc had changed the structure of folder since RT-Thread V4.1.0.
        ### if the pahomqtt will release new tag, should add it here.
        if RT_VER_NUM >= 0x40100
            config LPKG_USING_PAHOMQTT_LATEST
                bool "latest"
        endif
    endchoice

    config LPKG_PAHOMQTT_VER
       string
       default "v1.1.0"    if LPKG_USING_PAHOMQTT_V110
       default "v1.0.0"    if LPKG_USING_PAHOMQTT_V100
       default "latest"    if LPKG_USING_PAHOMQTT_LATEST

endif
```

## packages/third-party/zephyr-bluetooth/Kconfig
```kconfig
# Kconfig file for package zephyr-bluetooth
menuconfig LPKG_USING_ZEPHYR_BLUETOOTH
    bool "zephyr-bluetooth: Bluetooth Stack"
    select RT_USING_MESSAGEQUEUE
    depends on !SMP
    select LPKG_NET_BUF
    default n
    help
        This option enables Bluetooth support.

if LPKG_USING_ZEPHYR_BLUETOOTH

    menu "General Kernel Options"

        config MULTITHREADING
            bool "Multi-threading"
            default y

        config NUM_PREEMPT_PRIORITIES
            int "Number of preemptible priorities" if MULTITHREADING
            default 0 if !MULTITHREADING
            default 15
            range 0 128

        config NUM_COOP_PRIORITIES
            int "Number of coop priorities" if MULTITHREADING
            default 1 if !MULTITHREADING
            default 16
            range 0 128

        config LPKG_ATOMIC_OPERATIONS_BUILTIN
            bool "ATOMIC OPERATIONS BUILTIN"
            default y

        config LPKG_RISCV
            bool "RISCV"
            default y

        config LPKG_LITTLE_ENDIAN
            bool "LITTLE ENDIAN"
            default y

        source "packages/third-party/zephyr-bluetooth/modules/libsbc/Kconfig"
        source "packages/third-party/zephyr-bluetooth/lib/net_buf/Kconfig"

    endmenu

    choice
        prompt "Select ChipSet"
        default LPKG_ZEPHYR_BLUETOOTH_CHIPSET_RTL8733
        help
            select the zephyr_polling chipset

        config LPKG_ZEPHYR_BLUETOOTH_CHIPSET_RTL8733
            bool "RTL8733"

        config LPKG_ZEPHYR_BLUETOOTH_CHIPSET_AIC8800D40
            bool "AIC8800D40"

    endchoice

    config LPKG_ZEPHYR_BLUETOOTH_CHIPSET
        string
        default "rtl8733"    if LPKG_ZEPHYR_BLUETOOTH_CHIPSET_RTL8733
        default "aic8800d40"    if LPKG_ZEPHYR_BLUETOOTH_CHIPSET_AIC8800D40

    menu "Bluetooth HCI Driver Options"
        config LPKG_BT_UART
            string "The uart device name"
            default "uart7"

        config LPKG_BT_H4
            bool "H:4 UART"
            default y
            help
                Bluetooth H:4 UART driver. Requires hardware flow control
                lines to be available.

        config LPKG_BT_H5
            bool "H:5 UART [EXPERIMENTAL]"
            select EXPERIMENTAL
            default y
            help
                Bluetooth three-wire (H:5) UART driver. Implementation of HCI
                Three-Wire UART Transport Layer.

        config LPKG_BT_HCI_SETUP
            bool "BT HCI SETUP"
            default y
            help
                Enable the HCI vendor-specific Setup function.

        config LPKG_BT_DRV_TX_STACK_SIZE
            int "BT DRV TX STACK SIZE"
            default 256
            help
                Stack size for the HCI driver's TX thread.

        config LPKG_BT_DRV_RX_STACK_SIZE
            int "BT DRV RX STACK SIZE"
        	default 640 if (LPKG_BT_SPI || LPKG_BT_AMBIQ_HCI)
        	default LPKG_BT_RX_STACK_SIZE if (LPKG_BT_H4 || LPKG_BT_HCI_RAW_H4)
        	default 512
        	help
        	  Stack size for the HCI driver's RX thread.
    endmenu

    source "packages/third-party/zephyr-bluetooth/subsys/bluetooth/Kconfig"

    choice
        prompt "Bluetooth Samples"
        default LPKG_ZEPHYR_BLUETOOTH_SAMPLE_DISABLE
        help
            select the NimBLE samples

        config LPKG_ZEPHYR_BLUETOOTH_SAMPLE_DISABLE
            bool "Not enable sample"

        config LPKG_ZEPHYR_BLUETOOTH_SAMPLE_A2DP_SINK
            bool "A2DP sink demo"
            select AIC_AUDIO_DRV

        config LPKG_ZEPHYR_BLUETOOTH_SAMPLE_PERIPHERAL_HR
            bool "BLE peripheral heartrate demo"
            select AIC_AUDIO_DRV

        config LPKG_ZEPHYR_BLUETOOTH_SAMPLE_BEACON
            bool "BLE beacon"

        config LPKG_ZEPHYR_BLUETOOTH_SAMPLE_BROADCASTER
            bool "BLE broadcaster"

        config LPKG_ZEPHYR_BLUETOOTH_SAMPLE_CENTRAL
            bool "BLE central"

    endchoice

    if LPKG_ZEPHYR_BLUETOOTH_SAMPLE_A2DP_SINK
        source "packages/third-party/zephyr-bluetooth/samples/bluetooth/classic/a2dp_sink/Kconfig"
    endif

    choice
        prompt "Zephyr bluetooth log level"
        default LPKG_ZEPHYR_BLUETOOTH_DEBUG_LEVEL_INFO
        help
            select the ZEPHYR_BLUETOOTH log level

        config LPKG_ZEPHYR_BLUETOOTH_DEBUG_LEVEL_NONE
            bool "none"

        config LPKG_ZEPHYR_BLUETOOTH_DEBUG_LEVEL_ERR
            bool "error"

        config LPKG_ZEPHYR_BLUETOOTH_DEBUG_LEVEL_WARN
            bool "warn"

        config LPKG_ZEPHYR_BLUETOOTH_DEBUG_LEVEL_INFO
            bool "info"

        config LPKG_ZEPHYR_BLUETOOTH_DEBUG_LEVEL_DEBUG
            bool "debug"

    endchoice

    config LPKG_ZEPHYR_BLUETOOTH_DEBUG_LEVEL
        int
        default 0 if LPKG_ZEPHYR_BLUETOOTH_DEBUG_LEVEL_NONE
        default 3 if LPKG_ZEPHYR_BLUETOOTH_DEBUG_LEVEL_ERR
        default 4 if LPKG_ZEPHYR_BLUETOOTH_DEBUG_LEVEL_WARN
        default 6 if LPKG_ZEPHYR_BLUETOOTH_DEBUG_LEVEL_INFO
        default 7 if LPKG_ZEPHYR_BLUETOOTH_DEBUG_LEVEL_DEBUG

    choice
        prompt "Version"
        default LPKG_USING_ZEPHYR_BLUETOOTH_V440
        help
            Select the package version

        config LPKG_USING_ZEPHYR_BLUETOOTH_V440
            bool "v4.4.0"

        config LPKG_USING_ZEPHYR_BLUETOOTH_LATEST_VERSION
            bool "latest"
    endchoice

    config LPKG_ZEPHYR_BLUETOOTH_VER
       string
       default "v4.4.0"    if LPKG_USING_ZEPHYR_BLUETOOTH_V440
       default "latest"    if LPKG_USING_ZEPHYR_BLUETOOTH_LATEST_VERSION

endif
```

## packages/third-party/zephyr-bluetooth/modules/libsbc/Kconfig
```kconfig
# Copyright (c) 2024 NXP
# SPDX-License-Identifier: Apache-2.0

config LPKG_LIBSBC
	bool "libsbc Support"
	help
	  This option enables Low Complexity Subband Codec (SBC)
```

## packages/third-party/zephyr-bluetooth/samples/bluetooth/cap_acceptor/Kconfig
```kconfig
# Copyright (c) 2022-2025 Nordic Semiconductor ASA
# SPDX-License-Identifier: Apache-2.0

mainmenu "Bluetooth: Common Audio Profile Acceptor sample"

config SAMPLE_UNICAST
	bool "Whether or not advertise connectable support for unicast audio"
	default y
	select LPKG_BT_BAP_UNICAST_SERVER
	select LPKG_BT_ISO_PERIPHERAL
	select LPKG_BT_ASCS
	select LPKG_BT_PAC_SNK
	select LPKG_BT_PAC_SNK_LOC
	select LPKG_BT_PAC_SRC
	select LPKG_BT_PAC_SRC_LOC
	select LPKG_BT_CTLR_PERIPHERAL_ISO if HAS_BT_CTLR
	help
	  If set to true, the sample will start advertising connectable for
	  Broadcast Assistants.

config SAMPLE_BROADCAST
	bool "Whether or not advertise connectable support for broadcast audio"
	default y if !SAMPLE_UNICAST
	select LPKG_BT_BAP_SCAN_DELEGATOR
	select LPKG_BT_OBSERVER
	select LPKG_BT_ISO_SYNC_RECEIVER
	select LPKG_BT_BAP_BROADCAST_SINK
	select LPKG_BT_PAC_SNK
	select LPKG_BT_PAC_SNK_LOC
	select LPKG_BT_PER_ADV_SYNC_TRANSFER_RECEIVER if (!HAS_BT_CTLR || \
						     LPKG_BT_CTLR_SYNC_TRANSFER_RECEIVER_SUPPORT)
	select LPKG_BT_CTLR_SYNC_ISO if HAS_BT_CTLR
	help
	  If set to true, the sample will start advertising syncable audio streams

config SAMPLE_SCAN_SELF
	bool "Whether to scan for Broadcast Sources without Broadcast Assistant"
	depends on SAMPLE_BROADCAST
	help
	  If set to true, the sample will start scanning for Broadcast Sources
	  without waiting for a Broadcast Assistant to connect.

config SAMPLE_TARGET_BROADCAST_NAME
	string "Target Broadcast Device Name when self-scanning"
	default ""
	help
	  Name of target broadcast device. If not empty string, sink device
	  will only listen to the specified broadcast source. Not case sensitive.

source "Kconfig.zephyr"
```

## packages/third-party/zephyr-bluetooth/samples/bluetooth/cap_initiator/Kconfig
```kconfig
# Copyright (c) 2024 Nordic Semiconductor ASA
# SPDX-License-Identifier: Apache-2.0

mainmenu "Bluetooth: Common Audio Profile initiator sample"

config SAMPLE_UNICAST
	bool "Whether or not to search for CAP acceptors for unicast audio"
	default y
	select LPKG_BT_CENTRAL
	select LPKG_BT_GATT_CLIENT
	select LPKG_BT_GATT_AUTO_DISCOVER_CCC
	select LPKG_BT_GATT_AUTO_UPDATE_MTU
	select LPKG_BT_ISO_CENTRAL
	select LPKG_BT_SMP
	select LPKG_BT_KEYS_OVERWRITE_OLDEST
	select LPKG_BT_CSIP_SET_COORDINATOR
	select LPKG_BT_BAP_UNICAST_CLIENT
	select LPKG_BT_CTLR_CENTRAL_ISO if HAS_BT_CTLR
	help
	  If set to true, the sample will start advertising connectable for
	  Broadcast Assistants.

config SAMPLE_BROADCAST
	bool "Whether or not to search for CAP acceptors for broadcast audio"
	default y if !SAMPLE_UNICAST
	select LPKG_BT_BROADCASTER
	select LPKG_BT_ISO_BROADCASTER
	select LPKG_BT_BAP_BROADCAST_SOURCE
	select LPKG_BT_CTLR_ADV_ISO if HAS_BT_CTLR
	help
	  If set to true, the sample will start advertising syncable audio streams

config STATIC_BROADCAST_ID
	bool "Use static broadcast ID"
	default y
	help
	   Enabling this option will make the application use static broadcast ID, as opposed to a
	   randomly generated one.

config BROADCAST_ID
	hex "The static broadcast ID to use"
	range 0x000000 0xFFFFFF
	depends on STATIC_BROADCAST_ID
	help
	   This is the 3-octet broadcast ID advertised if static broadcast IDs are enabled.

source "Kconfig.zephyr"
```

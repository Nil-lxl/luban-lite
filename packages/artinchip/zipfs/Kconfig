## packages/third-party/zephyr-bluetooth/subsys/bluetooth/audio/Kconfig.tbs
```kconfig
# Bluetooth Audio - Call control configuration options
#
# Copyright (c) 2020 Bose Corporation
# Copyright (c) 2024-2026 Nordic Semiconductor ASA
#
# SPDX-License-Identifier: Apache-2.0
#

if LPKG_BT_AUDIO

#####################  Telephone Bearer Service #####################

config LPKG_BT_TBS
	bool "Telephone Bearer Service Support"
	depends on LPKG_BT_GATT_DYNAMIC_DB
	depends on LPKG_BT_SMP
	help
	  This option enables support for Telephone Bearer Service. By default this only
	  initializes the GTBS service. If specific TBS services are wanted, they need to be
	  enabled by setting LPKG_BT_TBS_BEARER_COUNT to a non-zero value.

if LPKG_BT_TBS

config LPKG_BT_TBS_MAX_CALLS
	int "Telephone Bearer Service Maximum Number Of Calls Supported"
	default 3
	range 1 16
	help
	  Sets the maximum number of calls the service supports per bearer.

config LPKG_BT_TBS_BEARER_COUNT
	int "How many bearer instances the device instantiates"
	default 0
	range 0 255
	help
	  Sets the number of TBS instances that are instantiated

config LPKG_BT_TBS_MAX_SCHEME_LIST_LENGTH
	int "The maximum length of the URI scheme list"
	default 30
	range 0 512
	help
	  Sets the maximum length of the URI scheme list.

config LPKG_BT_TBS_LOCK_TIMEOUT
	int "Milliseconds of timeout when handling concurrent operations"
	range 0 1000
	default 10
	help
	  The number of milliseconds that the TBS implementation will maximum wait before rejecting
	  an write request if another is already in progress in another thread.

endif # LPKG_BT_TBS


##################### Call Control Client #####################

config LPKG_BT_TBS_CLIENT_GTBS
	bool "Generic Telephone Bearer Service client support"
	depends on LPKG_BT_GATT_CLIENT
	depends on LPKG_BT_GATT_AUTO_DISCOVER_CCC
	depends on LPKG_BT_SMP
	help
	  This option enables support for the GTBS-oriented Call Control client.

config LPKG_BT_TBS_CLIENT_TBS
	bool "Telephone Bearer Service client support"
	depends on LPKG_BT_GATT_CLIENT
	depends on LPKG_BT_GATT_AUTO_DISCOVER_CCC
	depends on LPKG_BT_SMP
	help
	  This option enables support for the TBS-oriented Call Control client.

config LPKG_BT_TBS_CLIENT
	bool
	default y if (LPKG_BT_TBS_CLIENT_GTBS || LPKG_BT_TBS_CLIENT_TBS)

if LPKG_BT_TBS_CLIENT

config LPKG_BT_TBS_CLIENT_MAX_CALLS
	int "Maximum Number Of Calls Supported"
	default 1
	help
	  Sets the maximum number of calls the client supports per TBS instance.

config LPKG_BT_TBS_CLIENT_MAX_TBS_INSTANCES
	int "Maximum number of TBS instances to setup"
	depends on LPKG_BT_TBS_CLIENT_TBS
	default 1
	range 1 3
	help
	  Sets the maximum number of Telephone Bearer Service (TBS)
	  instances to setup and use.

config LPKG_BT_TBS_CLIENT_MINIMAL
	bool "Minimal TBS Client without optional procedures"
	default n
	help
	  This option disables all optional procedures in the TBS Client.

config LPKG_BT_TBS_CLIENT_BEARER_PROVIDER_NAME
	bool "Support reading Bearer Provider Name"
	default !LPKG_BT_TBS_CLIENT_MINIMAL
	help
	  This option enables support for reading Bearer Provider Name.

config LPKG_BT_TBS_CLIENT_BEARER_UCI
	bool "Support reading Bearer UCI"
	default !LPKG_BT_TBS_CLIENT_MINIMAL
	help
	  This option enables support for reading Bearer UCI.

config LPKG_BT_TBS_CLIENT_BEARER_TECHNOLOGY
	bool "Support reading Bearer Technology"
	default !LPKG_BT_TBS_CLIENT_MINIMAL
	help
	  This option enables support for reading Bearer Technology.

config LPKG_BT_TBS_CLIENT_BEARER_URI_SCHEMES_SUPPORTED_LIST
	bool "Support reading Bearer URI Schemes Supported List"
	default !LPKG_BT_TBS_CLIENT_MINIMAL
	help
	  This option enables support for reading Bearer URI Schemes Supported
	  List.

config LPKG_BT_TBS_CLIENT_BEARER_SIGNAL_STRENGTH
	bool "Support reading Bearer Signal Strength"
	default !LPKG_BT_TBS_CLIENT_MINIMAL
	help
	  This option enables support for reading Bearer Signal Strength.

config LPKG_BT_TBS_CLIENT_READ_BEARER_SIGNAL_INTERVAL
	bool "Support reading Bearer Signal Strength Reporting Interval"
	default !LPKG_BT_TBS_CLIENT_MINIMAL
	help
	  This option enables support for reading Bearer Signal Strength
	  Reporting Interval.

config LPKG_BT_TBS_CLIENT_SET_BEARER_SIGNAL_INTERVAL
	bool "Support setting Bearer Signal Strength Reporting Interval"
	default !LPKG_BT_TBS_CLIENT_MINIMAL
	help
	  This option enables support for setting Bearer Signal Strength
	  Reporting Interval.

config LPKG_BT_TBS_CLIENT_BEARER_LIST_CURRENT_CALLS
	bool "Support reading Bearer List Current Calls"
	default !LPKG_BT_TBS_CLIENT_MINIMAL
	help
	  This option enables support for reading Bearer List Current Calls.

config LPKG_BT_TBS_CLIENT_CCID
	bool "Support reading Content Control ID"
	default !LPKG_BT_TBS_CLIENT_MINIMAL
	help
	  This option enables support for reading Content Control ID.

config LPKG_BT_TBS_CLIENT_INCOMING_URI
	bool "Support reading Incoming Call Target Bearer URI"
	default !LPKG_BT_TBS_CLIENT_MINIMAL
	help
	  This option enables support for reading Incoming Call Target Bearer
	  URI.

config LPKG_BT_TBS_CLIENT_STATUS_FLAGS
	bool "Support reading Status Flags"
	default !LPKG_BT_TBS_CLIENT_MINIMAL
	help
	  This option enables support for reading Status Flags.

config LPKG_BT_TBS_CLIENT_CP_PROCEDURES
	bool
	default y
	depends on (LPKG_BT_TBS_CLIENT_ACCEPT_CALL || \
		    LPKG_BT_TBS_CLIENT_TERMINATE_CALL || \
		    LPKG_BT_TBS_CLIENT_HOLD_CALL || \
		    LPKG_BT_TBS_CLIENT_RETRIEVE_CALL || \
		    LPKG_BT_TBS_CLIENT_ORIGINATE_CALL || \
		    LPKG_BT_TBS_CLIENT_JOIN_CALLS)
	help
	  This hidden option indicates that there are at least one control
	  point procedure available.
	  When this option is disabled it indicates that the control point can
	  be optimized away.

config LPKG_BT_TBS_CLIENT_ACCEPT_CALL
	bool "Support Accept Call"
	default !LPKG_BT_TBS_CLIENT_MINIMAL
	help
	  This option enables support for answering an incoming call.

config LPKG_BT_TBS_CLIENT_TERMINATE_CALL
	bool "Support Terminate Call"
	default !LPKG_BT_TBS_CLIENT_MINIMAL
	help
	  This option enables support for terminating a call.

config LPKG_BT_TBS_CLIENT_HOLD_CALL
	bool "Support Hold Call"
	default !LPKG_BT_TBS_CLIENT_MINIMAL
	help
	  This option enables support for putting a call on hold.

config LPKG_BT_TBS_CLIENT_RETRIEVE_CALL
	bool "Support Retrieve Call"
	default !LPKG_BT_TBS_CLIENT_MINIMAL
	help
	  This option enables support for retrieving a call on hold.

config LPKG_BT_TBS_CLIENT_ORIGINATE_CALL
	bool "Support Originate Call"
	default !LPKG_BT_TBS_CLIENT_MINIMAL
	help
	  This option enables support for originating a call.

config LPKG_BT_TBS_CLIENT_JOIN_CALLS
	bool "Support Join Calls"
	depends on LPKG_BT_TBS_CLIENT_MAX_CALLS > 1
	default !LPKG_BT_TBS_CLIENT_MINIMAL
	help
	  This option enables support for joining calls.

config LPKG_BT_TBS_CLIENT_OPTIONAL_OPCODES
	bool "Support reading Optional Opcodes"
	default !LPKG_BT_TBS_CLIENT_MINIMAL
	help
	  This option enables support for reading Optional Opcodes.

config LPKG_BT_TBS_CLIENT_INCOMING_CALL
	bool "Support reading Incoming Call"
	default !LPKG_BT_TBS_CLIENT_MINIMAL
	help
	  This option enables support for reading Incoming Call.

config LPKG_BT_TBS_CLIENT_CALL_FRIENDLY_NAME
	bool "Support reading Call Friendly Name"
	default !LPKG_BT_TBS_CLIENT_MINIMAL
	help
	  This option enables support for reading Call Friendly Name.

endif # LPKG_BT_TBS_CLIENT

if LPKG_BT_TBS || LPKG_BT_TBS_CLIENT

config LPKG_BT_TBS_MAX_URI_LENGTH
	int "The maximum length of the call URI supported"
	default 30
	range 4 253
	help
	  Sets the maximum length of the call URI supported in octets (without NULL terminator).
	  Note that if this value is lower than a call URI, the call request will be rejected.

config LPKG_BT_TBS_MAX_PROVIDER_NAME_LENGTH
	int "The maximum length of the bearer provider name"
	default 30
	range 1 512
	help
	  Sets the maximum length of the bearer provider name in octets (without NULL terminator).

config LPKG_BT_TBS_MAX_FRIENDLY_NAME_LENGTH
	int "The maximum length of the friendly name supported"
	default 30
	range 1 512
	help
	  Sets the maximum length of the friendly name in octets (without NULL terminator).

endif # LPKG_BT_TBS || LPKG_BT_TBS_CLIENT

endif # LPKG_BT_AUDIO
```

## packages/third-party/zephyr-bluetooth/subsys/bluetooth/audio/Kconfig.tmap
```kconfig
# Bluetooth Audio - Telephony and Media Audio Profile (TMAP) options
#
# Copyright 2023 NXP
#
# SPDX-License-Identifier: Apache-2.0
#
config LPKG_BT_TMAP_CG_SUPPORTED
	bool
	default y if (LPKG_BT_CAP_INITIATOR && LPKG_BT_CAP_COMMANDER && LPKG_BT_BAP_UNICAST_CLIENT && \
		  LPKG_BT_BAP_UNICAST_CLIENT_ASE_SRC > 0 && LPKG_BT_BAP_UNICAST_CLIENT_ASE_SNK > 0 && \
		  LPKG_BT_VCP_VOL_CTLR && LPKG_BT_TBS)

config LPKG_BT_TMAP_CT_SUPPORTED
	bool
	default y if (LPKG_BT_CAP_ACCEPTOR && (LPKG_BT_ASCS_ASE_SNK > 0 || LPKG_BT_ASCS_ASE_SRC > 0))

config LPKG_BT_TMAP_UMS_SUPPORTED
	bool
	default y if (LPKG_BT_CAP_INITIATOR && LPKG_BT_CAP_COMMANDER && LPKG_BT_BAP_UNICAST_CLIENT && \
		  LPKG_BT_BAP_UNICAST_CLIENT_ASE_SNK_COUNT > 0 && LPKG_BT_VCP_VOL_CTLR && LPKG_BT_MCS)

config LPKG_BT_TMAP_UMR_SUPPORTED
	bool
	default y if (LPKG_BT_CAP_ACCEPTOR && LPKG_BT_ASCS_ASE_SNK > 0 && LPKG_BT_VCP_VOL_REND)

config LPKG_BT_TMAP_BMS_SUPPORTED
	bool
	default y if (LPKG_BT_CAP_INITIATOR && LPKG_BT_BAP_BROADCAST_SOURCE)

config LPKG_BT_TMAP_BMR_SUPPORTED
	bool
	default y if (LPKG_BT_CAP_ACCEPTOR && LPKG_BT_BAP_BROADCAST_SINK && LPKG_BT_VCP_VOL_REND)

config LPKG_BT_TMAP
	bool "Telephony and Media Audio Profile"
	depends on LPKG_BT_CAP_ACCEPTOR || LPKG_BT_CAP_INITIATOR
	help
	  Enabling this will enable TMAP.

#parent-module = BT
#module = LPKG_BT_TMAP
#module-str = "Telephony and Media Audio Profile"
#source "subsys/logging/Kconfig.template.log_config_inherit"
```

## packages/third-party/zephyr-bluetooth/subsys/bluetooth/audio/Kconfig.vcp
```kconfig
# Bluetooth Audio - Volume Control Profile configuration options
#
# Copyright (c) 2020 Bose Corporation
# Copyright (c) 2020-2022 Nordic Semiconductor ASA
#
# SPDX-License-Identifier: Apache-2.0
#

################### Volume Control Profile Volume Renderer ###################

config LPKG_BT_VCP_VOL_REND
	bool "Volume Control Profile Volume Renderer Support"
	depends on LPKG_BT_GATT_DYNAMIC_DB
	depends on LPKG_BT_SMP
	help
	  This option enables support for Volume Control Profile Volume Renderer
	  role and the Volume Control Service.

if LPKG_BT_VCP_VOL_REND
config LPKG_BT_VCP_VOL_REND_VOCS_INSTANCE_COUNT
	int "Volume Offset Control Service instance count"
	default 0
	range 0 LPKG_BT_VOCS_MAX_INSTANCE_COUNT
	help
	  This option sets the number of instances of Volume Offset Control
	  Services.

config LPKG_BT_VCP_VOL_REND_VOCS
	bool # Hidden
	default y if LPKG_BT_VCP_VOL_REND_VOCS_INSTANCE_COUNT > 0
	help
	  This hidden option makes it possible to easily check if VOCS is
	  enabled for VCS.

config LPKG_BT_VCP_VOL_REND_AICS_INSTANCE_COUNT
	int "Audio Input Control Service instance count for VCS"
	default 0
	range 0 LPKG_BT_AICS_MAX_INSTANCE_COUNT
	help
	  This option sets the number of instances of Audio Input Control
	  Services for VCS.

config LPKG_BT_VCP_VOL_REND_AICS
	bool # Hidden
	default y if LPKG_BT_VCP_VOL_REND_AICS_INSTANCE_COUNT > 0
	help
	  This hidden option makes it possible to easily check if AICS is
	  enabled for VCS.

config LPKG_BT_VCP_VOL_REND_VOL_FLAGS_NOTIFIABLE
	bool "Volume Flags notifiable support"
	help
	  This option enables support for clients to subscribe for notifications
	  on the Volume Flags characteristic.

endif # LPKG_BT_VCP_VOL_REND

################### Volume Control Profile Volume Controller ###################

config LPKG_BT_VCP_VOL_CTLR
	bool "Volume Control Profile Volume Controller Support"
	depends on LPKG_BT_GATT_CLIENT
	depends on LPKG_BT_GATT_AUTO_DISCOVER_CCC
	depends on LPKG_BT_SMP
	help
	  This option enables support for Volume Control Profile Volume
	  Controller.

if LPKG_BT_VCP_VOL_CTLR

config LPKG_BT_VCP_VOL_CTLR_MAX_VOCS_INST
	int "Maximum number of VOCS instances to setup"
	default 0
	range 0 LPKG_BT_VOCS_CLIENT_MAX_INSTANCE_COUNT
	help
	  Sets the maximum number of Volume Offset Control Service (VOCS)
	  instances to setup and use.

config LPKG_BT_VCP_VOL_CTLR_VOCS
	bool # Hidden
	default y if LPKG_BT_VCP_VOL_CTLR_MAX_VOCS_INST > 0
	help
	  This hidden option makes it possible to easily check if VOCS is
	  enabled for VCS client.

config LPKG_BT_VCP_VOL_CTLR_MAX_AICS_INST
	int "Maximum number of AICS instances to setup"
	default 0
	range 0 3
	help
	  Sets the maximum number of Audio Input Control Service (AICS)
	  instances to setup and use.

config LPKG_BT_VCP_VOL_CTLR_AICS
	bool # Hidden
	default y if LPKG_BT_VCP_VOL_CTLR_MAX_AICS_INST > 0
	help
	  This hidden option makes it possible to easily check if AICS is
	  enabled for VCS client.

endif # LPKG_BT_VCP_VOL_CTLR
```

## packages/third-party/zephyr-bluetooth/subsys/bluetooth/audio/Kconfig.vocs
```kconfig
# Bluetooth Audio - Volume Offset Control Service options
#
# Copyright (c) 2020 Bose Corporation
#
# SPDX-License-Identifier: Apache-2.0
#

##################### Volume Offset Control Service #####################

config LPKG_BT_VOCS_MAX_INSTANCE_COUNT
	int "Volume Offset Control Service max instance count"
	depends on LPKG_BT_SMP
	default 0
	range 0 15
	help
	  This option sets the maximum number of instances of Volume Offset
	  Control Services.

config LPKG_BT_VOCS
	bool # hidden
	default y if LPKG_BT_VOCS_MAX_INSTANCE_COUNT > 0
	help
	  This hidden option enables support for Volume Control Service.

if LPKG_BT_VOCS

config LPKG_BT_VOCS_MAX_OUTPUT_DESCRIPTION_SIZE
	int "Volume Offset Control Service max output description size"
	default 32
	range 0 512
	help
	  This option sets the maximum output description size in octets.

endif # LPKG_BT_VOCS

##################### Volume Offset Control Service Client #####################

config LPKG_BT_VOCS_CLIENT_MAX_INSTANCE_COUNT
	int "Volume Offset Control Service client max instance count"
	depends on LPKG_BT_SMP
	default 0
	range 0 15
	help
	  This option sets the maximum number of instances of Volume Offset
	  Control Service clients.

config LPKG_BT_VOCS_CLIENT
	bool # hidden
	default y if LPKG_BT_VOCS_CLIENT_MAX_INSTANCE_COUNT > 0
	help
	  This hidden option enables support for Volume Offset Control Service.
```

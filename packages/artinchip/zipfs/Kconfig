## packages/third-party/zephyr-bluetooth/subsys/bluetooth/audio/Kconfig.cap
```kconfig
# Bluetooth Audio - Common Audio Profile (CAP) options
#
# Copyright (c) 2022 Nordic Semiconductor ASA
#
# SPDX-License-Identifier: Apache-2.0
#

config LPKG_BT_CAP
	bool
	default y if (LPKG_BT_CAP_ACCEPTOR || LPKG_BT_CAP_INITIATOR)

config LPKG_BT_CAP_ACCEPTOR
	bool "Common Audio Profile Acceptor Role Support"
	depends on LPKG_BT_BAP_UNICAST_SERVER || (LPKG_BT_BAP_BROADCAST_SINK && LPKG_BT_BAP_SCAN_DELEGATOR)
	depends on LPKG_BT_AUDIO_CODEC_CFG_MAX_METADATA_SIZE >= 4
	help
	  Enabling this will enable the CAP Acceptor role. This instantiates the
	  common audio service (CAS).

config LPKG_BT_CAP_ACCEPTOR_SET_MEMBER
	bool "Common Audio Profile Acceptor Role Set Member support"
	depends on LPKG_BT_CAP_ACCEPTOR
	depends on LPKG_BT_CSIP_SET_MEMBER
	depends on LPKG_BT_GATT_DYNAMIC_DB
	help
	  Enabling this will allow a CAP acceptor to be a set member.
	  Enabling this will require a manual register of the CAS service.
	  Enabling will take one of the allocated CSIS instances
	  (LPKG_BT_CSIP_SET_MEMBER_MAX_INSTANCE_COUNT).

config LPKG_BT_CAP_INITIATOR_UNICAST
	bool
	default y if (LPKG_BT_CAP_INITIATOR && LPKG_BT_BAP_UNICAST_CLIENT)

config LPKG_BT_CAP_INITIATOR
	bool "Common Audio Profile Initiator Role Support"
	depends on (LPKG_BT_BAP_UNICAST_CLIENT && LPKG_BT_CSIP_SET_COORDINATOR) || LPKG_BT_BAP_BROADCAST_SOURCE
	depends on LPKG_BT_AUDIO_CODEC_CFG_MAX_METADATA_SIZE >= 4
	help
	  Enabling this will enable the CAP Initiator role.


config LPKG_BT_CAP_COMMANDER
	bool "Common Audio Profile Initiator Role Support"
	depends on (LPKG_BT_BAP_BROADCAST_ASSISTANT && LPKG_BT_BAP_SCAN_DELEGATOR && LPKG_BT_CSIP_SET_COORDINATOR) || \
		   (LPKG_BT_BAP_SCAN_DELEGATOR && LPKG_BT_CSIP_SET_COORDINATOR) || \
		   (LPKG_BT_VCP_VOL_CTLR && LPKG_BT_CSIP_SET_COORDINATOR) || \
		   (LPKG_BT_MICP_MIC_CTLR && LPKG_BT_CSIP_SET_COORDINATOR) || \
		   LPKG_BT_TBS_CLIENT || \
		   LPKG_BT_MCC
	help
	  Enabling this will enable the CAP Initiator role.

config LPKG_BT_CAP_HANDOVER
	bool "Common Audio Profile Handover Procedures"
	depends on LPKG_BT_CAP_COMMANDER && LPKG_BT_CAP_INITIATOR && LPKG_BT_BAP_BROADCAST_ASSISTANT && \
		   LPKG_BT_BAP_BROADCAST_SOURCE && LPKG_BT_BAP_UNICAST_CLIENT_ASE_SNK_COUNT > 0
	help
	  Enable support for the CAP Handover procedures, allowing a device to switch between
	  broadcast and unicast for a usecase.
```

## packages/third-party/zephyr-bluetooth/subsys/bluetooth/audio/Kconfig.gmap
```kconfig
# Bluetooth Audio - Gaming Audio Profile (GMAP) options
#
# Copyright (c) 2023 Nordic Semiconductor ASA
#
# SPDX-License-Identifier: Apache-2.0
#

config LPKG_BT_GMAP_UGG_SUPPORTED
	bool
	default y if (LPKG_BT_CAP_INITIATOR && LPKG_BT_BAP_UNICAST_CLIENT && LPKG_BT_VCP_VOL_CTLR)

config LPKG_BT_GMAP_UGT_SUPPORTED
	bool
	default y if (LPKG_BT_CAP_ACCEPTOR && LPKG_BT_BAP_UNICAST_SERVER)

config LPKG_BT_GMAP_BGS_SUPPORTED
	bool
	default y if (LPKG_BT_CAP_INITIATOR && LPKG_BT_BAP_BROADCAST_SOURCE && LPKG_BT_BAP_BROADCAST_ASSISTANT)

config LPKG_BT_GMAP_BGR_SUPPORTED
	bool
	default y if (LPKG_BT_CAP_ACCEPTOR && LPKG_BT_BAP_BROADCAST_SINK && LPKG_BT_VCP_VOL_REND)

config LPKG_BT_GMAP
	bool "Gaming Audio Profile"
	depends on LPKG_BT_CAP_ACCEPTOR || LPKG_BT_CAP_INITIATOR
	help
	  Enabling this will enable GMAP.

#parent-module = BT
#module = LPKG_BT_GMAP
#module-str = "Bluetooth Gaming Audio Profile"
#source "subsys/logging/Kconfig.template.log_config_inherit"
```

## packages/third-party/zephyr-bluetooth/subsys/bluetooth/audio/Kconfig.has
```kconfig
# Bluetooth Audio - Hearing Access Service options
#
# Copyright (c) 2022 Codecoup
# Copyright (c) 2026 Nordic Semiconductor ASA
#
# SPDX-License-Identifier: Apache-2.0

menuconfig LPKG_BT_HAS
	bool "Hearing Access Service support"
	depends on LPKG_BT_GATT_DYNAMIC_DB
	depends on LPKG_BT_BAP_UNICAST_SERVER
	help
	  This option enables support for Hearing Access Service.

if LPKG_BT_HAS

config LPKG_BT_HAS_FEATURES_NOTIFIABLE
	bool "Hearing Aid Features Notifiable Support"
	help
	  This option enables support for clients to subscribe for notifications
	  on the Hearing Aid Features characteristic.

config LPKG_BT_HAS_PRESET_COUNT
	int "Preset record list size"
	default 2
	range 0 255
	help
	  This option sets the number of Hearing Access Service Presets
	  that can be registered. Setting this value to 0 disables Presets support.

config LPKG_BT_HAS_PRESET_SUPPORT
	bool
	default y if (LPKG_BT_HAS_PRESET_COUNT > 0)

if LPKG_BT_HAS_PRESET_SUPPORT

config LPKG_BT_HAS_PRESET_NAME_DYNAMIC
	bool "Allow to set preset name on runtime"
	help
	  Enabling this option allows for runtime configuration of preset name.

config LPKG_BT_HAS_PRESET_CONTROL_POINT_NOTIFIABLE
	bool "Preset Control Point Notifiable support"
	depends on LPKG_BT_EATT
	help
	  This option enables support for clients to subscribe for notifications
	  on the Hearing Aid Preset Control Point characteristic.

config LPKG_BT_HAS_ACTIVE_PRESET_INDEX
	bool
	default y if (LPKG_BT_HAS_PRESET_SUPPORT)
	help
	  This option enables the Hearing Aid Active Preset Index characteristic.

endif # LPKG_BT_HAS_PRESET_SUPPORT

endif # LPKG_BT_HAS

config LPKG_BT_HAS_CLIENT
	bool "Hearing Access Service Client support"
	depends on LPKG_BT_GATT_CLIENT
	depends on LPKG_BT_GATT_AUTO_DISCOVER_CCC
	depends on LPKG_BT_GATT_AUTO_UPDATE_MTU
	depends on LPKG_BT_SMP
	help
	  This option enables support for Hearing Access Service Client.
```

## packages/third-party/zephyr-bluetooth/subsys/bluetooth/audio/Kconfig.mcs
```kconfig
# Bluetooth Audio - Media control configuration options

#
# Copyright (c) 2020-2026 Nordic Semiconductor
#
# SPDX-License-Identifier: Apache-2.0
#

#### Media Control Service ################################

config LPKG_BT_MCS
	bool "Media Control Service Support"
	depends on MCTL_LOCAL_PLAYER_REMOTE_CONTROL
	depends on LPKG_BT_GATT_DYNAMIC_DB
	depends on LPKG_BT_SMP
	help
	  This option enables support for the Media Control Service.

#### Media Control Client ################################

config LPKG_BT_MCC
	bool "Media Control Client Support"
	depends on LPKG_BT_GATT_CLIENT
	depends on LPKG_BT_GATT_AUTO_DISCOVER_CCC
	depends on LPKG_BT_SMP
	help
	  This option enables support for the Media Control Client.

if LPKG_BT_MCC

config LPKG_BT_MCC_MEDIA_PLAYER_NAME_MAX
	int "Max length of media player name"
	default 20
	range 1 255
	help
	  Sets the maximum number of bytes (including the null termination) of
	  the name of the media player. If the name is longer, the media
	  control client will truncate the name when reading it.

config LPKG_BT_MCC_ICON_URL_MAX
	int "Max length of media player icon URL"
	default 40
	range 1 255
	help
	  Sets the maximum number of bytes (including the null termination) of
	  the media player icon URL. If the URL is longer, the media control
	  client will truncate the name when reading it.

config LPKG_BT_MCC_TRACK_TITLE_MAX
	int "Max length of the title of a track"
	default 40
	range 1 255
	help
	  Sets the maximum number of bytes (including the null termination) of
	  the title of any track in the media player. If the title is longer,
	  the media control client will truncate the title when reading it.

config LPKG_BT_MCC_SEGMENT_NAME_MAX
	int "Max length of the name of a track segment"
	default 25
	range 1 255
	help
	  Sets the maximum number of bytes (including the null termination)
	  of the name of any track segment in the media player. If the name is
	  longer, the media control client will truncate the name when reading
	  it.

config LPKG_BT_MCC_OTS
	bool "Media Control Client support for Object Transfer Service"
	depends on LPKG_BT_OTS_CLIENT
	help
	  Use this option to configure support in the Media Control Client for
	  an included Object Transfer Service in the Media Control Service.

if LPKG_BT_MCC_OTS

config LPKG_BT_MCC_OTC_OBJ_BUF_SIZE
	int "The size of the buffer used for OTC object in MCC"
	default 512
	range 1 65536
	help
	  Sets the size (in octets) of the buffer used for receiving the content
	  of objects.
	  Should be set large enough to fit any expected object.

config LPKG_BT_MCC_TOTAL_OBJ_CONTENT_MEM
	int "Total memory size to use for storing the content of objects"
	default 1
	range 0 65536
	help
	  Sets the total memory size (in octets) to use for storing the content
	  of objects.
	  This is used for the total memory pool buffer size from which memory
	  is allocated when reading object content.

config LPKG_BT_MCC_TRACK_SEGS_MAX_CNT
	int "Maximum number of tracks segments in a track segment object"
	default 25
	range 0 500
	help
	  Sets the maximum number of tracks segments in a track segment object.
	  If the received object is bigger, the remaining data in the object
	  will be ignored.

config LPKG_BT_MCC_GROUP_RECORDS_MAX
	int "Maximum number of records in a group object"
	default 25
	range 0 500
	help
	  Sets the maximum number of records in a group object. If the received
	  group object has more records than this, the remaining records in the
	  object will be ignored.

endif # LPKG_BT_MCC_OTS

config LPKG_BT_MCC_SHELL
	bool "Media Control Client Shell Support"
	default y if LPKG_BT_SHELL
	help
	  This option enables shell support for the Media Control Client.

config LPKG_BT_MCC_MINIMAL
	bool "Minimal Media Control Client without optional procedures"
	help
	  This option disables all optional procedures in the Media Control Client.

config LPKG_BT_MCC_READ_MEDIA_PLAYER_ICON_URL
	bool "Support reading Media Player Icon URL"
	default !LPKG_BT_MCC_MINIMAL
	help
	  This option enables support for Read Media Information procedure
	  optionally read the Media Player Icon URL.

config LPKG_BT_MCC_READ_TRACK_TITLE
	bool "Support reading Track Title"
	default !LPKG_BT_MCC_MINIMAL
	help
	  This option enables support for reading Track Title.

config LPKG_BT_MCC_READ_TRACK_TITLE_ENABLE_SUBSCRIPTION
	bool "Support to enable or disable the subscription of Track Title"
	default !LPKG_BT_MCC_MINIMAL
	help
	  This option enables support for the subscription of Track Title.

config LPKG_BT_MCC_READ_TRACK_DURATION
	bool "Support reading Track Duration"
	default !LPKG_BT_MCC_MINIMAL
	help
	  This option enables support for reading Track Duration.

config LPKG_BT_MCC_READ_TRACK_POSITION
	bool "Support reading Track Position"
	default !LPKG_BT_MCC_MINIMAL
	help
	  This option enables support for reading Track Position.

config LPKG_BT_MCC_SET_TRACK_POSITION
	bool "Support setting Track Position"
	default !LPKG_BT_MCC_MINIMAL
	help
	  This option enables support for setting Track Position.

config LPKG_BT_MCC_READ_PLAYBACK_SPEED
	bool "Support reading Playback Speed"
	default !LPKG_BT_MCC_MINIMAL
	help
	  This option enables support for reading Playback Speed.

config LPKG_BT_MCC_SET_PLAYBACK_SPEED
	bool "Support setting Playback Speed"
	default !LPKG_BT_MCC_MINIMAL
	help
	  This option enables support for setting Playback Speed.

config LPKG_BT_MCC_READ_SEEKING_SPEED
	bool "Support reading Seeking Speed"
	default !LPKG_BT_MCC_MINIMAL
	help
	  This option enables support for reading Seeking Speed.

config LPKG_BT_MCC_READ_PLAYING_ORDER
	bool "Support reading Playing Order"
	default !LPKG_BT_MCC_MINIMAL
	help
	  This option enables support for reading Playing Order.

config LPKG_BT_MCC_SET_PLAYING_ORDER
	bool "Support setting Playing Order"
	default !LPKG_BT_MCC_MINIMAL
	help
	  This option enables support for setting Playing Order.

config LPKG_BT_MCC_READ_PLAYING_ORDER_SUPPORTED
	bool "Support reading Playing Order Supported"
	default !LPKG_BT_MCC_MINIMAL
	help
	  This option enables support for reading Playing Order Supported.

config LPKG_BT_MCC_READ_MEDIA_STATE
	bool "Support reading Media State"
	default !LPKG_BT_MCC_MINIMAL
	help
	  This option enables support for reading Media State.

config LPKG_BT_MCC_SET_MEDIA_CONTROL_POINT
	bool "Support setting Media Control Point"
	default !LPKG_BT_MCC_MINIMAL
	help
	  This option enables support for setting Media Control Point.

config LPKG_BT_MCC_READ_MEDIA_CONTROL_POINT_OPCODES_SUPPORTED
	bool "Support reading Media Control Point Opcodes Supported"
	default !LPKG_BT_MCC_MINIMAL
	help
	  This option enables support for reading Media Control Point Opcodes Supported.

config LPKG_BT_MCC_READ_CONTENT_CONTROL_ID
	bool "Support reading Content Control ID"
	default !LPKG_BT_MCC_MINIMAL
	help
	  This option enables support for reading Content Control ID.

endif # LPKG_BT_MCC
```

## packages/third-party/zephyr-bluetooth/subsys/bluetooth/audio/Kconfig.pacs
```kconfig
# Bluetooth Audio - Published Audio Capabilities configuration options
#
# Copyright (c) 2022 Nordic Semiconductor ASA

# SPDX-License-Identifier: Apache-2.0
#

menu "Published Audio Capabilities (PAC) options"

config LPKG_BT_PAC_SNK
	bool "Sink PAC Characteristic Support"
	depends on LPKG_BT_GATT_DYNAMIC_DB
	depends on LPKG_BT_SMP
	help
	  This option enables support for Sink Published Audio Capabilities.

if LPKG_BT_PAC_SNK
config LPKG_BT_PAC_SNK_NOTIFIABLE
	bool "Sink PAC Notifiable Support"
	help
	  This option enables support for clients to be notified on the Sink
	  PAC Characteristic changes.

config LPKG_BT_PAC_SNK_LOC
	bool "Sink PAC Location Support"
	default y
	help
	  This option enables support for Sink PAC Location Characteristic.

config LPKG_BT_PAC_SNK_LOC_WRITEABLE
	bool "Sink PAC Location Writable Support"
	depends on LPKG_BT_PAC_SNK_LOC
	help
	  This option enables support for clients to write to the Sink PAC
	  Location Characteristic.

config LPKG_BT_PAC_SNK_LOC_NOTIFIABLE
	bool "Sink Audio Location Notifiable Support"
	depends on LPKG_BT_PAC_SNK_LOC
	help
	  This option enables support for clients to be notified on the Sink
	  Audio Location Characteristic changes.

endif # LPKG_BT_PACS_SNK

config LPKG_BT_PAC_SRC
	bool "Source PAC Characteristic Support"
	depends on LPKG_BT_GATT_DYNAMIC_DB
	help
	  This option enables support for Source Published Audio Capabilities.

if LPKG_BT_PAC_SRC

config LPKG_BT_PAC_SRC_NOTIFIABLE
	bool "Source PAC Notifiable Support"
	help
	  This option enables support for clients to be notified on the Source
	  PAC Characteristic changes.

config LPKG_BT_PAC_SRC_LOC
	bool "Source PAC Location Support"
	default y
	help
	  This option enables support for Source PAC Location Characteristic.

config LPKG_BT_PAC_SRC_LOC_WRITEABLE
	bool "Source PAC Location Writable Support"
	depends on LPKG_BT_PAC_SRC_LOC
	help
	  This option enables support for clients to write to the Source PAC
	  Location Characteristic.

config LPKG_BT_PAC_SRC_LOC_NOTIFIABLE
	bool "Source Audio Location Notifiable Support"
	depends on LPKG_BT_PAC_SRC_LOC
	help
	  This option enables support for clients to be notified on the Source
	  Audio Location Characteristic changes.

endif # LPKG_BT_PAC_SRC

config LPKG_BT_PACS
	bool
	default y if (LPKG_BT_PAC_SNK || LPKG_BT_PAC_SRC)

config LPKG_BT_PACS_SUPPORTED_CONTEXT_NOTIFIABLE
	bool "Supported Audio Context Notifiable Support"
	depends on LPKG_BT_PACS
	help
	  This option enables support for clients to be notified on the
	  Supported Audio Contexts Characteristic changes.

endmenu
```

## target/configs/d12p_d126-demo124-nor_rt-thread_helloworld_defconfig
```kconfig
CONFIG_PRJ_DEFCONFIG_FILENAME="d12p_d126-demo124-nor_rt-thread_helloworld_defconfig"
CONFIG_PRJ_CHIP="d12p"
CONFIG_PRJ_BOARD="d126-demo124-nor"
CONFIG_PRJ_KERNEL="rt-thread"
CONFIG_PRJ_APP="helloworld"
CONFIG_AIC_USING_FS_IMAGE_0=y
CONFIG_AIC_USING_FS_IMAGE_TYPE_FATFS_FOR_0=y
CONFIG_AIC_FS_IMAGE_DIR_0="rodata"
CONFIG_AIC_FS_IMAGE_NAME_0="rodata.fatfs"
CONFIG_AIC_USING_FS_IMAGE_1=y
CONFIG_AIC_FS_IMAGE_DIR_1="data/"
CONFIG_AIC_FS_IMAGE_NAME_1="data.lfs"
CONFIG_LVGL_V_9=y
CONFIG_LPKG_LVGL_USING_DEMOS=y
CONFIG_AIC_LVGL_DEMO=y
CONFIG_AIC_LVGL_SLIDE_DEMO=y
CONFIG_LV_CACHE_IMG_NUM=20
CONFIG_AIC_USING_UART0=y
CONFIG_AIC_USING_I2C0=y
CONFIG_AIC_USING_I2C1=y
CONFIG_AIC_USING_QSPI0=y
CONFIG_AIC_QSPI0_DEVICE_SPINOR=y
CONFIG_AIC_SDMC1_IS_SDIO=y
CONFIG_AIC_SDMC1_CLK_FREQ=40000000
CONFIG_AIC_WIRELESS_LAN=y
CONFIG_AIC_WIRELESS_PWR_GPIO="PE.18"
CONFIG_AIC_WIRELESS_BT_PWR_GPIO="PE.20"
CONFIG_AIC_WIRELESS_WIFI_WK_HOST_GPIO="PA.6"
CONFIG_AIC_WLAN_AIC8800D40L=y
CONFIG_CHIP_SELECT_AIC8800DW=y
CONFIG_AIC_USING_TSEN=y
CONFIG_AIC_USING_TSEN_CPU=y
CONFIG_AIC_DISP_MIPI_DSI=y
CONFIG_AICFB_RGB565=y
CONFIG_AIC_PAN_DISPLAY=y
CONFIG_AIC_PANEL_DSI_EK79007AD=y
CONFIG_AIC_PANEL_ENABLE_GPIO="PF.0"
CONFIG_AIC_GE_CMDQ=y
CONFIG_AIC_USING_DMA=y
CONFIG_AIC_USING_WRI=y
CONFIG_AIC_USING_RTC=y
CONFIG_AIC_USING_WDT=y
CONFIG_AIC_PSRAM_SW_SIZE=0x200000
CONFIG_AIC_INTERRUPTSTACK_SIZE=4096
CONFIG_AIC_SYSCFG_LDO1X_ENABLE=y
CONFIG_RT_NAME_MAX=8
CONFIG_IDLE_THREAD_STACK_SIZE=1024
CONFIG_RT_TIMER_THREAD_PRIO=7
CONFIG_RT_TIMER_THREAD_STACK_SIZE=8192
# CONFIG_RT_KSERVICE_USING_STDLIB is not set
# CONFIG_RT_DEBUG is not set
CONFIG_RT_MEMHEAP_BSET_MODE=y
CONFIG_RT_USING_MEMHEAP_AS_HEAP=y
# CONFIG_RT_USING_MEMHEAP_AUTO_BINDING is not set
CONFIG_RT_USING_MEMTRACE=y
CONFIG_RT_CONSOLE_DEVICE_NAME="uart0"
CONFIG_RT_MAIN_THREAD_STACK_SIZE=8192
CONFIG_RT_USING_LEGACY=y
CONFIG_FINSH_HISTORY_LINES=1
CONFIG_DFS_FILESYSTEMS_MAX=8
CONFIG_RT_USING_DFS_MNTTABLE=y
CONFIG_RT_USING_DFS_ELMFAT=y
CONFIG_RT_DFS_ELM_LFN_UNICODE_2=y
CONFIG_RT_DFS_ELM_USE_EXFAT=y
CONFIG_RT_DFS_ELM_DRIVES=4
CONFIG_RT_DFS_ELM_MAX_SECTOR_SIZE=4096
CONFIG_RT_USING_DFS_ROMFS=y
CONFIG_RT_USING_FAL=y
CONFIG_FAL_USING_SFUD_PORT=y
# CONFIG_FAL_BLK_DEVICE_RDONLY is not set
CONFIG_RT_USING_SYSTEM_WORKQUEUE=y
CONFIG_RT_SYSTEM_WORKQUEUE_STACKSIZE=8192
CONFIG_RT_USING_ADC=y
CONFIG_RT_SDIO_STACK_SIZE=16384
CONFIG_RT_SDIO_THREAD_PRIORITY=5
CONFIG_RT_MMCSD_STACK_SIZE=8192
CONFIG_RT_SFUD_USING_QSPI=y
CONFIG_RT_USING_TOUCH=y
CONFIG_RT_TOUCH_PIN_IRQ=y
CONFIG_RT_USING_WIFI=y
CONFIG_RT_WLAN_WORKQUEUE_THREAD_SIZE=8192
CONFIG_RT_WLAN_DEBUG=y
CONFIG_RT_WLAN_CMD_DEBUG=y
CONFIG_RT_USING_POSIX_FS=y
CONFIG_RT_USING_NETDEV=y
CONFIG_RT_LWIP_TCPTHREAD_PRIORITY=3
CONFIG_RT_LWIP_TCPTHREAD_STACKSIZE=8192
CONFIG_RT_LWIP_NETIF_LOOPBACK=y
CONFIG_RT_USING_ULOG=y
CONFIG_ULOG_OUTPUT_LVL_I=y
CONFIG_ULOG_TIME_USING_TIMESTAMP=y
CONFIG_LPKG_USING_CPU_USAGE=y
CONFIG_LPKG_USING_LITTLEFS=y
CONFIG_LPKG_USING_I2C_TOOLS=y
CONFIG_LPKG_USING_MHZ=y
CONFIG_LPKG_USING_NETUTILS=y
CONFIG_LPKG_NETUTILS_IPERF=y
CONFIG_AIC_MPP_PLAYER_INTERFACE=y
CONFIG_AIC_MPP_VE_TEST=y
CONFIG_LPKG_USING_PINMUX_CHECHK=y
CONFIG_AIC_PINMUX_CHECK=y
CONFIG_AIC_GPIO_IRQ_DRV_EN=y
CONFIG_AIC_USING_TOUCH=y
CONFIG_AIC_TOUCH_PANEL_I2C_CHAN="i2c0"
CONFIG_AIC_TOUCH_PANEL_RST_PIN="PA.10"
CONFIG_AIC_TOUCH_PANEL_INT_PIN="PA.11"
CONFIG_AIC_I2S_CODEC_SELECT=y
# CONFIG_AIC_I2S_CODEC_TLV320 is not set
CONFIG_AIC_I2S_CODEC_JY6311=y
CONFIG_AIC_I2S_CODEC_JY6311_I2C="i2c1"
CONFIG_AIC_I2S_CODEC_PA_PIN="PE.17"
CONFIG_AIC_CMU_DRV_TEST=y
CONFIG_AIC_TP_DRV_TEST=y
CONFIG_AIC_WDT_DRV_TEST=y
```

## target/configs/d12p_demo132-nor_baremetal_bootloader_defconfig
```kconfig
CONFIG_PRJ_DEFCONFIG_FILENAME="d12p_demo132-nor_baremetal_bootloader_defconfig"
CONFIG_PRJ_CHIP="d12p"
CONFIG_PRJ_BOARD="demo132-nor"
CONFIG_PRJ_KERNEL="baremetal"
CONFIG_PRJ_APP="bootloader"
CONFIG_PRJ_CUSTOM_LDS="application/baremetal/bootloader/ldscript/d12p_bootloader_gcc.ld"
CONFIG_AIC_USING_UART0=y
CONFIG_AIC_USING_QSPI0=y
CONFIG_AIC_QSPI0_DEVICE_SPINOR=y
# CONFIG_AIC_USING_GE is not set
# CONFIG_AIC_USING_VE is not set
CONFIG_AIC_USING_WRI=y
CONFIG_AIC_USING_RTC=y
CONFIG_AIC_USING_WDT=y
CONFIG_AIC_PSRAM_SW_SIZE=0x300000
CONFIG_AIC_INTERRUPTSTACK_SIZE=8192
CONFIG_AIC_USING_SID=y
CONFIG_EFUSE_WRITE_SUPPORT=y
CONFIG_AIC_SYSCFG_SIP_FLASH_ENABLE=y
CONFIG_AIC_SYSCFG_LDO1X_ENABLE=y
CONFIG_AIC_NORMALSTACK_SIZE=8192
CONFIG_AIC_BOOTLOADER_TEXT_SIZE=0x7FF00
# CONFIG_AIC_BOOTLOADER_SPINAND_SUPPORT is not set
CONFIG_AIC_BOOTLOADER_AXICFG_SUPPORT=y
CONFIG_AIC_AXICFG_PORT_DVP_EN=y
CONFIG_AIC_AXICFG_PORT_DVP_PRIO=10
CONFIG_AICUPG_SDCARD_ENABLE=y
CONFIG_AICUPG_MMC_ARTINCHIP=y
CONFIG_AICUPG_NOR_ARTINCHIP=y
# CONFIG_AICUPG_LOG_BUFFER_SUPPORT is not set
CONFIG_AIC_BOOTLOADER_CMD_NOR_BOOT=y
CONFIG_AIC_BOOTLOADER_CMD_SPI_NOR=y
CONFIG_AIC_BOOTLOADER_CMD_MTD=y
CONFIG_LPKG_CHERRYUSB_DEVICE_CLASS_AIC_SINGLE=y
# CONFIG_LPKG_MPP is not set
CONFIG_LPKG_USING_SFUD=y
CONFIG_AIC_LOG_LEVEL_INFO=y
CONFIG_AIC_MMC_BARE_TEST=y
CONFIG_AIC_SID_BARE_TEST=y
```

## target/configs/d12p_demo132-nor_rt-thread_helloworld_defconfig
```kconfig
CONFIG_PRJ_DEFCONFIG_FILENAME="d12p_demo132-nor_rt-thread_helloworld_defconfig"
CONFIG_PRJ_CHIP="d12p"
CONFIG_PRJ_BOARD="demo132-nor"
CONFIG_PRJ_KERNEL="rt-thread"
CONFIG_PRJ_APP="helloworld"
CONFIG_AIC_USING_FS_IMAGE_0=y
CONFIG_AIC_USING_FS_IMAGE_TYPE_FATFS_FOR_0=y
CONFIG_AIC_FS_IMAGE_DIR_0="rodata/"
CONFIG_AIC_FS_IMAGE_NAME_0="rodata.fatfs"
CONFIG_AIC_USING_FS_IMAGE_1=y
CONFIG_AIC_USING_FS_IMAGE_TYPE_FATFS_FOR_1=y
CONFIG_AIC_FS_IMAGE_DIR_1="data/"
CONFIG_AIC_FS_IMAGE_NAME_1="data.fatfs"
CONFIG_LVGL_V_9=y
CONFIG_AIC_LVGL_DEMO=y
CONFIG_AIC_LVGL_DEMO_HUB_DEMO=y
CONFIG_AIC_USING_UART0=y
CONFIG_AIC_USING_I2C0=y
CONFIG_AIC_USING_I2C1=y
CONFIG_AIC_USING_QSPI0=y
CONFIG_AIC_QSPI0_DEVICE_SPINOR=y
CONFIG_AIC_USING_SDMC0=y
# CONFIG_AIC_USING_SDMC1 is not set
CONFIG_AIC_SDMC_IRQ_MODE=y
CONFIG_AIC_SDMC0_SMP_PHASE=1
CONFIG_AIC_USING_TSEN=y
CONFIG_AIC_USING_TSEN_CPU=y
CONFIG_AIC_USING_GPAI=y
CONFIG_AIC_USING_GPAI0=y
CONFIG_AIC_USING_GPAI7=y
CONFIG_AIC_GPAI0_MODE_SINGLE=y
CONFIG_AIC_GPAI7_MODE_SINGLE=y
CONFIG_AIC_DISP_MIPI_DSI=y
CONFIG_AICFB_RGB565=y
CONFIG_AIC_PAN_DISPLAY=y
# CONFIG_AIC_DISP_BOOTUP_LOGO is not set
CONFIG_AIC_PANEL_DSI_EK79007AD=y
CONFIG_AIC_PANEL_ENABLE_GPIO="PE.16"
CONFIG_AIC_USING_DVP=y
CONFIG_AIC_USING_DMA=y
CONFIG_AIC_USING_WRI=y
CONFIG_AIC_USING_RTC=y
CONFIG_AIC_USING_WDT=y
CONFIG_AIC_PSRAM_SIZE=0x1000000
CONFIG_AIC_INTERRUPTSTACK_SIZE=4096
CONFIG_AIC_SYSCFG_SIP_FLASH_ENABLE=y
CONFIG_AIC_SYSCFG_LDO1X_ENABLE=y
CONFIG_AIC_USING_MTOP=y
CONFIG_RT_NAME_MAX=8
CONFIG_IDLE_THREAD_STACK_SIZE=2048
# CONFIG_RT_USING_TIMER_SOFT is not set
# CONFIG_RT_KSERVICE_USING_STDLIB is not set
# CONFIG_RT_DEBUG is not set
CONFIG_RT_MEMHEAP_BSET_MODE=y
CONFIG_RT_USING_MEMHEAP_AS_HEAP=y
# CONFIG_RT_USING_MEMHEAP_AUTO_BINDING is not set
CONFIG_RT_USING_DEVICE_OPS=y
CONFIG_RT_CONSOLE_DEVICE_NAME="uart0"
CONFIG_RT_MAIN_THREAD_STACK_SIZE=4096
CONFIG_RT_USING_LEGACY=y
CONFIG_FINSH_HISTORY_LINES=1
CONFIG_DFS_FILESYSTEMS_MAX=8
CONFIG_RT_USING_DFS_MNTTABLE=y
CONFIG_RT_USING_DFS_ELMFAT=y
CONFIG_RT_USING_DFS_ROMFS=y
CONFIG_RT_USING_FAL=y
CONFIG_FAL_USING_SFUD_PORT=y
CONFIG_RT_USING_PM=y
CONFIG_PM_USING_CUSTOM_CONFIG=y
CONFIG_PM_ENABLE_DEBUG=y
CONFIG_PM_ENABLE_SUSPEND_SLEEP_MODE=y
CONFIG_PM_ENABLE_THRESHOLD_SLEEP_MODE=y
CONFIG_RT_MMCSD_STACK_SIZE=8192
CONFIG_RT_SFUD_USING_QSPI=y
CONFIG_RT_USING_TOUCH=y
CONFIG_RT_TOUCH_PIN_IRQ=y
CONFIG_RT_USING_POSIX_FS=y
CONFIG_RT_USING_ULOG=y
CONFIG_ULOG_OUTPUT_LVL_I=y
CONFIG_ULOG_TIME_USING_TIMESTAMP=y
CONFIG_ULOG_USING_FILTER=y
CONFIG_LPKG_USING_CPU_LOAD=y
CONFIG_LPKG_USING_LITTLEFS=y
CONFIG_LPKG_USING_MHZ=y
CONFIG_AIC_MPP_PLAYER_INTERFACE=y
CONFIG_AIC_MPP_VIN=y
CONFIG_AIC_GPIO_IRQ_DRV_EN=y
CONFIG_AIC_USING_CAMERA=y
CONFIG_AIC_USING_CAMERA_XS9950=y
CONFIG_AIC_CAMERA_I2C_CHAN=1
CONFIG_AIC_CAMERA_RST_PIN=""
CONFIG_AIC_CAMERA_PWDN_PIN="PE.13"
CONFIG_AIC_USING_TOUCH=y
CONFIG_AIC_TOUCH_PANEL_I2C_CHAN="i2c0"
CONFIG_AIC_TOUCH_PANEL_RST_PIN="PA.10"
CONFIG_AIC_TOUCH_PANEL_INT_PIN="PA.11"
CONFIG_AIC_I2S_CODEC_SELECT=y
CONFIG_AIC_I2S_CODEC_ES8388=y
# CONFIG_AIC_I2S_CODEC_TLV320 is not set
CONFIG_AIC_I2S_CODEC_ES8388_I2C="i2c0"
CONFIG_AIC_I2S_CODEC_PA_PIN="PE.17"
CONFIG_AIC_CMU_DRV_TEST=y
CONFIG_AIC_DISPLAY_TEST=y
CONFIG_AIC_VIN_TEST=y
CONFIG_AIC_WDT_DRV_TEST=y
```

## target/configs/d13x_HT68-DEMO-A02-V0_baremetal_bootloader_defconfig
```kconfig
CONFIG_PRJ_DEFCONFIG_FILENAME="d13x_HT68-DEMO-A02-V0_baremetal_bootloader_defconfig"
CONFIG_PRJ_CHIP="d13x"
CONFIG_PRJ_BOARD="HT68-DEMO-A02-V0"
CONFIG_PRJ_KERNEL="baremetal"
CONFIG_PRJ_APP="bootloader"
CONFIG_AIC_USING_HOT68_DEMO_A01_V0=y
CONFIG_PRJ_CUSTOM_LDS="application/baremetal/bootloader/ldscript/d13x_bootloader_gcc.ld"
CONFIG_AIC_USING_UART0=y
CONFIG_AIC_USING_QSPI0=y
CONFIG_AIC_QSPI0_DEVICE_SPINOR=y
CONFIG_AIC_DISP_MIPI_DSI=y
CONFIG_AICFB_RGB565=y
CONFIG_AIC_PANEL_DSI_H080A11=y
CONFIG_AIC_PANEL_ENABLE_GPIO="PE.15"
# CONFIG_AIC_USING_GE is not set
# CONFIG_AIC_USING_VE is not set
CONFIG_AIC_USING_DMA=y
CONFIG_AIC_USING_WRI=y
CONFIG_AIC_USING_RTC=y
CONFIG_AIC_PSRAM_SW_SIZE=0x300000
CONFIG_AIC_INTERRUPTSTACK_SIZE=8192
CONFIG_AIC_USING_SID=y
CONFIG_AIC_SYSCFG_SIP_FLASH_ENABLE=y
CONFIG_AIC_SYSCFG_LDO1X_ENABLE=y
CONFIG_AIC_NORMALSTACK_SIZE=8192
CONFIG_AIC_BOOTLOADER_TEXT_SIZE=0x7FF00
# CONFIG_AIC_BOOTLOADER_SPINAND_SUPPORT is not set
CONFIG_AIC_BOOTLOADER_PSRAM_EN=y
CONFIG_AIC_XSPI_PSRAM_CS0_PINS=0
CONFIG_AIC_XSPI_PSRAM_CS1_PINS=0
CONFIG_AICUPG_UART_ENABLE=y
CONFIG_AICUPG_SDCARD_ENABLE=y
CONFIG_AICUPG_UDISK_ENABLE=y
CONFIG_AICUPG_MMC_ARTINCHIP=y
CONFIG_AICUPG_NOR_ARTINCHIP=y
CONFIG_AIC_BOOTLOADER_CMD_NOR_BOOT=y
CONFIG_AIC_BOOTLOADER_CMD_SPI_NOR=y
CONFIG_AIC_BOOTLOADER_CMD_MTD=y
CONFIG_AIC_BOOTLOADER_CMD_PART=y
CONFIG_AIC_BOOTLOADER_CMD_PROGRESS_BAR=y
CONFIG_AIC_BOOTLOADER_CMD_FB_CONSOLE=y
CONFIG_AICUPG_DEBUG=y
CONFIG_LPKG_CHERRYUSB_DEVICE_CLASS_AIC_SINGLE=y
CONFIG_LPKG_USING_DFS_ROMFS=y
# CONFIG_LPKG_MPP is not set
CONFIG_AIC_ENV_INTERFACE=y
CONFIG_LPKG_USING_SFUD=y
```

## target/configs/d13x_HT68-DEMO-A02-V0_rt-thread_evFunction_defconfig
```kconfig
CONFIG_PRJ_DEFCONFIG_FILENAME="d13x_HT68-DEMO-A02-V0_rt-thread_evFunction_defconfig"
CONFIG_PRJ_CHIP="d13x"
CONFIG_PRJ_BOARD="HT68-DEMO-A02-V0"
CONFIG_PRJ_KERNEL="rt-thread"
CONFIG_PRJ_APP="evFunction"
CONFIG_AIC_USING_HT68_DEMO_A02_V0=y
CONFIG_AIC_USING_FS_IMAGE_0=y
CONFIG_AIC_USING_FS_IMAGE_TYPE_FATFS_FOR_0=y
CONFIG_AIC_FS_IMAGE_DIR_0="rodata/"
CONFIG_AIC_FS_IMAGE_NAME_0="rodata.fatfs"
CONFIG_AIC_USING_UART0=y
CONFIG_AIC_USING_I2C2=y
CONFIG_AIC_USING_PWM1=y
CONFIG_AIC_USING_USB0=y
CONFIG_AIC_USING_QSPI0=y
CONFIG_AIC_QSPI0_DEVICE_SPINOR=y
CONFIG_AIC_SDMC1_USING_HOTPLUG=y
CONFIG_AIC_SDMC1_HOTPLUG_PIN="PA.5"
CONFIG_AIC_USING_TSEN=y
CONFIG_AIC_USING_TSEN_CPU=y
CONFIG_AIC_USING_TSEN_GPAI=y
CONFIG_DATA_ORDER_BGR=y
CONFIG_AIC_PAN_DISPLAY=y
CONFIG_AIC_PANEL_CUSTOM_RESOLUTION=y
CONFIG_PANEL_PIXELCLOCK=32
CONFIG_PANEL_HACTIVE=540
CONFIG_PANEL_VACTIVE=540
CONFIG_PANEL_HBP=140
CONFIG_PANEL_HFP=140
CONFIG_PANEL_HSW=4
CONFIG_PANEL_VBP=40
CONFIG_PANEL_VFP=60
CONFIG_PANEL_VSW=4
CONFIG_AIC_PWM_BACKLIGHT=y
CONFIG_AIC_PWM_BACKLIGHT_CHANNEL=1
CONFIG_AIC_GE_CMDQ=y
CONFIG_AIC_USING_DMA=y
CONFIG_AIC_USING_WRI=y
CONFIG_AIC_USING_RTC=y
CONFIG_AIC_PSRAM_SW_SIZE=0x0
CONFIG_AIC_INTERRUPTSTACK_SIZE=4096
CONFIG_AIC_CLK_PLL_FRA0_FREQ=792000000
CONFIG_AIC_CLK_PLL_FRA2_FREQ=1188000000
CONFIG_AIC_USING_SID=y
CONFIG_AIC_SYSCFG_SIP_FLASH_ENABLE=y
CONFIG_AIC_SYSCFG_LDO1X_ENABLE=y
CONFIG_AIC_USING_MTOP=y
CONFIG_IDLE_THREAD_STACK_SIZE=1024
# CONFIG_RT_KSERVICE_USING_STDLIB is not set
# CONFIG_RT_DEBUG is not set
CONFIG_RT_MEMHEAP_BSET_MODE=y
CONFIG_RT_USING_MEMHEAP_AS_HEAP=y
# CONFIG_RT_USING_MEMHEAP_AUTO_BINDING is not set
CONFIG_RT_CONSOLE_DEVICE_NAME="uart0"
CONFIG_RT_MAIN_THREAD_STACK_SIZE=4096
CONFIG_RT_USING_LEGACY=y
CONFIG_FINSH_HISTORY_LINES=1
CONFIG_RT_USING_DFS_MNTTABLE=y
CONFIG_RT_USING_DFS_ELMFAT=y
CONFIG_RT_DFS_ELM_LFN_UNICODE_2=y
CONFIG_RT_DFS_ELM_USE_EXFAT=y
CONFIG_RT_DFS_ELM_DRIVES=4
CONFIG_RT_DFS_ELM_MAX_SECTOR_SIZE=4096
CONFIG_RT_USING_DFS_ROMFS=y
CONFIG_RT_USING_FAL=y
# CONFIG_FAL_DEBUG_CONFIG is not set
CONFIG_FAL_USING_SFUD_PORT=y
# CONFIG_FAL_BLK_DEVICE_RDONLY is not set
CONFIG_RT_USING_CAN=y
CONFIG_RT_CAN_USING_HDR=y
CONFIG_RT_USING_ADC=y
CONFIG_RT_USING_PM=y
CONFIG_PM_USING_CUSTOM_CONFIG=y
CONFIG_PM_ENABLE_SUSPEND_SLEEP_MODE=y
CONFIG_PM_ENABLE_THRESHOLD_SLEEP_MODE=y
CONFIG_RT_MMCSD_STACK_SIZE=8192
CONFIG_RT_SFUD_USING_QSPI=y
CONFIG_RT_USING_WDT=y
CONFIG_RT_USING_TOUCH=y
CONFIG_RT_TOUCH_PIN_IRQ=y
CONFIG_RT_USING_ULOG=y
CONFIG_ULOG_OUTPUT_LVL_I=y
# CONFIG_ULOG_OUTPUT_TIME is not set
CONFIG_ULOG_USING_FILTER=y
CONFIG_APP_USE_DRAW_LINE_TEST=y
CONFIG_LPKG_USING_CPU_USAGE=y
CONFIG_LPKG_USING_LITTLEFS=y
CONFIG_LPKG_USING_I2C_TOOLS=y
CONFIG_AIC_MPP_PLAYER_INTERFACE=y
CONFIG_LPKG_USING_OTA_DOWNLOADER=y
CONFIG_OTA_DOWNLOADER_DEBUG=y
CONFIG_AIC_GPIO_IRQ_DRV_EN=y
CONFIG_AIC_I2C_INTERRUPT_MODE=y
CONFIG_AIC_USING_TOUCH=y
CONFIG_AIC_TOUCH_PANEL_AXS15260=y
CONFIG_AIC_I2C_DRV_DEBUG=y
CONFIG_AIC_FB_DRV_DEBUG=y
CONFIG_AIC_CMU_DRV_TEST=y
CONFIG_AIC_GPIO_DRV_TEST=y
CONFIG_AIC_DMA_DRV_TEST=y
CONFIG_AIC_I2C_DRV_TEST=y
CONFIG_AIC_TP_DRV_TEST=y
```

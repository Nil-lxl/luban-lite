## packages/third-party/zephyr-bluetooth/subsys/bluetooth/services/Kconfig.ans
```kconfig
# Bluetooth GATT Alert Notification Service

# Copyright (c) 2025 Sean Kyer
#
# SPDX-License-Identifier: Apache-2.0

menuconfig LPKG_BT_ANS
	bool "GATT Alert Notification Service [EXPERIMENTAL]"
	depends on UTF8
	select EXPERIMENTAL

if LPKG_BT_ANS

#module = LPKG_BT_ANS
#module-str = Alert Notification Service (ANS)
#source "subsys/logging/Kconfig.template.log_config"

menu "New Alert Categories"

config LPKG_BT_ANS_NALRT_CAT_SIMPLE_ALERT
	bool "Support Simple Alert"

config LPKG_BT_ANS_NALRT_CAT_EMAIL
	bool "Support Email"

config LPKG_BT_ANS_NALRT_CAT_NEWS
	bool "Support News"

config LPKG_BT_ANS_NALRT_CAT_CALL
	bool "Support Call"

config LPKG_BT_ANS_NALRT_CAT_MISSED_CALL
	bool "Support Missed Call"

config LPKG_BT_ANS_NALRT_CAT_SMS_MMS
	bool "Support SMS/MMS"

config LPKG_BT_ANS_NALRT_CAT_VOICE_MAIL
	bool "Support Voice Mail"

config LPKG_BT_ANS_NALRT_CAT_SCHEDULE
	bool "Support Schedule"

config LPKG_BT_ANS_NALRT_CAT_HIGH_PRI_ALERT
	bool "Support High Priority Alert"

config LPKG_BT_ANS_NALRT_CAT_INSTANT_MESSAGE
	bool "Support Instant Message"

endmenu

menu "Unread Alert Categories"

config LPKG_BT_ANS_UNALRT_CAT_SIMPLE_ALERT
	bool "Support Simple Alert"

config LPKG_BT_ANS_UNALRT_CAT_EMAIL
	bool "Support Email"

config LPKG_BT_ANS_UNALRT_CAT_NEWS
	bool "Support News"

config LPKG_BT_ANS_UNALRT_CAT_CALL
	bool "Support Call"

config LPKG_BT_ANS_UNALRT_CAT_MISSED_CALL
	bool "Support Missed Call"

config LPKG_BT_ANS_UNALRT_CAT_SMS_MMS
	bool "Support SMS/MMS"

config LPKG_BT_ANS_UNALRT_CAT_VOICE_MAIL
	bool "Support Voice Mail"

config LPKG_BT_ANS_UNALRT_CAT_SCHEDULE
	bool "Support Schedule"

config LPKG_BT_ANS_UNALRT_CAT_HIGH_PRI_ALERT
	bool "Support High Priority Alert"

config LPKG_BT_ANS_UNALRT_CAT_INSTANT_MESSAGE
	bool "Support Instant Message"

endmenu

endif # LPKG_BT_ANS
```

## packages/third-party/zephyr-bluetooth/subsys/bluetooth/services/Kconfig.gap_svc
```kconfig
# GATT Generic Access Service - default implementation
#
# Copyright (c) 2019-2025 Intel Corporation
# Copyright (c) 2025 Koppel Electronic
#
# SPDX-License-Identifier: Apache-2.0

menuconfig LPKG_BT_GAP_SVC
	bool "GATT Generic Access Service"
	default y
	help
	  Enable the default GATT Generic Access Service.
	  Enabled by default provides basic GAP functionality.
	  If disabled, it is the application responsibility to provide its own
	  implementation of GAP service, otherwise the system is not Bluetooth
	  qualification compliant.

if LPKG_BT_GAP_SVC

config LPKG_BT_DEVICE_NAME_GATT_WRITABLE
	bool "Allow to write device name by remote GATT clients"
	depends on LPKG_BT_DEVICE_NAME_DYNAMIC
	default y
	help
	  Enabling this option allows remote GATT clients to write to device
	  name GAP characteristic.

if LPKG_BT_DEVICE_NAME_GATT_WRITABLE
choice LPKG_BT_DEVICE_NAME_GATT_WRITABLE_SECURITY
	prompt "Security requirements"
	default LPKG_BT_DEVICE_NAME_GATT_WRITABLE_NONE if DEVICE_NAME_GATT_WRITABLE_NONE
	default LPKG_BT_DEVICE_NAME_GATT_WRITABLE_AUTHEN if DEVICE_NAME_GATT_WRITABLE_AUTHEN
	default LPKG_BT_DEVICE_NAME_GATT_WRITABLE_ENCRYPT if DEVICE_NAME_GATT_WRITABLE_ENCRYPT
	default LPKG_BT_DEVICE_NAME_GATT_WRITABLE_ENCRYPT
	help
	  Select security requirements for writing device name by remote GATT
	  clients.

config LPKG_BT_DEVICE_NAME_GATT_WRITABLE_NONE
	bool "No requirements"

config LPKG_BT_DEVICE_NAME_GATT_WRITABLE_ENCRYPT
	bool "Encryption required"

config LPKG_BT_DEVICE_NAME_GATT_WRITABLE_AUTHEN
	bool "Encryption and authentication required"

endchoice  #LPKG_BT_DEVICE_NAME_GATT_WRITABLE_SECURITY

config DEVICE_NAME_GATT_WRITABLE_NONE
	select DEPRECATED
	bool "No requirements [DEPRECATED]"
	help
	  This option is deprecated. Select LPKG_BT_DEVICE_NAME_GATT_WRITABLE_NONE instead.

config DEVICE_NAME_GATT_WRITABLE_ENCRYPT
	select DEPRECATED
	bool "Encryption required [DEPRECATED]"
	help
	  This option is deprecated. Select LPKG_BT_DEVICE_NAME_GATT_WRITABLE_ENCRYPT instead.

config DEVICE_NAME_GATT_WRITABLE_AUTHEN
	select DEPRECATED
	bool "Encryption and authentication required [DEPRECATED]"
	help
	  This option is deprecated. Select LPKG_BT_DEVICE_NAME_GATT_WRITABLE_AUTHEN instead.

endif #LPKG_BT_DEVICE_NAME_GATT_WRITABLE

config LPKG_BT_DEVICE_APPEARANCE_GATT_WRITABLE
	bool "Allow to write GAP Appearance by remote GATT clients"
	depends on LPKG_BT_DEVICE_APPEARANCE_DYNAMIC
	default y
	help
	  Enabling this option allows remote GATT clients to write to device
	  appearance GAP characteristic.

if LPKG_BT_DEVICE_APPEARANCE_GATT_WRITABLE
choice LPKG_BT_DEVICE_APPEARANCE_GATT_WRITABLE_SECURITY
	prompt "Security requirements"
	default LPKG_BT_DEVICE_APPEARANCE_GATT_WRITABLE_AUTHEN if DEVICE_APPEARANCE_GATT_WRITABLE_AUTHEN
	default LPKG_BT_DEVICE_APPEARANCE_GATT_WRITABLE_AUTHEN
	help
	  Select security requirements for writing device appearance by remote
	  GATT clients.

config LPKG_BT_DEVICE_APPEARANCE_GATT_WRITABLE_NONE
	bool "No requirements"

config LPKG_BT_DEVICE_APPEARANCE_GATT_WRITABLE_ENCRYPT
	bool "Encryption required"

config LPKG_BT_DEVICE_APPEARANCE_GATT_WRITABLE_AUTHEN
	bool "Encryption and authentication required"

endchoice  #LPKG_BT_DEVICE_APPEARANCE_GATT_WRITABLE_SECURITY

config LPKG_DEVICE_APPEARANCE_GATT_WRITABLE_AUTHEN
	select DEPRECATED
	bool "Encryption and authentication required [DEPRECATED]"
	help
	  This option is deprecated. Select LPKG_BT_DEVICE_APPEARANCE_GATT_WRITABLE_AUTHEN instead.

endif #LPKG_BT_DEVICE_APPEARANCE_GATT_WRITABLE

endif #LPKG_BT_GAP_SVC
```

## packages/third-party/zephyr-bluetooth/subsys/bluetooth/services/Kconfig.hrs
```kconfig
# Bluetooth GATT Heart Rate service

# Copyright (c) 2018 Nordic Semiconductor ASA
# SPDX-License-Identifier: Apache-2.0

menuconfig LPKG_BT_HRS
	bool "GATT Heart Rate service"

if LPKG_BT_HRS

choice LPKG_BT_HRS_DEFAULT_PERM
	prompt "Default permissions used for HRS characteristics"
	default LPKG_BT_HRS_DEFAULT_PERM_RW
	help
	  Default permissions for HRS characteristic attributes
	  used when no permission is set for the report.
	  Used also for boot reports.

config LPKG_BT_HRS_DEFAULT_PERM_RW
	bool "Read and write allowed"

config LPKG_BT_HRS_DEFAULT_PERM_RW_ENCRYPT
	bool "Require encryption for access"

config LPKG_BT_HRS_DEFAULT_PERM_RW_AUTHEN
	bool "Require encryption and authentication for access"

endchoice

endif # LPKG_BT_HRS
```

## packages/third-party/zephyr-bluetooth/subsys/bluetooth/services/ias/Kconfig.ias
```kconfig
# Bluetooth GATT Immediate Alert Service

# Copyright (c) 2022 Codecoup
# SPDX-License-Identifier: Apache-2.0

menuconfig LPKG_BT_IAS
	bool "Support for GATT Immediate Alert Service [EXPERIMENTAL]"
	select EXPERIMENTAL

if LPKG_BT_IAS

choice LPKG_BT_IAS_SEC_CHOICE
	prompt "Default permissions used for IAS characteristics"
	default LPKG_BT_IAS_SEC_NONE
	help
	  Default write permissions for IAS characteristic attributes

config LPKG_BT_IAS_SEC_NONE
	bool "No security required"

config LPKG_BT_IAS_SEC_ENC
	bool "Require encryption for write access"

config LPKG_BT_IAS_SEC_AUTH
	bool "Require encryption and authentication for write access"

endchoice #LPKG_BT_IAS_SEC_CHOICE

endif # LPKG_BT_IAS

#### Immediate Alert Service Client ################################

config LPKG_BT_IAS_CLIENT
	bool "Immediate Alert Service Client [Experimental]"
	select LPKG_BT_GATT_CLIENT
	select EXPERIMENTAL
	help
	This option enables support for Immediate Alert Service Client
```

## packages/third-party/zephyr-bluetooth/subsys/bluetooth/services/ots/Kconfig
```kconfig
# Bluetooth Object Transfer service

# Copyright (c) 2020-2022 Nordic Semiconductor ASA
# SPDX-License-Identifier: Apache-2.0

config LPKG_BT_OTS
	bool "Object Transfer Service (OTS) [EXPERIMENTAL]"
	select LPKG_BT_L2CAP_DYNAMIC_CHANNEL
	select LPKG_BT_GATT_DYNAMIC_DB
	select LPKG_BT_SMP
	select EXPERIMENTAL
	help
	  Enable Object Transfer Service.

if LPKG_BT_OTS

config LPKG_BT_OTS_DIR_LIST_OBJ
	bool "The Directory Listing Object"
	help
	  Enables the Directory Listing Object, which is an object that contains all the metadata
	  from all other objects, for easy exposure to a client. Enabling this will use one of the
	  objects given by LPKG_BT_OTS_MAX_OBJ_CNT.

config LPKG_BT_OTS_DIR_LIST_OBJ_NAME
	string "The object name of the Directory Listing Object"
	default "Directory"
	depends on LPKG_BT_OTS_DIR_LIST_OBJ
	help
	  The name of the Directory Listing Object when it is read by a client.

config LPKG_BT_OTS_MAX_INST_CNT
	int "Maximum number of available OTS instances"
	default 1
	range 1 1 if !LPKG_BT_OTS_SECONDARY_SVC

config LPKG_BT_OTS_SECONDARY_SVC
	bool "Register OTS as Secondary Service"

config LPKG_BT_OTS_OACP_CREATE_SUPPORT
	bool "Support OACP Create Operation"
	depends on LPKG_BT_OTS_OACP_WRITE_SUPPORT
	depends on LPKG_BT_OTS_OBJ_NAME_WRITE_SUPPORT

config LPKG_BT_OTS_OACP_CHECKSUM_SUPPORT
	imply CRC
	bool "Support OACP Calculate Checksum operation"

config LPKG_BT_OTS_OACP_DELETE_SUPPORT
	bool "Support OACP Delete Operation"

config LPKG_BT_OTS_OACP_READ_SUPPORT
	bool "Support OACP Read Operation"
	default y

config LPKG_BT_OTS_OACP_WRITE_SUPPORT
	bool "Support OACP Write Operation"

config LPKG_BT_OTS_OACP_PATCH_SUPPORT
	bool "Support patching of objects"
	depends on LPKG_BT_OTS_OACP_WRITE_SUPPORT

config LPKG_BT_OTS_OLCP_GO_TO_SUPPORT
	bool "Support OLCP Go To Operation"
	default y

config LPKG_BT_OTS_OBJ_NAME_WRITE_SUPPORT
	bool "Support object name write"

endif # LPKG_BT_OTS

#### Object Transfer Service Client ################################

config LPKG_BT_OTS_CLIENT
	bool "Object Transfer Service Client [Experimental]"
	select LPKG_BT_L2CAP_DYNAMIC_CHANNEL
	select LPKG_BT_GATT_CLIENT
	select LPKG_BT_GATT_AUTO_DISCOVER_CCC
	select EXPERIMENTAL
	help
	  This option enables support for the Object Transfer Service Client.

if LPKG_BT_OTS || LPKG_BT_OTS_CLIENT

config LPKG_BT_OTS_MAX_OBJ_CNT
	hex "Maximum number of objects that each service instance can store"
	default 0x05
	# Given the maximum size of a directory listing record (172) and the maximum size of an
	# object using the net_buf implementation is 2^16-1, the maximum number of objects is given
	# by 2^16-1 / 172 = 381 == 0x17D)
	range 0x02 0x17D if LPKG_BT_OTS_DIR_LIST_OBJ
	# Max obj count is otherwise the non-RFU IDs available
	range 0x01 0xFFFFFFFFFFFFFEFF

config LPKG_BT_OTS_L2CAP_CHAN_TX_MTU
	int "Size of TX MTU for Object Transfer Channel"
	default 256
	range 21 65533

config LPKG_BT_OTS_L2CAP_CHAN_RX_MTU
	int "Size of RX MTU for Object Transfer Channel"
	# RX MTU will be truncated to account for the L2CAP PDU and SDU header.
	default LPKG_BT_BUF_ACL_RX_SIZE
	range 21 LPKG_BT_BUF_ACL_RX_SIZE

config LPKG_BT_OTS_OBJ_MAX_NAME_LEN
	int "Maximum object name length"
	# Max name length allowed by OTS spec is 120 octets
	# TODO: Set separate max name length for client, as other
	# servers may use the full 120 octets.
	default 120
	range 1 120

endif # LPKG_BT_OTS || LPKG_BT_OTS_CLIENT
```

## packages/third-party/zephyr-bluetooth/tests/bluetooth/audio/ascs/Kconfig
```kconfig
# Copyright (c) 2025 Nordic Semiconductor ASA
# SPDX-License-Identifier: Apache-2.0

config LPKG_BT_ATT_PREPARE_COUNT
	int
	default 1

config LPKG_BT_AUDIO
	bool
	default y

config LPKG_BT_BONDABLE
	bool
	default y

config LPKG_BT_BUF_ACL_RX_SIZE
	int
	default 69

config LPKG_BT_BUF_ACL_TX_COUNT
	int
	default 5

config LPKG_BT_BUF_EVT_RX_COUNT
	int
	default 10

config LPKG_BT_CONN
	bool
	default y

config LPKG_BT_MAX_PAIRED
	int
	default 1

config LPKG_BT_GATT_DYNAMIC_DB
	bool
	default y

config LPKG_BT_ISO_PERIPHERAL
	bool
	default y

config LPKG_BT_ISO_MAX_CHAN
	int
	default 10

config LPKG_BT_L2CAP_TX_MTU
	int
	default 65

config LPKG_BT_LOG
	bool
	default y

config LPKG_BT_MAX_CONN
	int
	default 1

config LPKG_BT_PERIPHERAL
	bool
	default y

config LPKG_BT_SMP
	bool
	default y

# Include Zephyr's Kconfig.
source "Kconfig"
source "subsys/bluetooth/audio/Kconfig"
source "subsys/bluetooth/Kconfig.logging"
```

## packages/third-party/zephyr-bluetooth/tests/bluetooth/bt_crypto/Kconfig
```kconfig
# Copyright (c) 2022 Nordic Semiconductor ASA
# SPDX-License-Identifier: Apache-2.0

config LPKG_BT_CRYPTO
	default y

# Include Zephyr's Kconfig.
source "Kconfig"
```

## target/configs/d11x_demo68-nopsram-xip_rt-thread_helloworld_defconfig
```kconfig
CONFIG_PRJ_DEFCONFIG_FILENAME="d11x_demo68-nopsram-xip_rt-thread_helloworld_defconfig"
CONFIG_PRJ_CHIP="d11x"
CONFIG_PRJ_BOARD="demo68-nopsram-xip"
CONFIG_PRJ_KERNEL="rt-thread"
CONFIG_PRJ_APP="helloworld"
CONFIG_LVGL_V_9=y
CONFIG_LPKG_LVGL_THREAD_STACK_SIZE=4096
CONFIG_AIC_LVGL_DEMO=y
CONFIG_AIC_SPI_SCREEN_DEMO=y
CONFIG_LV_COLOR_DEPTH=16
CONFIG_LVGL_STORAGE_PATH="/ram/lvgl_data"
CONFIG_PRJ_CUSTOM_LDS="bsp/artinchip/sys/d11x/link_script/gcc_aic_nopsram.ld"
CONFIG_AIC_USING_UART1=y
CONFIG_AIC_USING_I2C1=y
CONFIG_AIC_DEV_I2C1_SPEED=100000
CONFIG_AIC_USING_QSPI0=y
CONFIG_AIC_USING_QSPI1=y
CONFIG_AIC_QSPI1_BUS_WIDTH_1=y
CONFIG_AIC_QSPI1_BUS_SPI=y
# CONFIG_AIC_USING_SDMC1 is not set
# CONFIG_AIC_USING_DE is not set
# CONFIG_AIC_USING_GE is not set
# CONFIG_AIC_USING_VE is not set
CONFIG_AIC_USING_WRI=y
CONFIG_AIC_USING_WDT=y
CONFIG_AIC_SRAM_SIZE=0xc000
CONFIG_AIC_SRAM_SW_SIZE=0xc000
CONFIG_AIC_NO_PSRAM=y
CONFIG_AIC_XIP=y
CONFIG_AIC_XIP_FW_OFFSET=0x80100
CONFIG_AIC_INTERRUPTSTACK_SIZE=0x200
CONFIG_AIC_USING_SID=y
CONFIG_AIC_SYSCFG_LDO1X_ENABLE=y
CONFIG_AIC_SYSCFG_LDO1X_VOL_VAL=8
CONFIG_IDLE_THREAD_STACK_SIZE=1024
# CONFIG_RT_KSERVICE_USING_STDLIB is not set
# CONFIG_RT_DEBUG is not set
# CONFIG_RT_USING_MEMPOOL is not set
CONFIG_RT_MEMHEAP_BSET_MODE=y
CONFIG_RT_USING_MEMHEAP_AS_HEAP=y
# CONFIG_RT_USING_MEMHEAP_AUTO_BINDING is not set
CONFIG_RT_USING_MEMTRACE=y
CONFIG_RT_CONSOLE_DEVICE_NAME="uart1"
CONFIG_RT_USING_LEGACY=y
CONFIG_FINSH_THREAD_STACK_SIZE=1024
CONFIG_FINSH_HISTORY_LINES=1
# CONFIG_RT_USING_DFS is not set
CONFIG_RT_USING_SENSOR=y
# CONFIG_RT_USING_SENSOR_CMD is not set
CONFIG_RT_USING_TOUCH=y
CONFIG_RT_TOUCH_PIN_IRQ=y
CONFIG_RT_USING_POSIX_TIMER=y
CONFIG_RT_USING_PTHREADS=y
CONFIG_RT_USING_CPLUSPLUS=y
CONFIG_RT_USING_ULOG=y
CONFIG_ULOG_OUTPUT_LVL_I=y
CONFIG_ULOG_TIME_USING_TIMESTAMP=y
CONFIG_ULOG_USING_FILTER=y
CONFIG_LPKG_USING_CPU_USAGE=y
# CONFIG_LPKG_USING_MINIMP3 is not set
# CONFIG_LPKG_MPP is not set
# CONFIG_LPKG_USING_ENV is not set
# CONFIG_AIC_USING_THREAD_STACK_TRACE is not set
CONFIG_AIC_GPIO_IRQ_DRV_EN=y
CONFIG_AIC_USING_TOUCH=y
CONFIG_AIC_TOUCH_PANEL_CST826=y
CONFIG_AIC_TOUCH_PANEL_I2C_CHAN="i2c1"
CONFIG_AIC_TOUCH_PANEL_RST_PIN="PD.4"
CONFIG_AIC_TOUCH_PANEL_INT_PIN="PD.5"
CONFIG_AIC_TOUCH_X_COORDINATE_RANGE=240
CONFIG_AIC_TOUCH_Y_COORDINATE_RANGE=240
CONFIG_AIC_SCREEN_REAL_X_RESOLUTION=240
CONFIG_AIC_SCREEN_REAL_Y_RESOLUTION=240
CONFIG_AIC_CTP_POLLING_MODE=y
```

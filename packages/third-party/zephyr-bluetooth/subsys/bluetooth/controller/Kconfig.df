## target/configs/d13x_HT68-DEMO-UART-A01-V0_rt-thread_evFunction_defconfig
```kconfig
CONFIG_PRJ_DEFCONFIG_FILENAME="d13x_HT68-DEMO-UART-A01-V0_rt-thread_evFunction_defconfig"
CONFIG_PRJ_CHIP="d13x"
CONFIG_PRJ_BOARD="HT68-DEMO-UART-A01-V0"
CONFIG_PRJ_KERNEL="rt-thread"
CONFIG_PRJ_APP="evFunction"
CONFIG_AIC_USING_HT68_DEMO_A02_V1=y
CONFIG_AIC_USING_FS_IMAGE_0=y
CONFIG_AIC_USING_FS_IMAGE_TYPE_FATFS_FOR_0=y
CONFIG_AIC_FS_IMAGE_DIR_0="rodata/"
CONFIG_AIC_FS_IMAGE_NAME_0="rodata.fatfs"
CONFIG_AIC_USING_FS_IMAGE_1=y
CONFIG_AIC_FS_IMAGE_DIR_1="data/"
CONFIG_AIC_FS_IMAGE_NAME_1="data.lfs"
CONFIG_AIC_USING_UART0=y
CONFIG_AIC_USING_I2C2=y
CONFIG_AIC_USING_USB0=y
CONFIG_AIC_USING_QSPI0=y
CONFIG_AIC_USING_QSPI2=y
CONFIG_AIC_DEV_QSPI2_MAX_SRC_FREQ_HZ=8000000
CONFIG_AIC_QSPI2_BUS_SPI=y
CONFIG_AIC_QSPI0_DEVICE_SPINOR=y
CONFIG_AIC_SDMC1_IS_SDIO=y
CONFIG_AIC_WIRELESS_LAN=y
CONFIG_AIC_WIRELESS_PWR_GPIO="PD.11"
CONFIG_AIC_WIRELESS_BT_PWR_GPIO="PD.12"
CONFIG_AIC_WLAN_REALTEK=y
CONFIG_AIC_USING_TSEN=y
CONFIG_AIC_USING_TSEN_CPU=y
CONFIG_AIC_USING_TSEN_GPAI=y
CONFIG_AIC_USING_GPAI=y
# CONFIG_AIC_USING_DE is not set
# CONFIG_AIC_USING_GE is not set
# CONFIG_AIC_USING_VE is not set
CONFIG_AIC_USING_DMA=y
CONFIG_AIC_USING_WRI=y
CONFIG_AIC_USING_RTC=y
CONFIG_AIC_USING_WDT=y
CONFIG_AIC_PSRAM_SW_SIZE=0x0
CONFIG_AIC_INTERRUPTSTACK_SIZE=4096
CONFIG_AIC_CLK_PLL_FRA0_FREQ=792000000
CONFIG_AIC_CLK_PLL_FRA2_FREQ=1188000000
CONFIG_AIC_USING_SID=y
CONFIG_AIC_SYSCFG_SIP_FLASH_ENABLE=y
CONFIG_AIC_SYSCFG_LDO1X_ENABLE=y
CONFIG_AIC_USING_MTOP=y
CONFIG_IDLE_THREAD_STACK_SIZE=1024
CONFIG_RT_TIMER_THREAD_PRIO=7
CONFIG_RT_TIMER_THREAD_STACK_SIZE=16384
# CONFIG_RT_KSERVICE_USING_STDLIB is not set
# CONFIG_RT_DEBUG is not set
CONFIG_RT_MEMHEAP_BSET_MODE=y
CONFIG_RT_USING_MEMHEAP_AS_HEAP=y
# CONFIG_RT_USING_MEMHEAP_AUTO_BINDING is not set
CONFIG_RT_CONSOLE_DEVICE_NAME="uart0"
CONFIG_RT_MAIN_THREAD_STACK_SIZE=4096
CONFIG_RT_USING_LEGACY=y
CONFIG_FINSH_HISTORY_LINES=1
CONFIG_RT_USING_DFS_MNTTABLE=y
CONFIG_RT_USING_DFS_ELMFAT=y
CONFIG_RT_DFS_ELM_LFN_UNICODE_2=y
CONFIG_RT_DFS_ELM_USE_EXFAT=y
CONFIG_RT_DFS_ELM_DRIVES=4
CONFIG_RT_DFS_ELM_MAX_SECTOR_SIZE=4096
CONFIG_RT_USING_DFS_ROMFS=y
CONFIG_RT_USING_FAL=y
# CONFIG_FAL_DEBUG_CONFIG is not set
CONFIG_FAL_USING_SFUD_PORT=y
# CONFIG_FAL_BLK_DEVICE_RDONLY is not set
CONFIG_RT_USING_SYSTEM_WORKQUEUE=y
CONFIG_RT_SYSTEM_WORKQUEUE_STACKSIZE=8192
CONFIG_RT_USING_CAN=y
CONFIG_RT_CAN_USING_HDR=y
CONFIG_RT_I2C_DEBUG=y
CONFIG_RT_USING_PWM=y
CONFIG_RT_USING_PM=y
CONFIG_PM_USING_CUSTOM_CONFIG=y
CONFIG_PM_ENABLE_SUSPEND_SLEEP_MODE=y
CONFIG_PM_ENABLE_THRESHOLD_SLEEP_MODE=y
CONFIG_RT_SDIO_STACK_SIZE=16384
CONFIG_RT_SDIO_THREAD_PRIORITY=5
CONFIG_RT_MMCSD_STACK_SIZE=8192
CONFIG_RT_SFUD_USING_QSPI=y
CONFIG_RT_USING_AUDIO=y
CONFIG_RT_USING_TOUCH=y
CONFIG_RT_TOUCH_PIN_IRQ=y
CONFIG_RT_USING_WIFI=y
CONFIG_RT_WLAN_PROT_LWIP_PBUF_FORCE=y
CONFIG_RT_WLAN_WORKQUEUE_THREAD_SIZE=4096
CONFIG_RT_WLAN_DEBUG=y
CONFIG_RT_WLAN_CMD_DEBUG=y
CONFIG_RT_USING_PTHREADS=y
CONFIG_RT_USING_NETDEV=y
CONFIG_RT_USING_ULOG=y
CONFIG_ULOG_OUTPUT_LVL_I=y
# CONFIG_ULOG_OUTPUT_TIME is not set
CONFIG_ULOG_USING_FILTER=y
CONFIG_PKG_USING_RT_VSNPRINTF_FULL=y
CONFIG_LPKG_USING_CPU_USAGE=y
CONFIG_LPKG_USING_LITTLEFS=y
CONFIG_LPKG_USING_I2C_TOOLS=y
CONFIG_LPKG_USING_FREETYPE=y
# CONFIG_LPKG_MPP is not set
CONFIG_LPKG_USING_OTA_DOWNLOADER=y
CONFIG_OTA_DOWNLOADER_DEBUG=y
CONFIG_AIC_GPIO_IRQ_DRV_EN=y
CONFIG_AIC_I2C_INTERRUPT_MODE=y
CONFIG_AIC_USING_RGB_LED=y
CONFIG_AIC_RGB_LED_WS2812B=y
CONFIG_AIC_USING_SENSOR=y
CONFIG_AIC_USE_SENSOR_BMP180=y
CONFIG_AIC_I2C_DRV_DEBUG=y
CONFIG_AIC_CMU_DRV_TEST=y
CONFIG_AIC_GPIO_DRV_TEST=y
CONFIG_AIC_GPIO_KEY_TEST=y
CONFIG_AIC_DMA_DRV_TEST=y
CONFIG_AIC_I2C_DRV_TEST=y
```

## target/configs/d21x_EzUIX1-DEMO-V1_rt-thread_Function_defconfig
```kconfig
CONFIG_PRJ_DEFCONFIG_FILENAME="d21x_EzUIX1-DEMO-V1_rt-thread_Function_defconfig"
CONFIG_PRJ_CHIP="d21x"
CONFIG_PRJ_BOARD="EzUIX1-DEMO-V1"
CONFIG_PRJ_KERNEL="rt-thread"
CONFIG_PRJ_APP="evFunction"
CONFIG_AIC_USING_D213ECV_EzUIX1_DEMO_V1=y
CONFIG_AIC_USING_FS_IMAGE_0=y
CONFIG_AIC_USING_FS_IMAGE_TYPE_FATFS_FOR_0=y
CONFIG_AIC_FS_IMAGE_DIR_0="rodata/"
CONFIG_AIC_FS_IMAGE_NAME_0="rodata.fatfs"
CONFIG_AIC_LVGL_DEMO=y
CONFIG_AIC_LVGL_SLIDE_DEMO=y
CONFIG_AIC_USING_UART0=y
CONFIG_AIC_USING_UART1=y
CONFIG_AIC_USING_UART3=y
CONFIG_AIC_USING_I2C3=y
CONFIG_AIC_USING_PWM3=y
CONFIG_AIC_USING_CAN0=y
CONFIG_AIC_USING_CIR=y
CONFIG_AIC_USING_USB0=y
CONFIG_AIC_USING_USB0_HOST=y
# CONFIG_AIC_USING_USB1 is not set
CONFIG_AIC_USING_QSPI0=y
CONFIG_AIC_QSPI0_DEVICE_SPINAND=y
CONFIG_AIC_QSPI0_DEVICE_SPINAND_CONT_READ=y
CONFIG_AIC_USING_SDMC2=y
CONFIG_AIC_SDMC1_USING_HOTPLUG=y
CONFIG_AIC_SDMC2_IS_SDIO=y
CONFIG_AIC_SDMC2_CLK_FREQ=40000000
CONFIG_AIC_WIRELESS_LAN=y
CONFIG_AIC_WLAN_REALTEK=y
CONFIG_AIC_DEV_REALTEK_WLAN0_PWR_GPIO="PB.8"
CONFIG_AIC_USING_TSEN=y
CONFIG_AIC_USING_GPAI=y
CONFIG_AIC_USING_GPAI7=y
CONFIG_AIC_PAN_DISPLAY=y
CONFIG_AIC_PANEL_RGB_H035A17=y
CONFIG_AIC_PWM_BACKLIGHT=y
CONFIG_AIC_USING_DMA=y
CONFIG_AIC_USING_WRI=y
CONFIG_AIC_USING_RTC=y
CONFIG_AIC_USING_WDT=y
CONFIG_AIC_DRAM_CMA_SIZE=0x2000000
CONFIG_AIC_INTERRUPTSTACK_SIZE=4096
CONFIG_AIC_USING_SID=y
CONFIG_RT_TIMER_THREAD_PRIO=7
CONFIG_RT_TIMER_THREAD_STACK_SIZE=8192
# CONFIG_RT_KSERVICE_USING_STDLIB is not set
# CONFIG_RT_KPRINTF_USING_LONGLONG is not set
# CONFIG_RT_DEBUG is not set
CONFIG_RT_USING_MEMHEAP_AS_HEAP=y
# CONFIG_RT_USING_MEMHEAP_AUTO_BINDING is not set
CONFIG_RT_USING_DEVICE_OPS=y
CONFIG_RT_CONSOLE_DEVICE_NAME="uart1"
CONFIG_RT_MAIN_THREAD_STACK_SIZE=4096
CONFIG_RT_USING_LEGACY=y
CONFIG_FINSH_HISTORY_LINES=1
CONFIG_DFS_FILESYSTEMS_MAX=8
CONFIG_RT_USING_DFS_MNTTABLE=y
CONFIG_RT_USING_DFS_ELMFAT=y
CONFIG_RT_DFS_ELM_LFN_UNICODE_2=y
CONFIG_RT_DFS_ELM_USE_EXFAT=y
CONFIG_RT_DFS_ELM_DRIVES=4
CONFIG_RT_USING_DFS_DEVFS=y
CONFIG_RT_USING_DFS_ROMFS=y
CONFIG_RT_USING_SYSTEM_WORKQUEUE=y
CONFIG_RT_SYSTEM_WORKQUEUE_STACKSIZE=8192
CONFIG_RT_I2C_DEBUG=y
CONFIG_RT_USING_PM=y
CONFIG_PM_USING_CUSTOM_CONFIG=y
CONFIG_PM_ENABLE_SUSPEND_SLEEP_MODE=y
CONFIG_PM_ENABLE_THRESHOLD_SLEEP_MODE=y
CONFIG_RT_SDIO_STACK_SIZE=16384
CONFIG_RT_SDIO_THREAD_PRIORITY=5
CONFIG_RT_MMCSD_STACK_SIZE=8192
CONFIG_RT_MMCSD_THREAD_PRIORITY=20
CONFIG_RT_USING_TOUCH=y
CONFIG_RT_TOUCH_PIN_IRQ=y
CONFIG_RT_USING_WIFI=y
CONFIG_RT_WLAN_PROT_LWIP_PBUF_FORCE=y
CONFIG_RT_WLAN_DEBUG=y
CONFIG_RT_WLAN_CMD_DEBUG=y
CONFIG_RT_USING_POSIX_FS=y
CONFIG_RT_USING_NETDEV=y
CONFIG_RT_LWIP_TCPTHREAD_PRIORITY=13
CONFIG_RT_LWIP_TCPTHREAD_STACKSIZE=8192
CONFIG_RT_USING_ULOG=y
CONFIG_ULOG_OUTPUT_LVL_I=y
# CONFIG_ULOG_OUTPUT_TIME is not set
CONFIG_ULOG_OUTPUT_THREAD_NAME=y
CONFIG_ULOG_USING_FILTER=y
CONFIG_LPKG_USING_BONNIE=y
CONFIG_LPKG_USING_CPU_USAGE=y
CONFIG_LPKG_USING_CHERRYUSB=y
CONFIG_LPKG_USING_I2C_TOOLS=y
CONFIG_LPKG_USING_CJSON=y
CONFIG_LPKG_USING_MBEDTLS=y
CONFIG_AIC_MPP_PLAYER_INTERFACE=y
CONFIG_AIC_MPP_AICP_DEC_ENABLE=y
CONFIG_LPKG_USING_OTA_DOWNLOADER=y
CONFIG_OTA_DOWNLOADER_DEBUG=y
CONFIG_AIC_GPIO_IRQ_DRV_EN=y
CONFIG_AIC_I2C_INTERRUPT_MODE=y
CONFIG_AIC_NFTL_SUPPORT=y
CONFIG_AIC_NFLT_USED_LIB=y
CONFIG_AIC_USING_TOUCH=y
CONFIG_AIC_UART_DRV_DEBUG=y
CONFIG_AIC_I2C_DRV_DEBUG=y
CONFIG_AIC_FB_DRV_DEBUG=y
CONFIG_AIC_DMA_DRV_TEST=y
CONFIG_AIC_RTC_DRV_TEST=y
CONFIG_AIC_TP_DRV_TEST=y
```

## target/configs/d21x_H215-DEMO-A02-V0_rt-thread_evFunction_defconfig
```kconfig
CONFIG_PRJ_DEFCONFIG_FILENAME="d21x_H215-DEMO-A02-V0_rt-thread_evFunction_defconfig"
CONFIG_PRJ_CHIP="d21x"
CONFIG_PRJ_BOARD="H215-DEMO-A02-V0"
CONFIG_PRJ_KERNEL="rt-thread"
CONFIG_PRJ_APP="evFunction"
CONFIG_AIC_USING_H215_DEMO_A02_V0=y
CONFIG_AIC_USING_FS_IMAGE_0=y
CONFIG_AIC_USING_FS_IMAGE_TYPE_FATFS_FOR_0=y
CONFIG_AIC_FS_IMAGE_DIR_0="rodata/"
CONFIG_AIC_FS_IMAGE_NAME_0="rodata.fatfs"
CONFIG_AIC_USING_UART0=y
CONFIG_AIC_USING_UART1=y
CONFIG_AIC_USING_I2C3=y
CONFIG_AIC_USING_PWM3=y
CONFIG_AIC_USING_USB0=y
# CONFIG_AIC_USING_USB1 is not set
CONFIG_AIC_USING_QSPI0=y
CONFIG_AIC_QSPI0_DEVICE_SPINAND=y
# CONFIG_AIC_USING_SDMC1 is not set
CONFIG_AIC_USING_TSEN=y
CONFIG_AIC_USING_TSEN_CPU=y
CONFIG_AIC_USING_TSEN_GPAI=y
CONFIG_AIC_USING_GPAI=y
CONFIG_AIC_USING_GPAI7=y
CONFIG_AIC_PAN_DISPLAY=y
CONFIG_AIC_PWM_BACKLIGHT=y
CONFIG_AIC_PWM_BRIGHTNESS_LEVEL=20
CONFIG_AIC_USING_DMA=y
CONFIG_AIC_USING_WRI=y
CONFIG_AIC_USING_RTC=y
CONFIG_AIC_USING_WDT=y
CONFIG_AIC_DRAM_TOTAL_SIZE=0x4000000
CONFIG_AIC_DRAM_CMA_SIZE=0x3000000
CONFIG_AIC_INTERRUPTSTACK_SIZE=4096
CONFIG_AIC_USING_SID=y
CONFIG_AIC_USING_MTOP=y
CONFIG_IDLE_THREAD_STACK_SIZE=2048
# CONFIG_RT_USING_TIMER_SOFT is not set
# CONFIG_RT_KSERVICE_USING_STDLIB is not set
# CONFIG_RT_KPRINTF_USING_LONGLONG is not set
# CONFIG_RT_DEBUG is not set
CONFIG_RT_MEMHEAP_BSET_MODE=y
CONFIG_RT_USING_MEMHEAP_AS_HEAP=y
# CONFIG_RT_USING_MEMHEAP_AUTO_BINDING is not set
CONFIG_RT_USING_DEVICE_OPS=y
CONFIG_RT_CONSOLE_DEVICE_NAME="uart0"
CONFIG_RT_MAIN_THREAD_STACK_SIZE=4096
CONFIG_RT_USING_LEGACY=y
CONFIG_FINSH_HISTORY_LINES=1
CONFIG_DFS_FILESYSTEMS_MAX=8
CONFIG_RT_USING_DFS_MNTTABLE=y
CONFIG_RT_USING_DFS_ELMFAT=y
CONFIG_RT_DFS_ELM_LFN_UNICODE_2=y
CONFIG_RT_DFS_ELM_USE_EXFAT=y
CONFIG_RT_DFS_ELM_DRIVES=4
CONFIG_RT_USING_DFS_DEVFS=y
CONFIG_RT_USING_DFS_ROMFS=y
CONFIG_RT_USING_CAN=y
CONFIG_RT_CAN_USING_HDR=y
CONFIG_RT_I2C_DEBUG=y
CONFIG_RT_USING_PM=y
CONFIG_PM_USING_CUSTOM_CONFIG=y
CONFIG_PM_ENABLE_SUSPEND_SLEEP_MODE=y
CONFIG_PM_ENABLE_THRESHOLD_SLEEP_MODE=y
CONFIG_RT_USING_SDIO=y
CONFIG_RT_MMCSD_STACK_SIZE=8192
CONFIG_RT_AUDIO_REPLAY_MP_BLOCK_SIZE=192
CONFIG_RT_AUDIO_REPLAY_MP_BLOCK_COUNT=20
CONFIG_RT_USING_TOUCH=y
CONFIG_RT_TOUCH_PIN_IRQ=y
CONFIG_RT_HWCRYPTO_USING_AES=y
CONFIG_RT_HWCRYPTO_USING_AES_CBC=y
CONFIG_RT_HWCRYPTO_USING_MD5=y
CONFIG_RT_HWCRYPTO_USING_SHA1=y
CONFIG_RT_HWCRYPTO_USING_SHA2=y
CONFIG_RT_HWCRYPTO_USING_SHA2_224=y
CONFIG_RT_HWCRYPTO_USING_SHA2_384=y
CONFIG_RT_HWCRYPTO_USING_SHA2_512=y
CONFIG_RT_USING_POSIX_FS=y
CONFIG_RT_USING_ULOG=y
CONFIG_ULOG_OUTPUT_LVL_I=y
CONFIG_ULOG_TIME_USING_TIMESTAMP=y
CONFIG_ULOG_USING_FILTER=y
CONFIG_LPKG_USING_BONNIE=y
CONFIG_LPKG_USING_CPU_USAGE=y
CONFIG_LPKG_USING_CHERRYUSB=y
CONFIG_LPKG_CHERRYUSB_DEVICE=y
CONFIG_LPKG_CHERRYUSB_DEVICE_COMPOSITE=y
CONFIG_LPKG_USING_COMP_DISP_TABLE1=y
CONFIG_LPKG_USING_COMP_HID_TABLE1=y
CONFIG_LPKG_CHERRYUSB_DEVICE_HID_TOUCH_TEMPLATE=y
CONFIG_LPKG_CHERRYUSB_DEVICE_DISPLAY_TEMPLATE=y
CONFIG_AIC_USB_DISP_JPEG_QUALITY_LOWTHRESH=6
CONFIG_AIC_USB_DISP_INIT_DELAY_MS=1000
CONFIG_LPKG_USING_I2C_TOOLS=y
CONFIG_LPKG_USING_CJSON=y
CONFIG_AIC_MPP_PLAYER_INTERFACE=y
CONFIG_LPKG_USING_OTA_DOWNLOADER=y
CONFIG_AIC_GPIO_IRQ_DRV_EN=y
CONFIG_AIC_I2C_INTERRUPT_MODE=y
CONFIG_AIC_NFTL_SUPPORT=y
CONFIG_AIC_NFLT_USED_LIB=y
CONFIG_AIC_USING_TOUCH=y
CONFIG_AIC_TOUCH_X_COORDINATE_RANGE=480
CONFIG_AIC_TOUCH_Y_COORDINATE_RANGE=272
CONFIG_AIC_SCREEN_REAL_X_RESOLUTION=480
CONFIG_AIC_SCREEN_REAL_Y_RESOLUTION=272
CONFIG_AIC_UART_DRV_DEBUG=y
CONFIG_AIC_FB_DRV_DEBUG=y
CONFIG_AIC_CMU_DRV_TEST=y
CONFIG_AIC_GPIO_DRV_TEST=y
CONFIG_AIC_DMA_DRV_TEST=y
CONFIG_AIC_RTC_DRV_TEST=y
# CONFIG_AIC_MTOP_DRV_TEST is not set
CONFIG_AIC_TSEN_TEST=y
```

## target/configs/g72x_demo48-nor_baremetal_bootloader_defconfig
```kconfig
CONFIG_PRJ_DEFCONFIG_FILENAME="g72x_demo48-nor_baremetal_bootloader_defconfig"
CONFIG_PRJ_CHIP="g72x"
CONFIG_PRJ_BOARD="demo48-nor"
CONFIG_PRJ_KERNEL="baremetal"
CONFIG_PRJ_APP="bootloader"
CONFIG_PRJ_CUSTOM_LDS="application/baremetal/bootloader/ldscript/g72x_bootloader_gcc.ld"
CONFIG_AIC_USING_UART0=y
CONFIG_AIC_CLK_UART0_FREQ=60000000
CONFIG_AIC_USING_QSPI0=y
CONFIG_AIC_QSPI0_DEVICE_SPINOR=y
# CONFIG_AIC_USING_GE is not set
# CONFIG_AIC_USING_VE is not set
CONFIG_AIC_USING_WRI=y
CONFIG_AIC_USING_RTC=y
CONFIG_AIC_USING_WDT=y
CONFIG_AIC_SRAM_SIZE=0xA000
CONFIG_AIC_PSRAM_SIZE=0x400000
CONFIG_AIC_PSRAM_SW_SIZE=0x400000
CONFIG_AIC_INTERRUPTSTACK_SIZE=8192
CONFIG_AIC_CLK_PLL_INT0_FREQ=960000000
CONFIG_AIC_CLK_PLL_FRA0_FREQ=792000000
CONFIG_AIC_CLK_PLL_FRA2_FREQ=1200000000
CONFIG_AIC_CLK_CPU_FREQ=240000000
CONFIG_AIC_USING_SID=y
CONFIG_EFUSE_WRITE_SUPPORT=y
CONFIG_AIC_SYSCFG_SIP_FLASH_ENABLE=y
CONFIG_AIC_SYSCFG_LDO1X_ENABLE=y
CONFIG_AIC_NORMALSTACK_SIZE=8192
# CONFIG_AIC_BOOTLOADER_SPINAND_SUPPORT is not set
CONFIG_AICUPG_SINGLE_TRANS_BURN_CRC32_VERIFY=y
CONFIG_AICUPG_SDCARD_ENABLE=y
CONFIG_AICUPG_NOR_ARTINCHIP=y
# CONFIG_AICUPG_LOG_BUFFER_SUPPORT is not set
CONFIG_AIC_BOOTLOADER_CMD_NOR_BOOT=y
CONFIG_AIC_BOOTLOADER_CMD_SPI_NOR=y
CONFIG_AIC_BOOTLOADER_CMD_MTD=y
CONFIG_LPKG_CHERRYUSB_DEVICE_CLASS_AIC_SINGLE=y
# CONFIG_LPKG_MPP is not set
CONFIG_LPKG_USING_SFUD=y
CONFIG_AIC_LOG_LEVEL_INFO=y
CONFIG_AIC_MMC_BARE_TEST=y
CONFIG_AIC_SID_BARE_TEST=y
```

## target/configs/g72x_demo48-nor_rt-thread_helloworld_defconfig
```kconfig
CONFIG_PRJ_DEFCONFIG_FILENAME="g72x_demo48-nor_rt-thread_helloworld_defconfig"
CONFIG_PRJ_CHIP="g72x"
CONFIG_PRJ_BOARD="demo48-nor"
CONFIG_PRJ_KERNEL="rt-thread"
CONFIG_PRJ_APP="helloworld"
CONFIG_AIC_USING_UART0=y
CONFIG_AIC_CLK_UART0_FREQ=60000000
CONFIG_AIC_USING_I2C1=y
CONFIG_AIC_USING_QSPI0=y
CONFIG_AIC_QSPI0_DEVICE_SPINOR=y
CONFIG_AIC_USING_SDMC0=y
# CONFIG_AIC_USING_SDMC1 is not set
CONFIG_AIC_SDMC_IRQ_MODE=y
CONFIG_AIC_SDMC0_SMP_PHASE=1
CONFIG_AIC_USING_TSEN=y
CONFIG_AIC_USING_TSEN_CPU=y
CONFIG_AIC_USING_GPAI=y
CONFIG_AIC_USING_GPAI0=y
CONFIG_AIC_USING_GPAI7=y
CONFIG_AIC_GPAI0_MODE_SINGLE=y
CONFIG_AIC_GPAI7_MODE_SINGLE=y
CONFIG_AIC_PRGB_18BIT_LD=y
CONFIG_RGB_DATA_MIRROT=y
CONFIG_AIC_PANEL_CUSTOM_RESOLUTION=y
CONFIG_PANEL_HBP=140
CONFIG_PANEL_HFP=130
CONFIG_PANEL_VBP=20
CONFIG_PANEL_VSW=3
CONFIG_AIC_SIMPLE_PANEL_POWER_GPIO=y
CONFIG_AIC_SIMPLE_PANEL_POWER_GPIO_LOW_ACTIVE=y
CONFIG_AIC_PANEL_ENABLE_GPIO="PE.16"
# CONFIG_AIC_USING_GE is not set
# CONFIG_AIC_USING_VE is not set
CONFIG_AIC_USING_DVP=y
CONFIG_AIC_USING_I2S0=y
CONFIG_AIC_USING_AUDIO=y
CONFIG_AIC_AUDIO_PA_ENABLE_GPIO="PE.17"
CONFIG_AIC_AUDIO_SPK0_OUTPUT_DIFFERENTIAL=y
CONFIG_AIC_USING_DMA=y
CONFIG_AIC_USING_WRI=y
CONFIG_AIC_USING_RTC=y
CONFIG_AIC_USING_WDT=y
CONFIG_AIC_PSRAM_SIZE=0x400000
CONFIG_AIC_INTERRUPTSTACK_SIZE=4096
CONFIG_AIC_SYSCFG_SIP_FLASH_ENABLE=y
CONFIG_AIC_SYSCFG_LDO1X_ENABLE=y
CONFIG_RT_NAME_MAX=8
CONFIG_IDLE_THREAD_STACK_SIZE=1024
# CONFIG_RT_USING_TIMER_SOFT is not set
# CONFIG_RT_KSERVICE_USING_STDLIB is not set
# CONFIG_RT_DEBUG is not set
CONFIG_RT_MEMHEAP_BSET_MODE=y
CONFIG_RT_USING_MEMHEAP_AS_HEAP=y
# CONFIG_RT_USING_MEMHEAP_AUTO_BINDING is not set
CONFIG_RT_CONSOLE_DEVICE_NAME="uart0"
CONFIG_RT_USING_LEGACY=y
CONFIG_FINSH_HISTORY_LINES=1
CONFIG_RT_USING_DFS_MNTTABLE=y
CONFIG_RT_USING_DFS_ELMFAT=y
CONFIG_RT_USING_DFS_ROMFS=y
CONFIG_RT_MMCSD_STACK_SIZE=8192
CONFIG_RT_SFUD_USING_QSPI=y
CONFIG_RT_USING_TOUCH=y
CONFIG_RT_USING_POSIX_FS=y
CONFIG_RT_USING_POSIX_CLOCK=y
CONFIG_RT_USING_ULOG=y
CONFIG_ULOG_OUTPUT_LVL_I=y
CONFIG_ULOG_TIME_USING_TIMESTAMP=y
CONFIG_ULOG_USING_FILTER=y
CONFIG_LPKG_USING_CPU_USAGE=y
CONFIG_LPKG_USING_CHERRYUSB=y
CONFIG_LPKG_USING_I2C_TOOLS=y
CONFIG_LPKG_USING_MHZ=y
# CONFIG_LPKG_USING_MINIMP3 is not set
CONFIG_AIC_MPP_VIN=y
CONFIG_LPKG_USING_PINMUX_CHECHK=y
CONFIG_AIC_PINMUX_CHECK=y
CONFIG_AIC_USING_BARCODE_DEMO=y
# CONFIG_AIC_BARCODE_BEEP is not set
CONFIG_AIC_GPIO_IRQ_DRV_EN=y
CONFIG_AIC_USING_CAMERA=y
CONFIG_AIC_USING_CAMERA_SC035HGS=y
CONFIG_AIC_CAMERA_RST_PIN="PA.8"
CONFIG_AIC_CAMERA_PWDN_PIN="PA.9"
# CONFIG_AIC_I2S_CODEC_TLV320 is not set
CONFIG_AIC_I2S_CODEC_JY6311=y
CONFIG_AIC_I2S_CODEC_JY6311_I2C="i2c1"
CONFIG_AIC_I2S_CODEC_PA_PIN="PE.17"
CONFIG_AIC_CMU_DRV_TEST=y
CONFIG_AIC_WDT_DRV_TEST=y
```

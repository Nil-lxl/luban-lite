## target/configs/d13x_hspi100-nor_rt-thread_helloworld_defconfig
```kconfig
CONFIG_PRJ_DEFCONFIG_FILENAME="d13x_hspi100-nor_rt-thread_helloworld_defconfig"
CONFIG_PRJ_CHIP="d13x"
CONFIG_PRJ_BOARD="hspi100-nor"
CONFIG_PRJ_KERNEL="rt-thread"
CONFIG_PRJ_APP="helloworld"
CONFIG_AIC_USING_FS_IMAGE_0=y
CONFIG_AIC_USING_FS_IMAGE_TYPE_FATFS_FOR_0=y
CONFIG_AIC_FS_IMAGE_DIR_0="packages/artinchip/lvgl-ui/aic_demo/demo_hub/assets/480x272"
CONFIG_AIC_FS_IMAGE_NAME_0="rodata.fatfs"
CONFIG_AIC_USING_FS_IMAGE_1=y
CONFIG_AIC_FS_IMAGE_DIR_1="packages/artinchip/lvgl-ui/aic_demo/demo_hub/app/navigation"
CONFIG_AIC_FS_IMAGE_NAME_1="data.lfs"
CONFIG_AIC_FATFS_ENABLE_WRITE_IN_SPINOR=y
CONFIG_LVGL_V_9=y
CONFIG_LPKG_LVGL_THREAD_STACK_SIZE=32768
CONFIG_AIC_LVGL_DEMO=y
CONFIG_AIC_LVGL_DEMO_HUB_DEMO=y
CONFIG_LV_COLOR_DEPTH=16
CONFIG_LV_CACHE_IMG_NUM=8
CONFIG_AIC_USING_UART0=y
CONFIG_AIC_USING_UART1=y
CONFIG_AIC_USING_UART2=y
CONFIG_AIC_USING_UART3=y
CONFIG_AIC_USING_I2C0=y
CONFIG_AIC_USING_I2C2=y
CONFIG_AIC_USING_PWM2=y
CONFIG_AIC_USING_PWM3=y
CONFIG_AIC_USING_EPWM10=y
CONFIG_AIC_USING_USB0=y
CONFIG_AIC_USING_USB0_HOST=y
CONFIG_AIC_USING_QSPI0=y
CONFIG_AIC_USING_QSPI3=y
CONFIG_AIC_QSPI0_DEVICE_SPINOR=y
CONFIG_AIC_USING_SDMC0=y
CONFIG_AIC_SDMC_IRQ_MODE=y
CONFIG_AIC_WIRELESS_LAN=y
CONFIG_AIC_WLAN_REALTEK=y
CONFIG_AIC_USING_RTL8189_WLAN0=y
CONFIG_AIC_DEV_REALTEK_WLAN0_PWR_GPIO="PC.7"
CONFIG_AIC_USING_TSEN=y
CONFIG_AIC_USING_TSEN_CPU=y
CONFIG_AIC_USING_TSEN_GPAI=y
CONFIG_AIC_USING_GPAI=y
CONFIG_DATA_ORDER_BGR=y
CONFIG_AIC_DEGREE_90=y
# CONFIG_RGB_DATA_MIRROT is not set
CONFIG_AICFB_RGB565=y
CONFIG_AIC_PAN_DISPLAY=y
CONFIG_AIC_PWM_BACKLIGHT=y
CONFIG_AIC_PWM_BACKLIGHT_CHANNEL=2
CONFIG_AIC_GE_CMDQ=y
CONFIG_AIC_USING_DVP=y
CONFIG_AIC_USING_DMA=y
CONFIG_AIC_USING_WRI=y
CONFIG_AIC_USING_RTC=y
CONFIG_AIC_USING_WDT=y
CONFIG_AIC_PSRAM_SW_SIZE=0x0
CONFIG_AIC_INTERRUPTSTACK_SIZE=4096
CONFIG_AIC_CLK_PLL_FRA0_FREQ=792000000
CONFIG_AIC_CLK_PLL_FRA2_FREQ=1188000000
CONFIG_AIC_USING_CLK_OUT1=y
CONFIG_AIC_USING_SID=y
CONFIG_AIC_USING_MTOP=y
CONFIG_AIC_USING_PSADC=y
CONFIG_IDLE_THREAD_STACK_SIZE=1024
CONFIG_RT_TIMER_THREAD_STACK_SIZE=4096
# CONFIG_RT_KSERVICE_USING_STDLIB is not set
# CONFIG_RT_DEBUG is not set
CONFIG_RT_MEMHEAP_BSET_MODE=y
CONFIG_RT_USING_MEMHEAP_AS_HEAP=y
# CONFIG_RT_USING_MEMHEAP_AUTO_BINDING is not set
CONFIG_RT_CONSOLE_DEVICE_NAME="uart0"
CONFIG_FINSH_THREAD_STACK_SIZE=4096
CONFIG_FINSH_HISTORY_LINES=1
CONFIG_DFS_FILESYSTEMS_MAX=8
CONFIG_RT_USING_DFS_MNTTABLE=y
CONFIG_RT_USING_DFS_ELMFAT=y
CONFIG_RT_DFS_ELM_LFN_UNICODE_2=y
CONFIG_RT_DFS_ELM_USE_EXFAT=y
CONFIG_RT_DFS_ELM_DRIVES=4
CONFIG_RT_DFS_ELM_MAX_SECTOR_SIZE=4096
CONFIG_RT_USING_DFS_ROMFS=y
CONFIG_RT_USING_FAL=y
# CONFIG_FAL_DEBUG_CONFIG is not set
CONFIG_FAL_USING_SFUD_PORT=y
# CONFIG_FAL_BLK_DEVICE_RDONLY is not set
CONFIG_RT_USING_CAN=y
CONFIG_RT_CAN_USING_HDR=y
CONFIG_RT_USING_PM=y
CONFIG_PM_USING_CUSTOM_CONFIG=y
CONFIG_PM_ENABLE_SUSPEND_SLEEP_MODE=y
CONFIG_PM_ENABLE_THRESHOLD_SLEEP_MODE=y
CONFIG_RT_SDIO_STACK_SIZE=4096
CONFIG_RT_SDIO_THREAD_PRIORITY=5
CONFIG_RT_MMCSD_STACK_SIZE=8192
CONFIG_RT_SFUD_USING_QSPI=y
CONFIG_RT_USING_TOUCH=y
CONFIG_RT_TOUCH_PIN_IRQ=y
CONFIG_RT_USING_INPUT_CAPTURE=y
CONFIG_RT_USING_ULOG=y
CONFIG_ULOG_OUTPUT_LVL_I=y
CONFIG_ULOG_TIME_USING_TIMESTAMP=y
CONFIG_ULOG_USING_FILTER=y
CONFIG_LPKG_USING_CPU_USAGE=y
CONFIG_LPKG_USING_LWIP=y
CONFIG_LPKG_LWIP_EXAMPLES=y
CONFIG_LPKG_USING_NETTOOLS=y
CONFIG_LPKG_LWIP_DNS=y
CONFIG_LPKG_LWIP_DHCP=y
CONFIG_LPKG_LWIP_TCP_SND_BUF=8196
CONFIG_LPKG_LWIP_TCP_WND=8196
CONFIG_LPKG_LWIP_USING_PING=y
CONFIG_LPKG_USING_LITTLEFS=y
CONFIG_LFS_READ_SIZE=256
CONFIG_AIC_MPP_PLAYER_INTERFACE=y
CONFIG_AIC_MPP_VIN=y
CONFIG_AIC_GPIO_IRQ_DRV_EN=y
CONFIG_AIC_USING_CAMERA=y
CONFIG_AIC_CAMERA_RST_PIN="PA.2"
CONFIG_AIC_CAMERA_PWDN_PIN="PA.3"
CONFIG_AIC_USING_TOUCH=y
CONFIG_AIC_TOUCH_PANEL_I2C_CHAN="i2c2"
CONFIG_AIC_TOUCH_PANEL_RST_PIN="PA.10"
CONFIG_AIC_TOUCH_PANEL_INT_PIN="PA.11"
CONFIG_AIC_CMU_DRV_TEST=y
CONFIG_AIC_GPIO_DRV_TEST=y
CONFIG_AIC_DMA_DRV_TEST=y
CONFIG_AIC_AUDIO_DRV_TEST=y
CONFIG_AIC_DVP_TEST=y
CONFIG_AIC_GPAI_TEST=y
CONFIG_AIC_TSEN_TEST=y
CONFIG_AIC_IPERF_LWIP_TEST=y
CONFIG_AIC_ETH_LOOPBACK_LWIP_TEST=y
```

## target/configs/d21x_EzUIX1-DEMO_baremetal_bootloader_defconfig
```kconfig
CONFIG_PRJ_DEFCONFIG_FILENAME="d21x_demo128-nand_baremetal_bootloader_defconfig"
CONFIG_PRJ_CHIP="d21x"
CONFIG_PRJ_BOARD="demo128-nand"
CONFIG_PRJ_KERNEL="baremetal"
CONFIG_PRJ_APP="bootloader"
CONFIG_PRJ_CUSTOM_LDS="application/baremetal/bootloader/ldscript/d21x_bootloader_gcc.ld"
CONFIG_AIC_USING_UART0=y
# CONFIG_AIC_USING_USB1 is not set
CONFIG_AIC_USING_QSPI0=y
CONFIG_AIC_QSPI0_DEVICE_SPINAND=y
CONFIG_AIC_QSPI0_DEVICE_SPINAND_CONT_READ=y
CONFIG_AIC_WIRELESS_LAN=y
CONFIG_AIC_DISP_LVDS=y
CONFIG_AICFB_RGB565=y
CONFIG_AIC_PANEL_ENABLE_GPIO="PC.7"
CONFIG_AIC_SCREEN_CROP=y
CONFIG_AIC_SCREEN_CROP_POS_Y=260
CONFIG_AIC_SCREEN_CROP_WIDTH=1024
CONFIG_AIC_SCREEN_CROP_HEIGHT=80
# CONFIG_AIC_USING_GE is not set
# CONFIG_AIC_USING_VE is not set
CONFIG_AIC_USING_DMA=y
CONFIG_AIC_USING_WRI=y
CONFIG_AIC_USING_RTC=y
CONFIG_AIC_USING_WDT=y
CONFIG_AIC_INTERRUPTSTACK_SIZE=8192
CONFIG_AIC_NORMALSTACK_SIZE=8192
CONFIG_AIC_BOOTLOADER_TEXT_SIZE=0x7FF00
CONFIG_AIC_BOOTLOADER_HEAP_SIZE=0x400000
# CONFIG_AIC_BOOTLOADER_SPINOR_SUPPORT is not set
CONFIG_AICUPG_SDCARD_ENABLE=y
CONFIG_AICUPG_UDISK_ENABLE=y
CONFIG_AICUPG_MMC_ARTINCHIP=y
CONFIG_AICUPG_NAND_ARTINCHIP=y
CONFIG_AIC_BOOTLOADER_CMD_NAND_BOOT=y
# CONFIG_AIC_BOOTLOADER_CMD_MEM is not set
CONFIG_AIC_BOOTLOADER_CMD_PART=y
CONFIG_AIC_BOOTLOADER_CMD_PROGRESS_BAR=y
CONFIG_AIC_BOOTLOADER_CMD_FB_CONSOLE=y
# CONFIG_LPKG_MPP is not set
CONFIG_AIC_ENV_INTERFACE=y
# CONFIG_AIC_AB_SYSTEM_INTERFACE is not set
CONFIG_AIC_NFTL_SUPPORT=y
CONFIG_AIC_NFLT_USED_LIB=y
CONFIG_AIC_SPINAND_DRV_TEST=y
CONFIG_AIC_MTD_BARE_TEST=y
```

## target/configs/d21x_d215-demo88-nand_baremetal_bootloader_defconfig
```kconfig
CONFIG_PRJ_DEFCONFIG_FILENAME="d21x_d215-demo88-nand_baremetal_bootloader_defconfig"
CONFIG_PRJ_CHIP="d21x"
CONFIG_PRJ_BOARD="d215-demo88-nand"
CONFIG_PRJ_KERNEL="baremetal"
CONFIG_PRJ_APP="bootloader"
CONFIG_PRJ_CUSTOM_LDS="application/baremetal/bootloader/ldscript/d21x_bootloader_gcc.ld"
CONFIG_AIC_USING_UART0=y
# CONFIG_AIC_USING_USB1 is not set
CONFIG_AIC_USING_QSPI0=y
CONFIG_AIC_QSPI0_DEVICE_SPINAND=y
CONFIG_AIC_WIRELESS_LAN=y
# CONFIG_AIC_USING_DE is not set
# CONFIG_AIC_USING_GE is not set
# CONFIG_AIC_USING_VE is not set
CONFIG_AIC_USING_DMA=y
CONFIG_AIC_USING_WRI=y
CONFIG_AIC_USING_RTC=y
CONFIG_AIC_USING_WDT=y
CONFIG_AIC_DRAM_TOTAL_SIZE=0x4000000
CONFIG_AIC_INTERRUPTSTACK_SIZE=8192
CONFIG_AIC_NORMALSTACK_SIZE=8192
CONFIG_AIC_BOOTLOADER_TEXT_SIZE=0x7FF00
CONFIG_AIC_BOOTLOADER_HEAP_SIZE=0x280000
# CONFIG_AIC_BOOTLOADER_SPINOR_SUPPORT is not set
CONFIG_AICUPG_SDCARD_ENABLE=y
CONFIG_AICUPG_UDISK_ENABLE=y
CONFIG_AICUPG_MMC_ARTINCHIP=y
CONFIG_AICUPG_NAND_ARTINCHIP=y
CONFIG_AIC_BOOTLOADER_CMD_NAND_BOOT=y
CONFIG_AIC_BOOTLOADER_CMD_SPI_NAND=y
CONFIG_AIC_BOOTLOADER_CMD_MTD=y
CONFIG_AIC_BOOTLOADER_CMD_PART=y
# CONFIG_LPKG_MPP is not set
CONFIG_AIC_ENV_INTERFACE=y
CONFIG_AIC_NFTL_SUPPORT=y
CONFIG_AIC_NFLT_USED_LIB=y
CONFIG_AIC_SPINAND_DRV_TEST=y
CONFIG_AIC_MTD_BARE_TEST=y
```

## target/configs/d21x_d215-demo88-nand_rt-thread_helloworld_defconfig
```kconfig
CONFIG_PRJ_DEFCONFIG_FILENAME="d21x_d215-demo88-nand_rt-thread_helloworld_defconfig"
CONFIG_PRJ_CHIP="d21x"
CONFIG_PRJ_BOARD="d215-demo88-nand"
CONFIG_PRJ_KERNEL="rt-thread"
CONFIG_PRJ_APP="helloworld"
CONFIG_AIC_USING_FS_IMAGE_0=y
CONFIG_AIC_USING_FS_IMAGE_TYPE_FATFS_FOR_0=y
CONFIG_AIC_FS_IMAGE_DIR_0="packages/third-party/cherryusb/tools/aic_usbdisplay/"
CONFIG_AIC_FS_IMAGE_NAME_0="rodata.fatfs"
CONFIG_AIC_USING_FS_IMAGE_1=y
CONFIG_AIC_USING_FS_IMAGE_TYPE_FATFS_FOR_1=y
CONFIG_AIC_FS_IMAGE_DIR_1="packages/artinchip/lvgl-ui/aic_demo/usb_osd_demo/lvgl_src/"
CONFIG_AIC_FS_IMAGE_NAME_1="data.fatfs"
# CONFIG_AIC_FATFS_AUTO_SIZE_FOR_1 is not set
CONFIG_AIC_FATFS_SECTOR_COUNT_FOR_1=68800
CONFIG_LVGL_V_9=y
CONFIG_LPKG_LVGL_THREAD_STACK_SIZE=32768
CONFIG_AIC_LVGL_DEMO=y
CONFIG_AIC_LVGL_USB_OSD_DEMO=y
CONFIG_LV_USB_OSD_LOGO_TYPE_VIDEO=y
CONFIG_LV_USB_OSD_SCREEN_LOCK_TIME=0
CONFIG_LVGL_STORAGE_PATH="/data/lvgl_data"
CONFIG_AIC_USING_UART0=y
CONFIG_AIC_USING_UART1=y
CONFIG_AIC_USING_I2C3=y
CONFIG_AIC_USING_PWM3=y
CONFIG_AIC_USING_USB0=y
# CONFIG_AIC_USING_USB1 is not set
CONFIG_AIC_USING_QSPI0=y
CONFIG_AIC_QSPI0_DEVICE_SPINAND=y
CONFIG_AIC_USING_TSEN=y
CONFIG_AIC_USING_TSEN_CPU=y
CONFIG_AIC_USING_TSEN_GPAI=y
CONFIG_AIC_DISP_LVDS=y
CONFIG_AIC_PAN_DISPLAY=y
# CONFIG_AIC_DISP_BOOTUP_LOGO is not set
CONFIG_AIC_PWM_BACKLIGHT=y
CONFIG_AIC_USING_AUDIO=y
CONFIG_AIC_AUDIO_EN_PIN_LOW=y
CONFIG_AIC_AUDIO_SPK_1=y
CONFIG_AIC_USING_DMA=y
CONFIG_AIC_USING_WRI=y
CONFIG_AIC_USING_RTC=y
CONFIG_AIC_USING_WDT=y
CONFIG_AIC_DRAM_TOTAL_SIZE=0x4000000
CONFIG_AIC_DRAM_CMA_SIZE=0x3000000
CONFIG_AIC_INTERRUPTSTACK_SIZE=4096
CONFIG_AIC_USING_SID=y
CONFIG_AIC_USING_MTOP=y
CONFIG_AIC_USING_PSADC=y
CONFIG_AIC_USING_PSADC6=y
# CONFIG_RT_USING_TIMER_SOFT is not set
# CONFIG_RT_KSERVICE_USING_STDLIB is not set
# CONFIG_RT_KPRINTF_USING_LONGLONG is not set
# CONFIG_RT_DEBUG is not set
CONFIG_RT_USING_MEMHEAP_AS_HEAP=y
# CONFIG_RT_USING_MEMHEAP_AUTO_BINDING is not set
CONFIG_RT_USING_DEVICE_OPS=y
CONFIG_RT_CONSOLE_DEVICE_NAME="uart0"
CONFIG_RT_MAIN_THREAD_STACK_SIZE=4096
CONFIG_FINSH_HISTORY_LINES=1
CONFIG_DFS_FILESYSTEMS_MAX=8
CONFIG_RT_USING_DFS_MNTTABLE=y
CONFIG_RT_USING_DFS_ELMFAT=y
CONFIG_RT_DFS_ELM_LFN_UNICODE_2=y
CONFIG_RT_DFS_ELM_USE_EXFAT=y
CONFIG_RT_DFS_ELM_DRIVES=4
CONFIG_RT_USING_DFS_DEVFS=y
CONFIG_RT_USING_DFS_ROMFS=y
CONFIG_RT_USING_CAN=y
CONFIG_RT_CAN_USING_HDR=y
CONFIG_RT_I2C_DEBUG=y
CONFIG_RT_USING_PM=y
CONFIG_PM_USING_CUSTOM_CONFIG=y
CONFIG_PM_ENABLE_SUSPEND_SLEEP_MODE=y
CONFIG_PM_ENABLE_THRESHOLD_SLEEP_MODE=y
CONFIG_RT_MMCSD_STACK_SIZE=8192
CONFIG_RT_AUDIO_REPLAY_MP_BLOCK_SIZE=192
CONFIG_RT_AUDIO_REPLAY_MP_BLOCK_COUNT=20
CONFIG_RT_USING_TOUCH=y
CONFIG_RT_TOUCH_PIN_IRQ=y
CONFIG_RT_HWCRYPTO_USING_AES=y
CONFIG_RT_HWCRYPTO_USING_AES_CBC=y
CONFIG_RT_HWCRYPTO_USING_MD5=y
CONFIG_RT_HWCRYPTO_USING_SHA1=y
CONFIG_RT_HWCRYPTO_USING_SHA2=y
CONFIG_RT_HWCRYPTO_USING_SHA2_224=y
CONFIG_RT_HWCRYPTO_USING_SHA2_384=y
CONFIG_RT_HWCRYPTO_USING_SHA2_512=y
CONFIG_RT_USING_POSIX_FS=y
CONFIG_RT_USING_ULOG=y
CONFIG_ULOG_OUTPUT_LVL_I=y
CONFIG_ULOG_TIME_USING_TIMESTAMP=y
CONFIG_ULOG_USING_FILTER=y
CONFIG_LPKG_USING_BONNIE=y
CONFIG_LPKG_USING_CPU_USAGE=y
CONFIG_LPKG_USING_CHERRYUSB=y
CONFIG_LPKG_CHERRYUSB_DEVICE=y
CONFIG_LPKG_CHERRYUSB_DYNAMIC_REGISTRATION_MODE=y
CONFIG_LPKG_CHERRYUSB_AIC_DISP_DR=y
CONFIG_LPKG_CHERRYUSB_DEVICE_HID=y
CONFIG_LPKG_CHERRYUSB_DEVICE_HID_TOUCH_TEMPLATE=y
CONFIG_LPKG_CHERRYUSB_DEVICE_MSC=y
CONFIG_USBDEV_MSC_READ_ONLY=y
CONFIG_MSC_STORAGE_PATH="/rodata"
CONFIG_LPKG_CHERRYUSB_DEVICE_AUDIO=y
CONFIG_LPKG_CHERRYUSB_DEVICE_AUDIO_SPEAKER=y
CONFIG_LPKG_CHERRYUSB_DEVICE_DISPLAY=y
CONFIG_LPKG_CHERRYUSB_DEVICE_DISPLAY_TEMPLATE=y
CONFIG_AIC_USB_DISP_INIT_DELAY_MS=4000
CONFIG_LPKG_USING_I2C_TOOLS=y
CONFIG_AIC_MPP_PLAYER_INTERFACE=y
CONFIG_LPKG_USING_OTA_DOWNLOADER=y
CONFIG_AIC_GPIO_IRQ_DRV_EN=y
CONFIG_AIC_NFTL_SUPPORT=y
CONFIG_AIC_NFLT_USED_LIB=y
CONFIG_AIC_USING_TOUCH=y
CONFIG_AIC_CMU_DRV_TEST=y
CONFIG_AIC_GPIO_DRV_TEST=y
CONFIG_AIC_DMA_DRV_TEST=y
CONFIG_AIC_RTC_DRV_TEST=y
CONFIG_AIC_DISPLAY_TEST=y
CONFIG_AIC_AUDIO_DRV_TEST=y
CONFIG_AIC_TSEN_TEST=y
CONFIG_AIC_PSADC_TEST=y
```

## target/configs/d21x_d215-demo88-nor_rt-thread_helloworld_defconfig
```kconfig
CONFIG_PRJ_DEFCONFIG_FILENAME="d21x_d215-demo88-nor_rt-thread_helloworld_defconfig"
CONFIG_PRJ_CHIP="d21x"
CONFIG_PRJ_BOARD="d215-demo88-nor"
CONFIG_PRJ_KERNEL="rt-thread"
CONFIG_PRJ_APP="helloworld"
CONFIG_AIC_USING_FS_IMAGE_0=y
CONFIG_AIC_USING_FS_IMAGE_TYPE_FATFS_FOR_0=y
CONFIG_AIC_FS_IMAGE_DIR_0="packages/third-party/cherryusb/tools/aic_usbdisplay/Windows"
CONFIG_AIC_FS_IMAGE_NAME_0="rodata.fatfs"
CONFIG_AIC_USING_FS_IMAGE_1=y
CONFIG_AIC_USING_FS_IMAGE_TYPE_FATFS_FOR_1=y
CONFIG_AIC_FS_IMAGE_DIR_1="packages/artinchip/lvgl-ui/aic_demo/usb_osd_demo/lvgl_src_nor"
CONFIG_AIC_FS_IMAGE_NAME_1="data.lfs"
CONFIG_AIC_FATFS_ENABLE_WRITE_IN_SPINOR=y
CONFIG_LVGL_V_9=y
CONFIG_LPKG_LVGL_THREAD_STACK_SIZE=7168
CONFIG_AIC_LVGL_DEMO=y
CONFIG_AIC_LVGL_USB_OSD_DEMO=y
CONFIG_LV_DISPLAY_ROTATE_EN=y
CONFIG_LV_USB_OSD_SCREEN_LOCK_TIME=0
CONFIG_LVGL_STORAGE_PATH="/data/lvgl_data"
CONFIG_AIC_USING_UART0=y
CONFIG_AIC_USING_UART1=y
CONFIG_AIC_USING_I2C3=y
CONFIG_AIC_USING_PWM3=y
CONFIG_AIC_USING_USB0=y
# CONFIG_AIC_USING_USB1 is not set
CONFIG_AIC_USING_QSPI0=y
CONFIG_AIC_QSPI0_DEVICE_SPINOR=y
# CONFIG_AIC_USING_SDMC1 is not set
CONFIG_AIC_WIRELESS_LAN=y
CONFIG_AIC_USING_TSEN=y
CONFIG_AIC_DISP_LVDS=y
CONFIG_AIC_PAN_DISPLAY=y
# CONFIG_AIC_DISP_BOOTUP_LOGO is not set
CONFIG_AIC_PWM_BACKLIGHT=y
CONFIG_AIC_USING_AUDIO=y
CONFIG_AIC_AUDIO_EN_PIN_LOW=y
CONFIG_AIC_AUDIO_SPK_1=y
CONFIG_AIC_USING_DMA=y
CONFIG_AIC_USING_WRI=y
CONFIG_AIC_USING_RTC=y
CONFIG_AIC_USING_WDT=y
CONFIG_AIC_DRAM_TOTAL_SIZE=0x4000000
CONFIG_AIC_DRAM_CMA_SIZE=0x3000000
CONFIG_AIC_INTERRUPTSTACK_SIZE=4096
CONFIG_AIC_USING_SID=y
CONFIG_IDLE_THREAD_STACK_SIZE=2048
# CONFIG_RT_USING_TIMER_SOFT is not set
# CONFIG_RT_KSERVICE_USING_STDLIB is not set
# CONFIG_RT_KPRINTF_USING_LONGLONG is not set
# CONFIG_RT_DEBUG is not set
CONFIG_RT_MEMHEAP_BSET_MODE=y
CONFIG_RT_USING_MEMHEAP_AS_HEAP=y
# CONFIG_RT_USING_MEMHEAP_AUTO_BINDING is not set
CONFIG_RT_USING_DEVICE_OPS=y
CONFIG_RT_CONSOLE_DEVICE_NAME="uart0"
CONFIG_RT_MAIN_THREAD_STACK_SIZE=4096
CONFIG_RT_USING_LEGACY=y
CONFIG_FINSH_HISTORY_LINES=1
CONFIG_DFS_FILESYSTEMS_MAX=8
CONFIG_RT_USING_DFS_MNTTABLE=y
CONFIG_RT_USING_DFS_ELMFAT=y
CONFIG_RT_DFS_ELM_LFN_UNICODE_2=y
CONFIG_RT_DFS_ELM_USE_EXFAT=y
CONFIG_RT_DFS_ELM_DRIVES=4
CONFIG_RT_USING_DFS_DEVFS=y
CONFIG_RT_USING_DFS_ROMFS=y
CONFIG_RT_USING_FAL=y
# CONFIG_FAL_DEBUG_CONFIG is not set
CONFIG_FAL_USING_SFUD_PORT=y
CONFIG_RT_USING_CAN=y
CONFIG_RT_CAN_USING_HDR=y
CONFIG_RT_I2C_DEBUG=y
# CONFIG_RT_USING_I2C_BITOPS is not set
CONFIG_RT_USING_ADC=y
CONFIG_RT_USING_PM=y
CONFIG_PM_USING_CUSTOM_CONFIG=y
CONFIG_PM_ENABLE_SUSPEND_SLEEP_MODE=y
CONFIG_PM_ENABLE_THRESHOLD_SLEEP_MODE=y
CONFIG_RT_USING_SDIO=y
CONFIG_RT_MMCSD_STACK_SIZE=8192
CONFIG_RT_SFUD_USING_QSPI=y
CONFIG_RT_AUDIO_REPLAY_MP_BLOCK_SIZE=192
CONFIG_RT_AUDIO_REPLAY_MP_BLOCK_COUNT=20
CONFIG_RT_USING_TOUCH=y
CONFIG_RT_TOUCH_PIN_IRQ=y
CONFIG_RT_USING_POSIX_FS=y
CONFIG_RT_USING_ULOG=y
CONFIG_ULOG_OUTPUT_LVL_I=y
CONFIG_ULOG_TIME_USING_TIMESTAMP=y
CONFIG_ULOG_USING_FILTER=y
CONFIG_LPKG_USING_CPU_USAGE=y
CONFIG_LPKG_USING_CHERRYUSB=y
CONFIG_LPKG_CHERRYUSB_DEVICE=y
CONFIG_LPKG_CHERRYUSB_DEVICE_COMPOSITE=y
CONFIG_LPKG_USING_COMP_UAC_TABLE1=y
CONFIG_LPKG_USING_COMP_HID_TABLE1=y
CONFIG_LPKG_CHERRYUSB_DYNAMIC_REGISTRATION_MODE=y
CONFIG_LPKG_CHERRYUSB_AIC_DISP_DR=y
CONFIG_LPKG_CHERRYUSB_DEVICE_HID_TOUCH_TEMPLATE=y
# CONFIG_USBD_MSC_STORAGE_USING_HOTPLUG is not set
CONFIG_USBDEV_MSC_READ_ONLY=y
CONFIG_MSC_STORAGE_PATH="/rodata"
CONFIG_AIC_USB_DISP_INIT_DELAY_MS=4000
CONFIG_LPKG_USING_LITTLEFS=y
CONFIG_LFS_READ_SIZE=2048
CONFIG_LFS_PROG_SIZE=2048
CONFIG_AIC_MPP_PLAYER_INTERFACE=y
CONFIG_AIC_GPIO_IRQ_DRV_EN=y
CONFIG_AIC_USING_TOUCH=y
CONFIG_AIC_DMA_DRV_TEST=y
CONFIG_AIC_RTC_DRV_TEST=y
```

## packages/third-party/minimp3/Kconfig
```kconfig
menuconfig LPKG_USING_MINIMP3
    bool "minimp3: A lightweight MP3 decoding library."
    default y
```

## packages/third-party/netutils/Kconfig
```kconfig
menuconfig LPKG_USING_NETUTILS
    bool "netutils: Networking utilities for RT-Thread"
    default n

if LPKG_USING_NETUTILS

    config LPKG_NETUTILS_IPERF
        bool "Enable iperf-liked network performance tool"
        default n

endif
```

## packages/third-party/protobuf-c/Kconfig
```kconfig
# Kconfig file for package protobuf-c
menuconfig LPKG_USING_PROTOBUF_C
    bool "protobuf-c: a C implementation of the Google Protocol Buffers data serialization format on RT-Thread"
    default n

if LPKG_USING_PROTOBUF_C

    config LPKG_PROTOBUF_C_PATH
        string
        default "/packages/iot/protobuf-c"

    config PROTOBUF_C_USING_EXAMPLE
        bool "protobuf-c examples"
        help
            protobuf-c examples
        default n
    if PROTOBUF_C_USING_EXAMPLE
        config PROTOBUF_C_USING_ENCODE_DECODE_EXAMPLE
            bool "protobuf-c example: encode and decode in memory"
            help
                protobuf-c example: encode and decode in memory
            default n

        config PROTOBUF_C_USING_ENCODE_DECODE_FILE_EXAMPLE
            select RT_USING_DFS      if RT_VER_NUM < 0x40100
            select RT_USING_POSIX_FS if RT_VER_NUM >= 0x40100
            bool "protobuf-c example: encode to file and decode from file"
            help
                protobuf-c example: encode to file and decode from file
            default n
    endif

    choice
        prompt "Version"
        default LPKG_USING_PROTOBUF_C_LATEST_VERSION
        help
            Select the package version
        config LPKG_USING_PROTOBUF_C_V100
            bool "v1.0.0"
        config LPKG_USING_PROTOBUF_C_LATEST_VERSION
            bool "latest"
    endchoice

    config LPKG_PROTOBUF_C_VER
       string
       default "v1.0.0"    if LPKG_USING_PROTOBUF_C_V100
       default "latest"    if LPKG_USING_PROTOBUF_C_LATEST_VERSION

    config LPKG_PROTOBUF_C_VER_NUM
        hex
        default 0x10000 if LPKG_USING_PROTOBUF_C_V100
        default 0x99999 if LPKG_USING_PROTOBUF_C_LATEST_VERSION

endif
```

## packages/third-party/ptpd/Kconfig
```kconfig
menuconfig LPKG_USING_PTPD
    bool "Enable IEEE1588 ptpd stack"
    default n
    select LPKG_USING_LWIP

if LPKG_USING_PTPD

    config LPKG_PTPD_THREAD_PRI
        int "The priority of PTPD thread"
        default 10

    config LPKG_PTPD_THREAD_STACK_SIZE
        int "The stack size of PTPD thread "
        default 2048

    config LPKG_PTPD_SLAVE_ONLY
        bool "PTP slave only"
        default n

    config LPKG_PTPD_DELAY_MECHANISM
        bool
        choice
        prompt "Delay mechanism of PTPD"
        default LPKG_PTPD_DELAY_MECHANISM_E2E

            config LPKG_PTPD_DELAY_MECHANISM_E2E
                bool "E2E"

            config LPKG_PTPD_DELAY_MECHANISM_P2P
                bool "P2P"

            config LPKG_PTPD_DELAY_MECHANISM_DISABLED
                bool "DELAY_DISABLED"

        endchoice

    config LPKG_PTPD_MASTER_SYNC_INTERVA
        int "PTPD master's synchronization cycle"
        default 0

    config LPKG_PTPD_MASTER_ANNOUNCE_INTERVA
        int "PTPD master's announce cycle"
        default 1

    config LPKG_PTPD_MAX_ADJ_FREQ
        int "Max frequency drift to try to adjust it"
        default 4096

    config LPKG_PTPD_MAX_ADJ_OFFSET
        int "Max offset(ns) to try to adjust it"
        default 4000000

    config LPKG_PTPD_PI_CONTROLLER_P
        int "Proportional parameters of PI controller"
        default 39

    config LPKG_PTPD_PI_CONTROLLER_I
        int "Integral parameters of PI controler"
        default 5

    config LPKG_PTPD_STACK_DEBUG
        bool
        choice
        prompt "The debug level of PTPD stack"
        default LPKG_PTPD_DEBUG_ERR

            config LPKG_PTPD_DEBUG_ERR
                bool "Error"

            config LPKG_PTPD_DEBUG_INFO
                bool "Information"

            config LPKG_PTPD_DEBUG_HANDLE
                bool "Debug handle message"

            config LPKG_PTPD_DEBUG_ALL
                bool "Debug"

        endchoice
endif
```

## packages/third-party/ramdisk/Kconfig
```kconfig
# Kconfig file for package ramdisk
menuconfig LPKG_USING_RAMDISK
    bool "ramdisk: A RAM memory block device."
    default n

if LPKG_USING_RAMDISK
    choice
        prompt "RAMDISK type"
        default LPKG_RAMDISK_TYPE_EMPTY
        help
            Select the initial ramdisk type

        config LPKG_RAMDISK_TYPE_EMPTY
            bool "Create empty RAMDISK"

        config LPKG_RAMDISK_TYPE_INITDATA
            bool "Create RAMDISK from initial data"
    endchoice

    config LPKG_RAMDISK_BLK_SIZE
        int "Ramdisk block size"
        default 512
        depends on LPKG_RAMDISK_TYPE_EMPTY

    config LPKG_RAMDISK_NUM_BLK
        int "Ramdisk number block"
        default 6144
        depends on LPKG_RAMDISK_TYPE_EMPTY

    config LPKG_RAMDISK_INIT_DEVICE_NAME
        string "RAMDISK initial device name"
        default "rodata"
        depends on LPKG_RAMDISK_TYPE_INITDATA
endif
```

## packages/third-party/sqlite/Kconfig
```kconfig
menuconfig LPKG_USING_SQLITE
    bool "SQLite: a self-contained, high-reliability, embedded, full-featured, public-domain, SQL database engine."
    default n
    select RT_USING_DFS      if RT_VER_NUM < 0x40100
    select RT_USING_POSIX_FS if RT_VER_NUM >= 0x40100

if LPKG_USING_SQLITE

    config LPKG_SQLITE_VER
        string
        default "v3.19.3"

    config LPKG_SQLITE_SQL_MAX_LEN
        int "SQL statements max length"
        default 512

    config LPKG_SQLITE_DB_NAME_MAX_LEN
        int "Database filename(fullpath) length"
        range 8 256
        default 64

    config LPKG_SQLITE_DAO_EXAMPLE
        bool "Enable example"
            default n

    config LPKG_SQLITE_RECIPE_EXAMPLE
        bool "Enable recipeData test example"
            default n

    choice
        prompt "version"
        help
            Select the Sqlite version

        config LPKG_USING_SQLITE_V3193
            bool "v3.19.3"
    endchoice

endif
```

## packages/third-party/zlib/Kconfig
```kconfig
# Kconfig file for package zlib
menuconfig LPKG_USING_ZLIB
    bool "zlib: general purpose data compression library"
    default n

if LPKG_USING_ZLIB

    config LPKG_ZLIB_USING_SAMPLE
        bool "Enable using zlib sample"
        select RT_USING_DFS      if RT_VER_NUM < 0x40100
        select RT_USING_POSIX_FS if RT_VER_NUM >= 0x40100
        default n

endif
```

## target/configs/d12x_demo68-mmc_baremetal_bootloader_defconfig
```kconfig
CONFIG_PRJ_DEFCONFIG_FILENAME="d12x_demo68-mmc_baremetal_bootloader_defconfig"
CONFIG_PRJ_CHIP="d12x"
CONFIG_PRJ_BOARD="demo68-mmc"
CONFIG_PRJ_KERNEL="baremetal"
CONFIG_PRJ_APP="bootloader"
CONFIG_PRJ_CUSTOM_LDS="application/baremetal/bootloader/ldscript/d12x_bootloader_gcc.ld"
CONFIG_AIC_USING_UART0=y
CONFIG_AIC_USING_UART1=y
CONFIG_AIC_UART0_DMA_ENABLE_FLAG=y
CONFIG_AIC_DEV_UART0_RX_MODE_INT=y
CONFIG_AIC_DEV_UART0_RX_BUFSZ=2048
CONFIG_AIC_DEV_UART0_TX_BUFSZ=2048
CONFIG_AIC_USING_SDMC0=y
# CONFIG_AIC_USING_DE is not set
# CONFIG_AIC_USING_GE is not set
# CONFIG_AIC_USING_VE is not set
CONFIG_AIC_USING_DMA=y
CONFIG_AIC_USING_WRI=y
CONFIG_AIC_USING_WDT=y
CONFIG_AIC_PSRAM_SW_SIZE=0x300000
CONFIG_AIC_INTERRUPTSTACK_SIZE=8192
CONFIG_AIC_CLK_PLL_FRA0_FREQ=384000000
CONFIG_AIC_SYSCFG_LDO1X_ENABLE=y
CONFIG_AIC_SYSCFG_LDO1X_VOL_VAL=8
CONFIG_AIC_NORMALSTACK_SIZE=8192
CONFIG_AIC_BOOTLOADER_TEXT_SIZE=0x7FF00
CONFIG_AIC_BOOTLOADER_CONSOLE_UART=1
CONFIG_AIC_BOOTLOADER_MMC_SUPPORT=y
# CONFIG_AIC_BOOTLOADER_SPINOR_SUPPORT is not set
# CONFIG_AIC_BOOTLOADER_SPINAND_SUPPORT is not set
CONFIG_AICUPG_SINGLE_TRANS_BURN_CRC32_VERIFY=y
CONFIG_AICUPG_UART_ENABLE=y
# CONFIG_AICUPG_USB_ENABLE is not set
CONFIG_AICUPG_MMC_ARTINCHIP=y
CONFIG_AIC_BOOTLOADER_CMD_MMC_BOOT=y
CONFIG_AIC_BOOTLOADER_CMD_PART=y
# CONFIG_LPKG_MPP is not set
CONFIG_AIC_ENV_INTERFACE=y
CONFIG_AIC_MMC_BARE_TEST=y
```

## target/configs/d12x_demo68-mmc_rt-thread_helloworld_defconfig
```kconfig
CONFIG_PRJ_DEFCONFIG_FILENAME="d12x_demo68-mmc_rt-thread_helloworld_defconfig"
CONFIG_PRJ_CHIP="d12x"
CONFIG_PRJ_BOARD="demo68-mmc"
CONFIG_PRJ_KERNEL="rt-thread"
CONFIG_PRJ_APP="helloworld"
CONFIG_AIC_USING_FS_IMAGE_0=y
CONFIG_AIC_USING_FS_IMAGE_TYPE_FATFS_FOR_0=y
CONFIG_AIC_FS_IMAGE_DIR_0="rodata"
CONFIG_AIC_FS_IMAGE_NAME_0="rodata.fatfs"
CONFIG_AIC_USING_FS_IMAGE_1=y
CONFIG_AIC_USING_FS_IMAGE_TYPE_FATFS_FOR_1=y
CONFIG_AIC_FS_IMAGE_DIR_1="data"
CONFIG_AIC_FS_IMAGE_NAME_1="data.fatfs"
CONFIG_LVGL_V_9=y
CONFIG_LPKG_LVGL_THREAD_STACK_SIZE=32768
CONFIG_AIC_LVGL_DEMO=y
CONFIG_AIC_LVGL_DEMO_HUB_DEMO=y
CONFIG_LV_COLOR_DEPTH=16
CONFIG_AIC_USING_UART0=y
CONFIG_AIC_USING_UART1=y
CONFIG_AIC_USING_I2C0=y
CONFIG_AIC_USING_SDMC0=y
CONFIG_AIC_PRGB_24BIT=y
CONFIG_DATA_ORDER_BGR=y
CONFIG_AIC_DEGREE_90=y
CONFIG_AICFB_RGB565=y
CONFIG_AIC_PAN_DISPLAY=y
CONFIG_AIC_STARTUP_UI_SHOW=y
CONFIG_AIC_PANEL_480X272_RESOLUTION=y
CONFIG_AIC_PANEL_ENABLE_GPIO="PE.13"
CONFIG_AIC_GE_CMDQ=y
CONFIG_AIC_USING_DMA=y
CONFIG_AIC_USING_WRI=y
CONFIG_AIC_USING_WDT=y
CONFIG_AIC_PSRAM_SW_SIZE=0x400000
CONFIG_AIC_INTERRUPTSTACK_SIZE=8192
CONFIG_AIC_CLK_PLL_FRA0_FREQ=384000000
CONFIG_AIC_USING_SID=y
CONFIG_EFUSE_MAX_WORD=64
CONFIG_AIC_SYSCFG_LDO1X_ENABLE=y
CONFIG_AIC_SYSCFG_LDO1X_VOL_VAL=8
CONFIG_AIC_USING_MTOP=y
CONFIG_IDLE_THREAD_STACK_SIZE=1024
# CONFIG_RT_KSERVICE_USING_STDLIB is not set
# CONFIG_RT_DEBUG is not set
CONFIG_RT_USING_MEMHEAP_AS_HEAP=y
# CONFIG_RT_USING_MEMHEAP_AUTO_BINDING is not set
CONFIG_RT_CONSOLE_DEVICE_NAME="uart1"
CONFIG_RT_USING_LEGACY=y
CONFIG_FINSH_THREAD_STACK_SIZE=4096
CONFIG_FINSH_HISTORY_LINES=1
CONFIG_DFS_FILESYSTEMS_MAX=8
CONFIG_RT_USING_DFS_MNTTABLE=y
CONFIG_RT_USING_DFS_ELMFAT=y
CONFIG_RT_DFS_ELM_LFN_UNICODE_2=y
CONFIG_RT_DFS_ELM_USE_EXFAT=y
CONFIG_RT_DFS_ELM_DRIVES=4
CONFIG_RT_USING_DFS_ROMFS=y
CONFIG_RT_USING_ADC=y
CONFIG_RT_USING_PWM=y
CONFIG_RT_USING_PM=y
CONFIG_PM_USING_CUSTOM_CONFIG=y
CONFIG_PM_ENABLE_SUSPEND_SLEEP_MODE=y
CONFIG_PM_ENABLE_THRESHOLD_SLEEP_MODE=y
CONFIG_RT_MMCSD_STACK_SIZE=8192
CONFIG_RT_USING_SPI=y
CONFIG_RT_USING_QSPI=y
CONFIG_RT_USING_SENSOR=y
CONFIG_RT_USING_TOUCH=y
CONFIG_RT_TOUCH_PIN_IRQ=y
CONFIG_RT_USING_ULOG=y
CONFIG_ULOG_OUTPUT_LVL_I=y
CONFIG_ULOG_TIME_USING_TIMESTAMP=y
CONFIG_ULOG_USING_FILTER=y
CONFIG_LPKG_USING_CPU_USAGE=y
CONFIG_LPKG_USING_LITTLEFS=y
CONFIG_LPKG_USING_CJSON=y
CONFIG_AIC_MPP_PLAYER_INTERFACE=y
CONFIG_AIC_MPP_PLAYER_VE_USE_FILL_FB=y
CONFIG_AIC_MPP_PLAYER_AUDIO_RENDER_SHARE_TEST=y
CONFIG_AIC_MPP_VE_TEST=y
CONFIG_AIC_MPP_GE_TEST=y
CONFIG_LPKG_USING_PINMUX_CHECHK=y
CONFIG_AIC_PINMUX_CHECK=y
CONFIG_LPKG_USING_OTA_DOWNLOADER=y
CONFIG_AIC_GPIO_IRQ_DRV_EN=y
CONFIG_AIC_USING_TOUCH=y
CONFIG_AIC_TOUCH_PANEL_I2C_CHAN="i2c0"
CONFIG_AIC_TOUCH_PANEL_RST_PIN="PA.10"
CONFIG_AIC_TOUCH_PANEL_INT_PIN="PA.11"
CONFIG_AIC_TOUCH_X_COORDINATE_RANGE=480
CONFIG_AIC_TOUCH_Y_COORDINATE_RANGE=272
CONFIG_AIC_SCREEN_REAL_X_RESOLUTION=480
CONFIG_AIC_SCREEN_REAL_Y_RESOLUTION=272
CONFIG_AIC_FB_DRV_DEBUG=y
CONFIG_AIC_SDMC_DRV_TEST=y
CONFIG_AIC_MMC_TEST=y
CONFIG_AIC_GE_TEST=y
CONFIG_AIC_VE_TEST=y
```

## target/configs/d12x_demo68-nand_baremetal_bootloader_defconfig
```kconfig
CONFIG_PRJ_DEFCONFIG_FILENAME="d12x_demo68-nand_baremetal_bootloader_defconfig"
CONFIG_PRJ_CHIP="d12x"
CONFIG_PRJ_BOARD="demo68-nand"
CONFIG_PRJ_KERNEL="baremetal"
CONFIG_PRJ_APP="bootloader"
CONFIG_PRJ_CUSTOM_LDS="application/baremetal/bootloader/ldscript/d12x_bootloader_gcc.ld"
CONFIG_AIC_USING_UART0=y
CONFIG_AIC_USING_UART1=y
CONFIG_AIC_CLK_UART0_FREQ=53454545
CONFIG_AIC_UART0_DMA_ENABLE_FLAG=y
CONFIG_AIC_DEV_UART0_RX_MODE_INT=y
CONFIG_AIC_DEV_UART0_RX_BUFSZ=2048
CONFIG_AIC_DEV_UART0_TX_BUFSZ=2048
CONFIG_AIC_CLK_UART1_FREQ=53454545
CONFIG_AIC_USING_QSPI0=y
CONFIG_AIC_QSPI0_DEVICE_SPINAND=y
CONFIG_AIC_WIRELESS_LAN=y
CONFIG_AIC_PRGB_24BIT=y
CONFIG_DATA_ORDER_BGR=y
CONFIG_AIC_DEGREE_90=y
CONFIG_AICFB_RGB565=y
# CONFIG_AIC_DISP_BOOTUP_LOGO is not set
CONFIG_AIC_PANEL_480X272_RESOLUTION=y
CONFIG_AIC_PANEL_ENABLE_GPIO="PE.13"
CONFIG_AIC_SCREEN_CROP=y
CONFIG_AIC_SCREEN_CROP_POS_Y=100
CONFIG_AIC_SCREEN_CROP_WIDTH=480
CONFIG_AIC_SCREEN_CROP_HEIGHT=80
# CONFIG_AIC_USING_GE is not set
# CONFIG_AIC_USING_VE is not set
CONFIG_AIC_USING_DMA=y
CONFIG_AIC_USING_WRI=y
CONFIG_AIC_USING_WDT=y
CONFIG_AIC_INTERRUPTSTACK_SIZE=8192
CONFIG_AIC_CLK_PLL_FRA0_FREQ=384000000
CONFIG_AIC_USING_SID=y
CONFIG_AIC_SYSCFG_LDO1X_ENABLE=y
CONFIG_AIC_SYSCFG_LDO1X_VOL_VAL=8
CONFIG_AIC_NORMALSTACK_SIZE=8192
CONFIG_AIC_BOOTLOADER_TEXT_SIZE=0x7FF00
CONFIG_AIC_BOOTLOADER_HEAP_SIZE=0x180000
CONFIG_AIC_BOOTLOADER_CONSOLE_UART=1
# CONFIG_AIC_BOOTLOADER_SPINOR_SUPPORT is not set
CONFIG_AICUPG_UART_ENABLE=y
# CONFIG_AICUPG_USB_ENABLE is not set
CONFIG_AICUPG_SDCARD_ENABLE=y
CONFIG_AICUPG_MMC_ARTINCHIP=y
CONFIG_AICUPG_NAND_ARTINCHIP=y
CONFIG_AIC_BOOTLOADER_CMD_NAND_BOOT=y
CONFIG_AIC_BOOTLOADER_CMD_SPI_NAND=y
CONFIG_AIC_BOOTLOADER_CMD_MTD=y
CONFIG_AIC_BOOTLOADER_CMD_PART=y
CONFIG_AIC_BOOTLOADER_CMD_PROGRESS_BAR=y
CONFIG_AIC_BOOTLOADER_CMD_FB_CONSOLE=y
# CONFIG_LPKG_MPP is not set
CONFIG_AIC_ENV_INTERFACE=y
CONFIG_SPI_NAND_DOSILICON=y
CONFIG_SPI_NAND_ETRON=y
CONFIG_SPI_NAND_MICRON=y
CONFIG_SPI_NAND_MACRONIX=y
CONFIG_SPI_NAND_GIGADEVICE=y
CONFIG_SPI_NAND_TOSHIBA=y
CONFIG_SPI_NAND_FORESEE=y
CONFIG_SPI_NAND_XTX=y
CONFIG_SPI_NAND_ZETTA=y
CONFIG_SPI_NAND_ZBIT=y
CONFIG_SPI_NAND_ESMT=y
CONFIG_SPI_NAND_UMTEK=y
CONFIG_SPI_NAND_QUANXING=y
CONFIG_AIC_NFTL_SUPPORT=y
CONFIG_AIC_NFLT_USED_LIB=y
CONFIG_AIC_SPINAND_DRV_TEST=y
CONFIG_AIC_MTD_BARE_TEST=y
CONFIG_AIC_SID_BARE_TEST=y
```

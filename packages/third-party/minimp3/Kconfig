## target/configs/d21x_demo88-mmc_rt-thread_helloworld_defconfig
```kconfig
CONFIG_PRJ_DEFCONFIG_FILENAME="d21x_demo88-mmc_rt-thread_helloworld_defconfig"
CONFIG_PRJ_CHIP="d21x"
CONFIG_PRJ_BOARD="demo88-mmc"
CONFIG_PRJ_KERNEL="rt-thread"
CONFIG_PRJ_APP="helloworld"
CONFIG_AIC_USING_FS_IMAGE_0=y
CONFIG_AIC_USING_FS_IMAGE_TYPE_FATFS_FOR_0=y
CONFIG_AIC_FS_IMAGE_DIR_0="rodata/"
CONFIG_AIC_FS_IMAGE_NAME_0="rodata.fatfs"
CONFIG_AIC_USING_FS_IMAGE_1=y
CONFIG_AIC_USING_FS_IMAGE_TYPE_FATFS_FOR_1=y
CONFIG_AIC_FS_IMAGE_DIR_1="data/"
CONFIG_AIC_FS_IMAGE_NAME_1="data.fatfs"
CONFIG_LVGL_V_9=y
CONFIG_LPKG_LVGL_THREAD_STACK_SIZE=32768
CONFIG_AIC_LVGL_DEMO=y
CONFIG_LV_CACHE_IMG_NUM=15
CONFIG_AIC_USING_UART0=y
CONFIG_AIC_USING_UART1=y
CONFIG_AIC_USING_I2C3=y
CONFIG_AIC_USING_CAN0=y
# CONFIG_AIC_USING_USB1 is not set
CONFIG_AIC_USING_SDMC0=y
CONFIG_AIC_SDMC0_SMP_PHASE=1
CONFIG_AIC_USING_TSEN=y
CONFIG_AIC_PAN_DISPLAY=y
CONFIG_AIC_USING_AUDIO=y
CONFIG_AIC_AUDIO_EN_PIN_LOW=y
CONFIG_AIC_AUDIO_SPK_1=y
CONFIG_AIC_USING_DMA=y
CONFIG_AIC_USING_WRI=y
CONFIG_AIC_USING_RTC=y
CONFIG_AIC_USING_WDT=y
CONFIG_AIC_DRAM_TOTAL_SIZE=0x4000000
CONFIG_AIC_DRAM_CMA_SIZE=0x2000000
CONFIG_AIC_INTERRUPTSTACK_SIZE=4096
CONFIG_AIC_USING_SID=y
CONFIG_IDLE_THREAD_STACK_SIZE=2048
# CONFIG_RT_USING_TIMER_SOFT is not set
# CONFIG_RT_KSERVICE_USING_STDLIB is not set
# CONFIG_RT_KPRINTF_USING_LONGLONG is not set
# CONFIG_RT_DEBUG is not set
CONFIG_RT_MEMHEAP_BSET_MODE=y
CONFIG_RT_USING_MEMHEAP_AS_HEAP=y
# CONFIG_RT_USING_MEMHEAP_AUTO_BINDING is not set
CONFIG_RT_USING_DEVICE_OPS=y
CONFIG_RT_CONSOLE_DEVICE_NAME="uart0"
CONFIG_RT_MAIN_THREAD_STACK_SIZE=4096
CONFIG_RT_USING_LEGACY=y
CONFIG_FINSH_HISTORY_LINES=1
CONFIG_DFS_FILESYSTEMS_MAX=8
CONFIG_RT_USING_DFS_MNTTABLE=y
CONFIG_RT_USING_DFS_ELMFAT=y
CONFIG_RT_DFS_ELM_LFN_UNICODE_2=y
CONFIG_RT_DFS_ELM_USE_EXFAT=y
CONFIG_RT_DFS_ELM_DRIVES=4
CONFIG_RT_USING_DFS_DEVFS=y
CONFIG_RT_USING_DFS_ROMFS=y
CONFIG_RT_I2C_DEBUG=y
# CONFIG_RT_USING_I2C_BITOPS is not set
CONFIG_RT_USING_ADC=y
CONFIG_RT_USING_PM=y
CONFIG_PM_USING_CUSTOM_CONFIG=y
CONFIG_PM_ENABLE_SUSPEND_SLEEP_MODE=y
CONFIG_PM_ENABLE_THRESHOLD_SLEEP_MODE=y
CONFIG_RT_MMCSD_STACK_SIZE=8192
CONFIG_RT_MMCSD_THREAD_PREORITY=19
CONFIG_RT_USING_SPI=y
CONFIG_RT_USING_QSPI=y
CONFIG_RT_USING_TOUCH=y
CONFIG_RT_TOUCH_PIN_IRQ=y
CONFIG_RT_USING_HWCRYPTO=y
CONFIG_RT_HWCRYPTO_USING_AES=y
CONFIG_RT_HWCRYPTO_USING_AES_CBC=y
CONFIG_RT_HWCRYPTO_USING_MD5=y
CONFIG_RT_HWCRYPTO_USING_SHA1=y
CONFIG_RT_HWCRYPTO_USING_SHA2=y
CONFIG_RT_HWCRYPTO_USING_SHA2_224=y
CONFIG_RT_HWCRYPTO_USING_SHA2_384=y
CONFIG_RT_HWCRYPTO_USING_SHA2_512=y
CONFIG_RT_USING_ULOG=y
CONFIG_ULOG_OUTPUT_LVL_I=y
CONFIG_ULOG_TIME_USING_TIMESTAMP=y
CONFIG_ULOG_USING_FILTER=y
CONFIG_LPKG_USING_BONNIE=y
CONFIG_LPKG_USING_CPU_USAGE=y
CONFIG_LPKG_USING_DFS_UFFS=y
CONFIG_RT_UFFS_ECC_MODE_3=y
CONFIG_AIC_MPP_PLAYER_INTERFACE=y
CONFIG_AIC_GPIO_IRQ_DRV_EN=y
CONFIG_LPKG_USING_SPINAND=y
CONFIG_AIC_USING_TOUCH=y
CONFIG_AIC_DMA_DRV_TEST=y
CONFIG_AIC_RTC_DRV_TEST=y
```

## target/configs/g73x_demo100-nor_baremetal_bootloader_defconfig
```kconfig
CONFIG_PRJ_DEFCONFIG_FILENAME="g73x_demo100-nor_baremetal_bootloader_defconfig"
CONFIG_PRJ_CHIP="g73x"
CONFIG_PRJ_BOARD="demo100-nor"
CONFIG_PRJ_KERNEL="baremetal"
CONFIG_PRJ_APP="bootloader"
CONFIG_PRJ_CUSTOM_LDS="application/baremetal/bootloader/ldscript/g73x_bootloader_gcc.ld"
CONFIG_AIC_USING_UART0=y
CONFIG_AIC_USING_QSPI0=y
CONFIG_AIC_DEV_QSPI0_MAX_SRC_FREQ_HZ=50000000
CONFIG_AIC_QSPI0_BUS_WIDTH_1=y
CONFIG_AIC_QSPI0_DEVICE_SPINOR=y
CONFIG_AIC_QSPI0_DEVICE_SPINOR_FREQ=50000000
# CONFIG_AIC_USING_DE is not set
# CONFIG_AIC_USING_GE is not set
# CONFIG_AIC_USING_VE is not set
CONFIG_AIC_USING_DMA=y
CONFIG_AIC_USING_WRI=y
CONFIG_AIC_USING_RTC=y
CONFIG_AIC_USING_WDT=y
CONFIG_AIC_PSRAM_SIZE=0x0
CONFIG_AIC_PSRAM_SW_SIZE=0x0
CONFIG_AIC_INTERRUPTSTACK_SIZE=8192
CONFIG_AIC_USING_SID=y
CONFIG_AIC_SYSCFG_SIP_FLASH_ENABLE=y
CONFIG_AIC_NORMALSTACK_SIZE=8192
CONFIG_AIC_BOOTLOADER_HEAP_SIZE=0x2F000
# CONFIG_AIC_BOOTLOADER_SPINAND_SUPPORT is not set
CONFIG_AIC_BOOTLOADER_FATFS_SUPPORT=y
CONFIG_AICUPG_UART_ENABLE=y
CONFIG_AICUPG_NOR_ARTINCHIP=y
CONFIG_AICUPG_LOG_BUFFER_ADDR=0x30040000
CONFIG_AICUPG_LOG_BUFFER_SIZE=0x3000
CONFIG_AIC_BOOTLOADER_CMD_NOR_BOOT=y
CONFIG_AIC_BOOTLOADER_CMD_SPI_NOR=y
CONFIG_AIC_BOOTLOADER_CMD_MTD=y
CONFIG_AIC_BOOTLOADER_CMD_PART=y
CONFIG_LPKG_CHERRYUSB_DEVICE_CLASS_AIC_SINGLE=y
# CONFIG_LPKG_MPP is not set
CONFIG_LPKG_USING_SFUD=y
CONFIG_AIC_SPINOR_DRV_TEST=y
CONFIG_AIC_MTD_BARE_TEST=y
CONFIG_AIC_SID_BARE_TEST=y
```

## target/configs/g73x_demo100-nor_rt-thread_helloworld_defconfig
```kconfig
CONFIG_PRJ_DEFCONFIG_FILENAME="g73x_demo100-nor_rt-thread_helloworld_defconfig"
CONFIG_PRJ_CHIP="g73x"
CONFIG_PRJ_BOARD="demo100-nor"
CONFIG_PRJ_KERNEL="rt-thread"
CONFIG_PRJ_APP="helloworld"
CONFIG_AIC_USING_UART0=y
CONFIG_AIC_USING_I2C2=y
CONFIG_AIC_USING_USB0=y
CONFIG_AIC_USING_USB0_HOST=y
CONFIG_AIC_USING_QSPI0=y
CONFIG_AIC_DEV_QSPI0_MAX_SRC_FREQ_HZ=50000000
CONFIG_AIC_QSPI0_BUS_WIDTH_1=y
CONFIG_AIC_QSPI0_DEVICE_SPINOR=y
CONFIG_AIC_QSPI0_DEVICE_SPINOR_FREQ=50000000
CONFIG_AIC_SDMC_IRQ_MODE=y
CONFIG_AIC_USING_TSEN=y
CONFIG_AIC_USING_GPAI=y
CONFIG_AIC_USING_GPAI7=y
CONFIG_AIC_GPAI7_PERIOD_TIME=1
# CONFIG_AIC_USING_DE is not set
# CONFIG_AIC_USING_GE is not set
# CONFIG_AIC_USING_VE is not set
CONFIG_AIC_USING_AUDIO=y
CONFIG_AIC_AUDIO_PA_ENABLE_GPIO="PD.10"
CONFIG_AIC_AUDIO_EN_PIN_LOW=y
CONFIG_AIC_AUDIO_SPK_1=y
CONFIG_AIC_USING_DMA=y
CONFIG_AIC_USING_WRI=y
CONFIG_AIC_USING_RTC=y
CONFIG_AIC_USING_WDT=y
CONFIG_AIC_SRAM_S1_SIZE_384K=y
CONFIG_AIC_SRAM1_SW_SIZE=0x10000
CONFIG_AIC_PSRAM_SIZE=0x0
CONFIG_AIC_PSRAM_SW_SIZE=0x0
CONFIG_AIC_INTERRUPTSTACK_SIZE=4096
CONFIG_AIC_CLK_PLL_FRA0_FREQ=792000000
CONFIG_AIC_CLK_PLL_FRA2_FREQ=1188000000
CONFIG_AIC_USING_SID=y
CONFIG_AIC_SYSCFG_SIP_FLASH_ENABLE=y
CONFIG_IDLE_THREAD_STACK_SIZE=1024
# CONFIG_RT_KSERVICE_USING_STDLIB is not set
# CONFIG_RT_DEBUG is not set
CONFIG_RT_MEMHEAP_BSET_MODE=y
CONFIG_RT_USING_MEMHEAP_AS_HEAP=y
# CONFIG_RT_USING_MEMHEAP_AUTO_BINDING is not set
CONFIG_RT_CONSOLE_DEVICE_NAME="uart0"
CONFIG_FINSH_HISTORY_LINES=1
CONFIG_DFS_FILESYSTEMS_MAX=8
CONFIG_RT_USING_DFS_MNTTABLE=y
CONFIG_RT_USING_DFS_ELMFAT=y
CONFIG_RT_DFS_ELM_LFN_UNICODE_2=y
CONFIG_RT_DFS_ELM_USE_EXFAT=y
CONFIG_RT_DFS_ELM_DRIVES=4
CONFIG_RT_DFS_ELM_MAX_SECTOR_SIZE=4096
CONFIG_RT_USING_DFS_ROMFS=y
CONFIG_RT_USING_FAL=y
# CONFIG_FAL_DEBUG_CONFIG is not set
CONFIG_FAL_USING_SFUD_PORT=y
# CONFIG_FAL_BLK_DEVICE_RDONLY is not set
CONFIG_RT_USING_PWM=y
CONFIG_RT_USING_PM=y
CONFIG_PM_USING_CUSTOM_CONFIG=y
CONFIG_PM_ENABLE_SUSPEND_SLEEP_MODE=y
CONFIG_PM_ENABLE_THRESHOLD_SLEEP_MODE=y
CONFIG_RT_MMCSD_STACK_SIZE=8192
CONFIG_RT_SFUD_USING_QSPI=y
CONFIG_RT_USING_TOUCH=y
CONFIG_RT_TOUCH_PIN_IRQ=y
CONFIG_RT_USING_POSIX_CLOCK=y
CONFIG_RT_USING_ULOG=y
CONFIG_ULOG_OUTPUT_LVL_I=y
CONFIG_ULOG_TIME_USING_TIMESTAMP=y
CONFIG_ULOG_USING_FILTER=y
CONFIG_LPKG_USING_CPU_USAGE=y
CONFIG_LPKG_USING_CHERRYUSB=y
CONFIG_LPKG_CHERRYUSB_HOST=y
CONFIG_LPKG_CHERRYUSB_HOST_MSC=y
CONFIG_LPKG_CHERRYUSB_HOST_MSC_TEMPLATE=y
CONFIG_LPKG_USING_LITTLEFS=y
# CONFIG_LPKG_MPP is not set
CONFIG_AIC_GPIO_IRQ_DRV_EN=y
CONFIG_AIC_QSPI_DRV_TEST=y
CONFIG_AIC_AUDIO_DRV_TEST=y
CONFIG_AIC_GPAI_TEST=y
CONFIG_AIC_TSEN_TEST=y
```

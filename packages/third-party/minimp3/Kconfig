## target/configs/d12x_demo68-nand_rt-thread_helloworld_defconfig
```kconfig
CONFIG_PRJ_DEFCONFIG_FILENAME="d12x_demo68-nand_rt-thread_helloworld_defconfig"
CONFIG_PRJ_CHIP="d12x"
CONFIG_PRJ_BOARD="demo68-nand"
CONFIG_PRJ_KERNEL="rt-thread"
CONFIG_PRJ_APP="helloworld"
CONFIG_AIC_USING_FS_IMAGE_0=y
CONFIG_AIC_USING_FS_IMAGE_TYPE_FATFS_FOR_0=y
CONFIG_AIC_FS_IMAGE_DIR_0="rodata/"
CONFIG_AIC_FS_IMAGE_NAME_0="rodata.fatfs"
CONFIG_AIC_USING_FS_IMAGE_1=y
CONFIG_AIC_USING_FS_IMAGE_TYPE_FATFS_FOR_1=y
CONFIG_AIC_FS_IMAGE_DIR_1="data/"
CONFIG_AIC_FS_IMAGE_NAME_1="data.fatfs"
CONFIG_LVGL_V_9=y
CONFIG_LPKG_LVGL_THREAD_STACK_SIZE=32768
CONFIG_AIC_LVGL_DEMO=y
CONFIG_AIC_LVGL_DEMO_HUB_DEMO=y
CONFIG_LV_COLOR_DEPTH=16
CONFIG_LV_CACHE_IMG_NUM=8
CONFIG_AIC_USING_UART1=y
CONFIG_AIC_USING_I2C0=y
CONFIG_AIC_USING_QSPI0=y
CONFIG_AIC_QSPI0_DEVICE_SPINAND=y
CONFIG_AIC_PRGB_24BIT=y
CONFIG_DATA_ORDER_BGR=y
CONFIG_AIC_DEGREE_90=y
CONFIG_AICFB_RGB565=y
CONFIG_AIC_PAN_DISPLAY=y
CONFIG_AIC_STARTUP_UI_SHOW=y
CONFIG_AIC_PANEL_480X272_RESOLUTION=y
CONFIG_AIC_PANEL_ENABLE_GPIO="PE.13"
CONFIG_AIC_GE_CMDQ=y
CONFIG_AIC_USING_DMA=y
CONFIG_AIC_USING_WRI=y
CONFIG_AIC_USING_WDT=y
CONFIG_AIC_PSRAM_SW_SIZE=0x400000
CONFIG_AIC_INTERRUPTSTACK_SIZE=8192
CONFIG_AIC_CLK_PLL_FRA0_FREQ=384000000
CONFIG_AIC_USING_SID=y
CONFIG_EFUSE_MAX_WORD=64
CONFIG_AIC_SYSCFG_LDO1X_ENABLE=y
CONFIG_AIC_SYSCFG_LDO1X_VOL_VAL=8
CONFIG_IDLE_THREAD_STACK_SIZE=1024
# CONFIG_RT_KSERVICE_USING_STDLIB is not set
# CONFIG_RT_DEBUG is not set
CONFIG_RT_USING_MEMHEAP_AS_HEAP=y
# CONFIG_RT_USING_MEMHEAP_AUTO_BINDING is not set
CONFIG_RT_CONSOLE_DEVICE_NAME="uart1"
CONFIG_RT_MAIN_THREAD_STACK_SIZE=4096
CONFIG_RT_USING_LEGACY=y
CONFIG_FINSH_HISTORY_LINES=1
CONFIG_DFS_FILESYSTEMS_MAX=8
CONFIG_RT_USING_DFS_MNTTABLE=y
CONFIG_RT_USING_DFS_ELMFAT=y
CONFIG_RT_DFS_ELM_LFN_UNICODE_2=y
CONFIG_RT_DFS_ELM_USE_EXFAT=y
CONFIG_RT_DFS_ELM_DRIVES=4
CONFIG_RT_DFS_ELM_MAX_SECTOR_SIZE=4096
CONFIG_RT_USING_DFS_ROMFS=y
CONFIG_RT_USING_ADC=y
CONFIG_RT_USING_PWM=y
CONFIG_RT_MTD_NAND_DEBUG=y
CONFIG_RT_USING_PM=y
CONFIG_PM_USING_CUSTOM_CONFIG=y
CONFIG_PM_ENABLE_SUSPEND_SLEEP_MODE=y
CONFIG_PM_ENABLE_THRESHOLD_SLEEP_MODE=y
CONFIG_RT_MMCSD_STACK_SIZE=8192
CONFIG_RT_USING_SENSOR=y
CONFIG_RT_USING_TOUCH=y
CONFIG_RT_TOUCH_PIN_IRQ=y
CONFIG_RT_USING_ULOG=y
CONFIG_ULOG_OUTPUT_LVL_I=y
CONFIG_ULOG_TIME_USING_TIMESTAMP=y
CONFIG_ULOG_USING_FILTER=y
CONFIG_LPKG_USING_CPU_USAGE=y
CONFIG_AIC_MPP_PLAYER_INTERFACE=y
CONFIG_AIC_GPIO_IRQ_DRV_EN=y
CONFIG_AIC_NFTL_SUPPORT=y
CONFIG_AIC_NFLT_USED_LIB=y
CONFIG_AIC_USING_TOUCH=y
CONFIG_AIC_TOUCH_PANEL_I2C_CHAN="i2c0"
CONFIG_AIC_TOUCH_PANEL_RST_PIN="PA.10"
CONFIG_AIC_TOUCH_PANEL_INT_PIN="PA.11"
CONFIG_AIC_DMA_DRV_TEST=y
```

## target/configs/d12x_hmi-nor_baremetal_bootloader_defconfig
```kconfig
CONFIG_PRJ_DEFCONFIG_FILENAME="d12x_hmi-nor_baremetal_bootloader_defconfig"
CONFIG_PRJ_CHIP="d12x"
CONFIG_PRJ_BOARD="hmi-nor"
CONFIG_PRJ_KERNEL="baremetal"
CONFIG_PRJ_APP="bootloader"
CONFIG_PRJ_CUSTOM_LDS="application/baremetal/bootloader/ldscript/d12x_bootloader_gcc.ld"
CONFIG_AIC_USING_UART0=y
CONFIG_AIC_USING_UART1=y
CONFIG_AIC_CLK_UART0_FREQ=53454545
CONFIG_AIC_CLK_UART1_FREQ=53454545
CONFIG_AIC_USING_QSPI0=y
CONFIG_AIC_QSPI0_DEVICE_SPINOR=y
CONFIG_AIC_DEGREE_90=y
CONFIG_AICFB_RGB565=y
# CONFIG_AIC_DISP_BOOTUP_LOGO is not set
CONFIG_AIC_PANEL_480X272_RESOLUTION=y
CONFIG_AIC_PANEL_ENABLE_GPIO="PE.13"
CONFIG_AIC_SCREEN_CROP=y
CONFIG_AIC_SCREEN_CROP_POS_Y=100
CONFIG_AIC_SCREEN_CROP_WIDTH=480
CONFIG_AIC_SCREEN_CROP_HEIGHT=80
# CONFIG_AIC_USING_GE is not set
# CONFIG_AIC_USING_VE is not set
CONFIG_AIC_USING_DMA=y
CONFIG_AIC_USING_WRI=y
CONFIG_AIC_USING_WDT=y
CONFIG_AIC_PSRAM_SIZE=0x400000
CONFIG_AIC_PSRAM_SW_SIZE=0x300000
CONFIG_AIC_INTERRUPTSTACK_SIZE=8192
CONFIG_AIC_CLK_PLL_FRA0_FREQ=384000000
CONFIG_AIC_USING_SID=y
CONFIG_EFUSE_MAX_WORD=64
CONFIG_AIC_SYSCFG_LDO1X_ENABLE=y
CONFIG_AIC_SYSCFG_LDO1X_VOL_VAL=8
CONFIG_AIC_NORMALSTACK_SIZE=8192
CONFIG_AIC_BOOTLOADER_TEXT_SIZE=0x7FF00
CONFIG_AIC_BOOTLOADER_CONSOLE_UART=1
# CONFIG_AIC_BOOTLOADER_SPINAND_SUPPORT is not set
CONFIG_AICUPG_UART_ENABLE=y
# CONFIG_AICUPG_USB_ENABLE is not set
CONFIG_AICUPG_SDCARD_ENABLE=y
CONFIG_AICUPG_MMC_ARTINCHIP=y
CONFIG_AICUPG_NOR_ARTINCHIP=y
CONFIG_AIC_BOOTLOADER_CMD_NOR_BOOT=y
CONFIG_AIC_BOOTLOADER_CMD_SPI_NOR=y
CONFIG_AIC_BOOTLOADER_CMD_MTD=y
CONFIG_AIC_BOOTLOADER_CMD_PART=y
CONFIG_AIC_BOOTLOADER_CMD_PROGRESS_BAR=y
CONFIG_AIC_BOOTLOADER_CMD_FB_CONSOLE=y
# CONFIG_LPKG_MPP is not set
CONFIG_LPKG_USING_SFUD=y
CONFIG_AIC_SPINOR_DRV_TEST=y
CONFIG_AIC_MTD_BARE_TEST=y
```

## target/configs/d12x_hmi-nor_rt-thread_helloworld_defconfig
```kconfig
CONFIG_PRJ_DEFCONFIG_FILENAME="d12x_hmi-nor_rt-thread_helloworld_defconfig"
CONFIG_PRJ_CHIP="d12x"
CONFIG_PRJ_BOARD="hmi-nor"
CONFIG_PRJ_KERNEL="rt-thread"
CONFIG_PRJ_APP="helloworld"
CONFIG_LVGL_V_9=y
CONFIG_AIC_LVGL_DEMO=y
CONFIG_AIC_LVGL_DEMO_HUB_DEMO=y
CONFIG_LV_COLOR_DEPTH=16
CONFIG_AIC_USING_UART1=y
CONFIG_AIC_USING_UART2=y
CONFIG_AIC_USING_I2C0=y
CONFIG_AIC_USING_PWM0=y
CONFIG_AIC_USING_CAN0=y
CONFIG_AIC_USING_QSPI0=y
CONFIG_AIC_QSPI0_DEVICE_SPINOR=y
CONFIG_DATA_ORDER_BGR=y
CONFIG_AIC_DEGREE_90=y
CONFIG_AICFB_RGB565=y
CONFIG_AIC_PAN_DISPLAY=y
CONFIG_AIC_PANEL_480X272_RESOLUTION=y
CONFIG_AIC_PWM_BACKLIGHT=y
CONFIG_AIC_PWM_BACKLIGHT_CHANNEL=0
CONFIG_AIC_GE_CMDQ=y
CONFIG_AIC_USING_AUDIO=y
CONFIG_AIC_USING_DMA=y
CONFIG_AIC_USING_WRI=y
CONFIG_AIC_USING_WDT=y
CONFIG_AIC_PSRAM_SW_SIZE=0x200000
CONFIG_AIC_INTERRUPTSTACK_SIZE=4096
CONFIG_AIC_CLK_PLL_FRA0_FREQ=384000000
CONFIG_AIC_SYSCFG_LDO1X_ENABLE=y
CONFIG_AIC_SYSCFG_LDO1X_VOL_VAL=8
CONFIG_AIC_USING_MTOP=y
CONFIG_IDLE_THREAD_STACK_SIZE=1024
# CONFIG_RT_KSERVICE_USING_STDLIB is not set
# CONFIG_RT_DEBUG is not set
CONFIG_RT_USING_MEMHEAP_AS_HEAP=y
# CONFIG_RT_USING_MEMHEAP_AUTO_BINDING is not set
CONFIG_RT_CONSOLE_DEVICE_NAME="uart1"
CONFIG_FINSH_HISTORY_LINES=1
CONFIG_DFS_FILESYSTEMS_MAX=8
CONFIG_RT_USING_DFS_MNTTABLE=y
CONFIG_RT_USING_DFS_ELMFAT=y
CONFIG_RT_DFS_ELM_LFN_UNICODE_2=y
CONFIG_RT_DFS_ELM_USE_EXFAT=y
CONFIG_RT_DFS_ELM_MAX_SECTOR_SIZE=4096
CONFIG_RT_USING_DFS_DEVFS=y
CONFIG_RT_USING_DFS_ROMFS=y
CONFIG_RT_USING_FAL=y
# CONFIG_FAL_DEBUG_CONFIG is not set
CONFIG_FAL_USING_SFUD_PORT=y
CONFIG_RT_USING_ADC=y
CONFIG_RT_USING_PM=y
CONFIG_PM_USING_CUSTOM_CONFIG=y
CONFIG_PM_ENABLE_SUSPEND_SLEEP_MODE=y
CONFIG_PM_ENABLE_THRESHOLD_SLEEP_MODE=y
CONFIG_RT_MMCSD_STACK_SIZE=8192
CONFIG_RT_SFUD_USING_QSPI=y
CONFIG_RT_USING_SENSOR=y
CONFIG_RT_USING_TOUCH=y
CONFIG_RT_TOUCH_PIN_IRQ=y
CONFIG_RT_USING_ULOG=y
CONFIG_ULOG_OUTPUT_LVL_I=y
CONFIG_ULOG_TIME_USING_TIMESTAMP=y
CONFIG_ULOG_USING_FILTER=y
CONFIG_LPKG_USING_CPU_USAGE=y
CONFIG_LPKG_USING_LITTLEFS=y
CONFIG_AIC_MPP_PLAYER_INTERFACE=y
CONFIG_LPKG_USING_PINMUX_CHECHK=y
CONFIG_AIC_PINMUX_CHECK=y
CONFIG_AIC_GPIO_IRQ_DRV_EN=y
CONFIG_AIC_USING_TOUCH=y
CONFIG_AIC_TOUCH_PANEL_I2C_CHAN="i2c0"
CONFIG_AIC_TOUCH_PANEL_RST_PIN="PA.10"
CONFIG_AIC_TOUCH_PANEL_INT_PIN="PA.11"
CONFIG_AIC_DMA_DRV_TEST=y
CONFIG_AIC_WDT_DRV_TEST=y
```

## target/configs/d13x_demo68-nor_baremetal_bootloader_defconfig
```kconfig
CONFIG_PRJ_DEFCONFIG_FILENAME="d13x_demo68-nor_baremetal_bootloader_defconfig"
CONFIG_PRJ_CHIP="d13x"
CONFIG_PRJ_BOARD="demo68-nor"
CONFIG_PRJ_KERNEL="baremetal"
CONFIG_PRJ_APP="bootloader"
CONFIG_PRJ_CUSTOM_LDS="application/baremetal/bootloader/ldscript/d13x_bootloader_gcc.ld"
CONFIG_AIC_USING_UART0=y
CONFIG_AIC_USING_UART1=y
CONFIG_AIC_UART0_DMA_ENABLE_FLAG=y
CONFIG_AIC_DEV_UART0_RX_MODE_INT=y
CONFIG_AIC_DEV_UART0_RX_BUFSZ=2048
CONFIG_AIC_DEV_UART0_TX_BUFSZ=2048
CONFIG_AIC_USING_QSPI0=y
CONFIG_AIC_QSPI0_DEVICE_SPINOR=y
CONFIG_AIC_WIRELESS_LAN=y
CONFIG_AIC_DISP_LVDS=y
CONFIG_AICFB_RGB565=y
CONFIG_AIC_PANEL_ENABLE_GPIO="PE.13"
CONFIG_AIC_SCREEN_CROP=y
CONFIG_AIC_SCREEN_CROP_POS_Y=260
CONFIG_AIC_SCREEN_CROP_WIDTH=1024
CONFIG_AIC_SCREEN_CROP_HEIGHT=80
# CONFIG_AIC_USING_GE is not set
# CONFIG_AIC_USING_VE is not set
CONFIG_AIC_USING_DMA=y
CONFIG_AIC_USING_WRI=y
CONFIG_AIC_USING_RTC=y
CONFIG_AIC_USING_WDT=y
CONFIG_AIC_SRAM_TOTAL_SIZE=0x80000
CONFIG_AIC_PSRAM_SW_SIZE=0x300000
CONFIG_AIC_INTERRUPTSTACK_SIZE=8192
CONFIG_AIC_USING_SID=y
CONFIG_AIC_SYSCFG_LDO1X_ENABLE=y
CONFIG_AIC_NORMALSTACK_SIZE=8192
CONFIG_AIC_BOOTLOADER_TEXT_SIZE=0x7FF00
CONFIG_AIC_BOOTLOADER_CONSOLE_UART=1
# CONFIG_AIC_BOOTLOADER_SPINAND_SUPPORT is not set
CONFIG_AIC_BOOTLOADER_PSRAM_EN=y
CONFIG_AIC_XSPI_PSRAM_CS0_PINS=0
CONFIG_AIC_XSPI_PSRAM_CS1_PINS=0
CONFIG_AICUPG_UART_ENABLE=y
CONFIG_AICUPG_SDCARD_ENABLE=y
CONFIG_AICUPG_UDISK_ENABLE=y
CONFIG_AICUPG_MMC_ARTINCHIP=y
CONFIG_AICUPG_NOR_ARTINCHIP=y
CONFIG_AIC_BOOTLOADER_CMD_NOR_BOOT=y
CONFIG_AIC_BOOTLOADER_CMD_SPI_NOR=y
CONFIG_AIC_BOOTLOADER_CMD_MTD=y
CONFIG_AIC_BOOTLOADER_CMD_PART=y
CONFIG_AIC_BOOTLOADER_CMD_PROGRESS_BAR=y
CONFIG_AIC_BOOTLOADER_CMD_FB_CONSOLE=y
CONFIG_LPKG_CHERRYUSB_DEVICE_CLASS_AIC_SINGLE=y
# CONFIG_LPKG_MPP is not set
CONFIG_AIC_ENV_INTERFACE=y
CONFIG_LPKG_USING_SFUD=y
CONFIG_AIC_SPINOR_DRV_TEST=y
CONFIG_AIC_MTD_BARE_TEST=y
```

## target/configs/d13x_demo68-nor_rt-thread_helloworld_defconfig
```kconfig
CONFIG_PRJ_DEFCONFIG_FILENAME="d13x_demo68-nor_rt-thread_helloworld_defconfig"
CONFIG_PRJ_CHIP="d13x"
CONFIG_PRJ_BOARD="demo68-nor"
CONFIG_PRJ_KERNEL="rt-thread"
CONFIG_PRJ_APP="helloworld"
CONFIG_AIC_USING_FS_IMAGE_0=y
CONFIG_AIC_USING_FS_IMAGE_TYPE_FATFS_FOR_0=y
CONFIG_AIC_FS_IMAGE_DIR_0="rodata/"
CONFIG_AIC_FS_IMAGE_NAME_0="rodata.fatfs"
CONFIG_AIC_USING_FS_IMAGE_1=y
CONFIG_AIC_FS_IMAGE_DIR_1="data/"
CONFIG_AIC_FS_IMAGE_NAME_1="data.lfs"
CONFIG_AIC_FATFS_ENABLE_WRITE_IN_SPINOR=y
CONFIG_LVGL_V_9=y
CONFIG_LPKG_LVGL_THREAD_STACK_SIZE=32768
CONFIG_AIC_LVGL_DEMO=y
CONFIG_AIC_LVGL_DEMO_HUB_DEMO=y
CONFIG_LV_COLOR_DEPTH=16
CONFIG_LV_CACHE_IMG_NUM=8
CONFIG_AIC_USING_UART1=y
CONFIG_AIC_USING_I2C2=y
CONFIG_AIC_USING_CAN0=y
CONFIG_AIC_USING_QSPI0=y
CONFIG_AIC_QSPI0_DEVICE_SPINOR=y
CONFIG_AIC_USING_TSEN=y
CONFIG_AIC_USING_TSEN_CPU=y
CONFIG_AIC_USING_TSEN_GPAI=y
CONFIG_AIC_USING_GPAI=y
CONFIG_AIC_USING_GPAI7=y
CONFIG_AIC_DISP_LVDS=y
CONFIG_AICFB_RGB565=y
CONFIG_AIC_PAN_DISPLAY=y
CONFIG_AIC_STARTUP_UI_SHOW=y
CONFIG_AIC_PANEL_ENABLE_GPIO="PE.13"
CONFIG_AIC_GE_CMDQ=y
CONFIG_AIC_USING_AUDIO=y
CONFIG_AIC_AUDIO_PA_ENABLE_GPIO="PD.10"
CONFIG_AIC_AUDIO_EN_PIN_LOW=y
CONFIG_AIC_AUDIO_SPK_1=y
CONFIG_AIC_USING_DMA=y
CONFIG_AIC_USING_WRI=y
CONFIG_AIC_USING_RTC=y
CONFIG_AIC_USING_WDT=y
CONFIG_AIC_SRAM_TOTAL_SIZE=0x80000
CONFIG_AIC_PSRAM_SW_SIZE=0x0
CONFIG_AIC_INTERRUPTSTACK_SIZE=4096
CONFIG_AIC_CLK_PLL_FRA0_FREQ=792000000
CONFIG_AIC_CLK_PLL_FRA2_FREQ=1188000000
CONFIG_AIC_USING_SID=y
CONFIG_AIC_SYSCFG_LDO1X_ENABLE=y
CONFIG_AIC_USING_MTOP=y
CONFIG_AIC_USING_PSADC=y
CONFIG_AIC_USING_PSADC6=y
CONFIG_IDLE_THREAD_STACK_SIZE=1024
# CONFIG_RT_KSERVICE_USING_STDLIB is not set
# CONFIG_RT_DEBUG is not set
CONFIG_RT_MEMHEAP_BSET_MODE=y
CONFIG_RT_USING_MEMHEAP_AS_HEAP=y
# CONFIG_RT_USING_MEMHEAP_AUTO_BINDING is not set
CONFIG_RT_CONSOLE_DEVICE_NAME="uart1"
CONFIG_RT_MAIN_THREAD_STACK_SIZE=4096
CONFIG_FINSH_HISTORY_LINES=1
CONFIG_DFS_FILESYSTEMS_MAX=8
CONFIG_RT_USING_DFS_MNTTABLE=y
CONFIG_RT_USING_DFS_ELMFAT=y
CONFIG_RT_DFS_ELM_LFN_UNICODE_2=y
CONFIG_RT_DFS_ELM_USE_EXFAT=y
CONFIG_RT_DFS_ELM_DRIVES=4
CONFIG_RT_DFS_ELM_MAX_SECTOR_SIZE=4096
CONFIG_RT_USING_DFS_ROMFS=y
CONFIG_RT_USING_FAL=y
# CONFIG_FAL_DEBUG_CONFIG is not set
CONFIG_FAL_USING_SFUD_PORT=y
# CONFIG_FAL_BLK_DEVICE_RDONLY is not set
CONFIG_RT_USING_PWM=y
CONFIG_RT_USING_PM=y
CONFIG_PM_USING_CUSTOM_CONFIG=y
CONFIG_PM_ENABLE_SUSPEND_SLEEP_MODE=y
CONFIG_PM_ENABLE_THRESHOLD_SLEEP_MODE=y
CONFIG_RT_MMCSD_STACK_SIZE=8192
CONFIG_RT_SFUD_USING_QSPI=y
CONFIG_RT_USING_TOUCH=y
CONFIG_RT_TOUCH_PIN_IRQ=y
CONFIG_RT_USING_ULOG=y
CONFIG_ULOG_OUTPUT_LVL_I=y
CONFIG_ULOG_TIME_USING_TIMESTAMP=y
CONFIG_ULOG_USING_FILTER=y
CONFIG_LPKG_USING_CPU_USAGE=y
CONFIG_LPKG_USING_LITTLEFS=y
CONFIG_AIC_MPP_PLAYER_INTERFACE=y
CONFIG_AIC_GPIO_IRQ_DRV_EN=y
CONFIG_AIC_USING_TOUCH=y
CONFIG_AIC_TOUCH_PANEL_I2C_CHAN="i2c2"
CONFIG_AIC_TOUCH_PANEL_RST_PIN="PA.10"
CONFIG_AIC_TOUCH_PANEL_INT_PIN="PA.11"
CONFIG_AIC_CMU_DRV_TEST=y
CONFIG_AIC_GPIO_DRV_TEST=y
CONFIG_AIC_DMA_DRV_TEST=y
CONFIG_AIC_AUDIO_DRV_TEST=y
CONFIG_AIC_GPAI_TEST=y
CONFIG_AIC_TSEN_TEST=y
CONFIG_AIC_PSADC_TEST=y
```

## target/configs/d13x_hspi100-nor_baremetal_bootloader_defconfig
```kconfig
CONFIG_PRJ_DEFCONFIG_FILENAME="d13x_hspi100-nor_baremetal_bootloader_defconfig"
CONFIG_PRJ_CHIP="d13x"
CONFIG_PRJ_BOARD="hspi100-nor"
CONFIG_PRJ_KERNEL="baremetal"
CONFIG_PRJ_APP="bootloader"
CONFIG_PRJ_CUSTOM_LDS="application/baremetal/bootloader/ldscript/d13x_bootloader_gcc.ld"
CONFIG_AIC_USING_UART0=y
CONFIG_AIC_USING_QSPI0=y
CONFIG_AIC_QSPI0_DEVICE_SPINOR=y
CONFIG_AIC_WIRELESS_LAN=y
CONFIG_DATA_ORDER_BGR=y
CONFIG_AIC_DEGREE_90=y
# CONFIG_RGB_DATA_MIRROT is not set
CONFIG_AICFB_RGB565=y
CONFIG_PANEL_PIXELCLOCK=12
CONFIG_PANEL_HACTIVE=480
CONFIG_PANEL_VACTIVE=272
CONFIG_PANEL_HBP=43
CONFIG_PANEL_HFP=8
CONFIG_PANEL_HSW=1
CONFIG_PANEL_VFP=4
CONFIG_PANEL_VSW=10
CONFIG_AIC_PANEL_ENABLE_GPIO="PE.15"
# CONFIG_AIC_USING_GE is not set
# CONFIG_AIC_USING_VE is not set
CONFIG_AIC_USING_DMA=y
CONFIG_AIC_USING_WRI=y
CONFIG_AIC_USING_RTC=y
CONFIG_AIC_USING_WDT=y
CONFIG_AIC_PSRAM_SW_SIZE=0x300000
CONFIG_AIC_INTERRUPTSTACK_SIZE=4096
CONFIG_AIC_USING_SID=y
CONFIG_AIC_NORMALSTACK_SIZE=8192
CONFIG_AIC_BOOTLOADER_TEXT_SIZE=0x7FF00
# CONFIG_AIC_BOOTLOADER_SPINAND_SUPPORT is not set
CONFIG_AIC_BOOTLOADER_PSRAM_EN=y
CONFIG_AIC_XSPI_PSRAM_CS0_PINS=0
CONFIG_AIC_XSPI_PSRAM_CS1_PINS=0
CONFIG_AICUPG_UART_ENABLE=y
CONFIG_AICUPG_SDCARD_ENABLE=y
CONFIG_AICUPG_UDISK_ENABLE=y
CONFIG_AICUPG_MMC_ARTINCHIP=y
CONFIG_AICUPG_NOR_ARTINCHIP=y
CONFIG_AIC_BOOTLOADER_CMD_NOR_BOOT=y
CONFIG_AIC_BOOTLOADER_CMD_SPI_NOR=y
CONFIG_AIC_BOOTLOADER_CMD_MTD=y
CONFIG_AIC_BOOTLOADER_CMD_PART=y
CONFIG_AIC_BOOTLOADER_CMD_PROGRESS_BAR=y
CONFIG_AIC_BOOTLOADER_CMD_FB_CONSOLE=y
# CONFIG_LPKG_USING_MINIMP3 is not set
# CONFIG_LPKG_MPP is not set
CONFIG_AIC_ENV_INTERFACE=y
CONFIG_LPKG_USING_SFUD=y
CONFIG_AIC_SPINOR_DRV_TEST=y
CONFIG_AIC_MTD_BARE_TEST=y
```

## Kconfig
```kconfig
mainmenu "ArtInChip Luban-Lite SDK Configuration"

menu "Project options"

config PRJ_DEFCONFIG_FILENAME
    string "Project defconfig file name"

comment "-- Important: If following options have been changed, you need save & rerun menuconfig before changing any other options."

config PRJ_CHIP
    string "Chip name"
    #option env="PRJ_CHIP"
    # Don't set default value to make defconfig contain CONFIG_PRJ_CHIP option

config PRJ_BOARD
    string "Board name"
    #option env="PRJ_BOARD"

config PRJ_KERNEL
    string "Kernel name"
    #option env="PRJ_KERNEL"

config PRJ_APP
    string "Application name"
    #option env="PRJ_APP"

choice
    prompt "Select a board"
    default n
    config AIC_USING_D213ECV_EzUIX1_DEMO_V0
        bool "D213ECV_EzUIX1_DEMO_V0"
        depends on AIC_CHIP_D21X

    config AIC_USING_D213ECV_EzUIX1_DEMO_V1
        bool "D213ECV_EzUIX1_DEMO_V1"
        depends on AIC_CHIP_D21X

    config AIC_USING_H215_DEMO_A02_V0
        bool "H215_DEMO_A02_V0"
        depends on AIC_CHIP_D21X

    config AIC_USING_HT68_DEMO_A01
        bool "HT68_DEMO_A01"
        depends on AIC_CHIP_D13X

    config AIC_USING_HT68_DEMO_A02_V1
        bool "HT68_DEMO_A02_V1"
        depends on AIC_CHIP_D13X

endchoice

choice
    prompt "Toolchain"
    depends on ARCH_RISCV
    default PRJ_RV_TOOLCHAIN_V2_6_1

    config PRJ_RV_TOOLCHAIN_V2_6_1
        bool "RISC-V Toolchain V2.6.1"
    config PRJ_RV_TOOLCHAIN_V3_2_0
        bool "RISC-V Toolchain V3.2.0"
endchoice

config PRJ_TOOLCHAIN_VER
    string
    default "V2.6.1" if PRJ_RV_TOOLCHAIN_V2_6_1
    default "V3.2.0" if PRJ_RV_TOOLCHAIN_V3_2_0

endmenu

config PLATFORM_LUBANLITE
    bool
    default y

config PKGS_DIR
    string
    default "tools/env/packages"
	help
        packages directory for RT-Thread online packages

if ! AIC_BOOTLOADER
source "application/Kconfig"
endif
source ".Kconfig.prj"
source "packages/Kconfig"
source "bsp/Kconfig"
```

## application/rt-thread/evFunction/Kconfig
```kconfig
menu "Custom App Config"
    config APP_USE_DRAW_LINE_TEST
        bool "USE DRAW LINE TEST"
        default n
        depends on AIC_USING_TOUCH
        depends on !LPKG_USING_LVGL
        if APP_USE_DRAW_LINE_TEST
            choice 
                prompt  "Select Touch Device"
                default TOUCH_GT911
                config TOUCH_GT911
                    bool "gt911"
                config TOUCH_FT6336
                    bool "ft6336"
            endchoice
            config APP_TOUCH_DEVICE
                string
                default "gt911" if TOUCH_GT911
                default "ft6336" if TOUCH_FT6336
        endif

    config APP_USE_UART_TEST
        bool "USE UART TEST"
        default n
        if APP_USE_UART_TEST
            choice
                prompt "Select UART Device"
                default USE_UART0
                config USE_UART0
                    bool "uart0"
                    depends on AIC_USING_UART0
                config USE_UART1
                    bool "uart1"
                    depends on AIC_USING_UART1
                config USE_UART2
                    bool "uart2"
                    depends on AIC_USING_UART2
                config USE_UART3
                    bool "uart3"
                    depends on AIC_USING_UART3
                config USE_UART4
                    bool "uart4"
                    depends on AIC_USING_UART4
            endchoice
            config APP_USE_UART_DEVICE
                string 
                default  "uart0" if USE_UART0
                default  "uart1" if USE_UART1
                default  "uart2" if USE_UART2
                default  "uart3" if USE_UART3
                default  "uart4" if USE_UART4
        endif
    config APP_USE_CIR_TEST
        bool "Use CIR TEST"
        default n
        depends on AIC_USING_CIR

        


endmenu 
```

## bsp/artinchip/drv/display/panel/Kconfig
```kconfig
menu "Display Panels"

    choice
        prompt "ArtInChip Panel Drivers"
        default AIC_SIMPLE_PANEL

#
# Simple Panel
#
    config AIC_SIMPLE_PANEL
        bool "ArtInChip SIMPLE panel"
        depends on AIC_DISP_RGB || AIC_DISP_LVDS
        help
            Simple Panel support general RGB or LVDS LCD

if !AIC_DISP_PQ_TOOL
#
# MIPI-DSI Panel
#

    config AIC_PANEL_DSI_ST7703
        bool "ArtInChip MIPI DSI ST7703 panel"
        depends on AIC_DISP_MIPI_DSI

    config AIC_PANEL_DSI_H013A08
        bool "Hotlcd MIPI DSI H013A08 panel"
        depends on AIC_DISP_MIPI_DSI

    config AIC_PANEL_DSI_H016A01
        bool "Hotlcd MIPI DSI H016A01 panel"
        depends on AIC_DISP_MIPI_DSI

    config AIC_PANEL_DSI_H024B12
        bool "Hotlcd MIPI DSI H024B12 panel"
        depends on AIC_DISP_MIPI_DSI

    config AIC_PANEL_DSI_H028B23
        bool "Hotlcd MIPI DSI H028B23 panel"
        depends on AIC_DISP_MIPI_DSI

    config AIC_PANEL_DSI_H028A29
        bool "Hotlcd MIPI DSI H028A29 panel"
        depends on AIC_DISP_MIPI_DSI

    config AIC_PANEL_DSI_H030B07
        bool "Hotlcd MIPI DSI H030B07 panel"
        depends on AIC_DISP_MIPI_DSI

    config AIC_PANEL_DSI_H034A01
        bool "Hotlcd MIPI DSI H034A01 panel"
        depends on AIC_DISP_MIPI_DSI

    config AIC_PANEL_DSI_H035A27
        bool "Hotlcd MIPI DSI H035A27 panel"
        depends on AIC_DISP_MIPI_DSI

    config AIC_PANEL_DSI_H035B16
        bool "Hotlcd MIPI DSI H035B16 panel"
        depends on AIC_DISP_MIPI_DSI

    config AIC_PANEL_DSI_H035B22
        bool "Hotlcd MIPI DSI H035B22 panel"
        depends on AIC_DISP_MIPI_DSI

    config AIC_PANEL_DSI_H040B24
        bool "Hotlcd MIPI DSI H040B24 panel"
        depends on AIC_DISP_MIPI_DSI

    config AIC_PANEL_DSI_H043A8
        bool "Hotlcd MIPI DSI H043A8 panel"
        depends on AIC_DISP_MIPI_DSI

    config AIC_PANEL_DSI_H050A20
        bool "Hotlcd MIPI DSI H050A20 panel"
        depends on AIC_DISP_MIPI_DSI

    config AIC_PANEL_DSI_H055A03
        bool "Hotlcd MIPI DSI H055A03 panel"
        depends on AIC_DISP_MIPI_DSI

    config AIC_PANEL_DSI_H070B13
        bool "Hotlcd MIPI DSI H070B13 panel"
        depends on AIC_DISP_MIPI_DSI

    config AIC_PANEL_DSI_H070A21
        bool "Hotlcd MIPI DSI H070A21 panel"
        depends on AIC_DISP_MIPI_DSI
    
    config AIC_PANEL_DSI_H070A27
        bool "Hotlcd MIPI DSI H070A27 panel(Round)"
        depends on AIC_DISP_MIPI_DSI

    config AIC_PANEL_DSI_H078B06
        bool "Hotlcd MIPI DSI H078B06 panel"
        depends on AIC_DISP_MIPI_DSI

    config AIC_PANEL_DSI_H080A11
        bool "Hotlcd MIPI DSI H080A11 panel"
        depends on AIC_DISP_MIPI_DSI

    config AIC_PANEL_DSI_H080D16
        bool "Hotlcd MIPI DSI H080D16 panel(Conversion)"
        depends on AIC_DISP_MIPI_DSI

    config AIC_PANEL_DSI_H103W01
        bool "Hotlcd MIPI DSI H103W01 panel"
        depends on AIC_DISP_MIPI_DSI

#
# MIPI-DBI Type B I8080 Panel
#
    config AIC_PANEL_DBI_ILI9488
        bool "ArtInChip MIPI DBI ILI9488 panel"
        depends on AIC_DISP_MIPI_DBI
        help
            MIPI-DBI Type B, I8080_RGB666_16BIT_3CYCLE

    config AIC_PANEL_DBI_ST7789
        bool "ArtInChip MIPI DBI ST7789 panel"
        depends on AIC_DISP_MIPI_DBI
        help
            MIPI-DBI Type B, I8080_RGB565_8BIT

    config AIC_PANEL_DBI_H040A12
        bool "Hotlcd MIPI DBI H040A12 panel"
        depends on AIC_DISP_MIPI_DBI

    config AIC_PANEL_DBI_H040A27
        bool "Hotlcd MIPI DBI H040A27 panel"
        depends on AIC_DISP_MIPI_DBI

#
# MIPI-DBI Type C SPI Panel
#
    config AIC_PANEL_DBI_ILI9341
        bool "ArtInChip MIPI DBI ILI9341 panel"
        depends on AIC_DISP_MIPI_DBI
        help
            MIPI-DBI Type C, SPI_4LINE_RGB888

    config AIC_PANEL_DBI_ST77903
        bool "ArtInChip MIPI DBI ST77903 panel"
        depends on AIC_DISP_MIPI_DBI
        help
            MIPI-DBI Type C, SPI_4SDA_RGB666

    config AIC_PANEL_SPI_GENERAL
        bool "ArtInChip SPI General panel"
        depends on AIC_DISP_MIPI_DBI
        help
            Use SPI Controller refresh SPI LCD Peripheral
#
# RGB Panel SPI Init
#
    config AIC_PANEL_RGB_ST7701S
        bool "ArtInChip RGB ST7701S panel"
        depends on AIC_DISP_RGB
        select AIC_PANEL_SPI_EMULATION

    config AIC_PANEL_RGB_H024A13
        bool "Hotlcd RGB H024A13 panel"
        depends on AIC_DISP_RGB
        select AIC_PANEL_SPI_EMULATION

    config AIC_PANEL_RGB_H028A19
        bool "Hotlcd RGB H028A19 panel"
        depends on AIC_DISP_RGB
        select AIC_PANEL_SPI_EMULATION

    config AIC_PANEL_RGB_H030A8
        bool "Hotlcd RGB H030A8 panel"
        depends on AIC_DISP_RGB
        select AIC_PANEL_SPI_EMULATION

    config AIC_PANEL_RGB_H030A10
        bool "Hotlcd RGB H030A10 panel"
        depends on AIC_DISP_RGB
        select AIC_PANEL_SPI_EMULATION

    config AIC_PANEL_RGB_H034A02
        bool "Hotlcd RGB H034A02 panel"
        depends on AIC_DISP_RGB
        select AIC_PANEL_SPI_EMULATION

    config AIC_PANEL_RGB_H035A17
        bool "Hotlcd RGB H035A17 panel"
        depends on AIC_DISP_RGB
        select AIC_PANEL_SPI_EMULATION

    config AIC_PANEL_RGB_H035A24
        bool "Hotlcd RGB H035A24 panel"
        depends on AIC_DISP_RGB
        select AIC_PANEL_SPI_EMULATION

    config AIC_PANEL_RGB_H040A18
        bool "Hotlcd RGB H040A18 panel"
        depends on AIC_DISP_RGB
        select AIC_PANEL_SPI_EMULATION

    config AIC_PANEL_RGB_H043A7
        bool "Hotlcd RGB H043A7 panel"
        depends on AIC_DISP_RGB
        select AIC_PANEL_SPI_EMULATION

    config AIC_PANEL_RGB_H043B32
        bool "Hotlcd RGB H043B32 panel"
        depends on AIC_DISP_RGB
        select AIC_PANEL_SPI_EMULATION

    config AIC_PANEL_RGB_H048A02
        bool "Hotlcd RGB H048A02 panel"
        depends on AIC_DISP_RGB
        select AIC_PANEL_SPI_EMULATION

    config AIC_PANEL_RGB_H050A12
        bool "Hotlcd RGB H050A12 panel"
        depends on AIC_DISP_RGB
        select AIC_PANEL_SPI_EMULATION

    config AIC_PANEL_RGB_H050A18
        bool "Hotlcd RGB H050A18 panel"
        depends on AIC_DISP_RGB
        select AIC_PANEL_SPI_EMULATION

    config AIC_PANEL_RGB_H052A01
        bool "Hotlcd RGB H052A01 panel"
        depends on AIC_DISP_RGB
        select AIC_PANEL_SPI_EMULATION

    config AIC_PANEL_RGB_H062A01
        bool "Hotlcd RGB H062A01 panel"
        depends on AIC_DISP_RGB
        select AIC_PANEL_SPI_EMULATION

    config AIC_PANEL_RGB_H068A04
        bool "Hotlcd RGB H068A04 panel"
        depends on AIC_DISP_RGB
        select AIC_PANEL_SPI_EMULATION

    config AIC_PANEL_RGB_H068B06
        bool "Hotlcd RGB H068B06 panel"
        depends on AIC_DISP_RGB
        select AIC_PANEL_SPI_EMULATION

    config AIC_PANEL_RGB_H070A18
        bool "Hotlcd RGB H070A18 panel"
        depends on AIC_DISP_RGB
        select AIC_PANEL_SPI_EMULATION
#
# SRGB Panel
#
    config AIC_PANEL_SRGB_HX8238
        bool "ArtInChip SRGB HX8238 panel"
        depends on AIC_DISP_RGB

#
# RGB Panel IIC Init
#
    config AIC_PANEL_LCOS_HX7033
        bool "ArtInChip RGB HX7033 panel"
        depends on AIC_I2C_DRV && AIC_DISP_RGB

#
# Bridge Panel
#
    config AIC_PANEL_BRIDGE_LT8911
        bool "ArtInChip LT8911 LVDS-eDP bridge"
        depends on AIC_DISP_LVDS

    config AIC_PANEL_DSI_EDP_LT9811EXB
        bool "ArtInChip MIPI DSI bridge eDP LT8911EXB"
        depends on AIC_DISP_MIPI_DSI
endif
    endchoice

config AIC_PANEL_CUSTOM_RESOLUTION
    bool "Custom Display Timing"
    depends on AIC_SIMPLE_PANEL
    default n

choice
        prompt "Classic Resolution List"
        depends on AIC_SIMPLE_PANEL
        depends on !AIC_PANEL_CUSTOM_RESOLUTION
        default AIC_PANEL_1024X600

    config AIC_PANEL_480X272
        bool "480x272"
        depends on AIC_DISP_RGB

    config AIC_PANEL_800X480
        bool "800x480"
        depends on AIC_DISP_RGB

    config AIC_PANEL_1024X600
        bool "1024x600"
        depends on AIC_DISP_RGB || AIC_DISP_LVDS

    config AIC_PANEL_H050A21
        bool "h050a21"
        depends on AIC_DISP_RGB

    config AIC_PANEL_H068B06
        bool "h068b06"
        depends on AIC_DISP_RGB

    config AIC_PANEL_H070A20
        bool "h070a20"
        depends on AIC_DISP_RGB

    config AIC_PANEL_H086A01
        bool "h086a01"
        depends on AIC_DISP_RGB

    config AIC_PANEL_1920X1080_RESOLUTION
        bool "1920x1080"
        depends on AIC_DISP_LVDS
endchoice

config RGB_PANEL_MATCH_ID
    int
    default 0 if AIC_PANEL_1024X600
    default 1 if AIC_PANEL_800X480
    default 2 if AIC_PANEL_480X272
    default 3 if AIC_PANEL_H050A21
    default 4 if AIC_PANEL_H068B06
    default 5 if AIC_PANEL_H070A20
    default 6 if AIC_PANEL_H086A01
    default 7 if AIC_PANEL_CUSTOM_RESOLUTION


config LVDS_PANEL_MATCH_ID
    int
    default 0 if AIC_PANEL_1024X600
    default 1 if AIC_PANEL_1920X1080_RESOLUTION
    default 2 if AIC_PANEL_CUSTOM_RESOLUTION

choice
    prompt "ILI9881C Match Table"
    depends on AIC_PANEL_DSI_ILI9881C
    default ILI9881C_DEFAULT

    config ILI9881C_DEFAULT
        bool "default 4 lane 800x1280"
    config TFT050BP071_DEFAULT
        bool "tft050bp071 2 lane 720"
endchoice

config ILI9881C_MATCH_ID
    int
    default 0 if ILI9881C_DEFAULT
    default 1 if TFT050BP071_DEFAULT

choice
    prompt "ST7789 Match Table"
    depends on AIC_PANEL_DBI_ST7789
    default ST7789_P3

    config ST7789_P3
        bool "P3 I8080 240x320"
    config ST7789_T3
        bool "T3 SPI 4LINE 240x320"
    config ST7789_V3
        bool "V3 SPI 4LINE 240x320"
endchoice

config ST7789_MATCH_ID
    int
    default 0 if ST7789_P3
    default 1 if ST7789_T3
    default 2 if ST7789_V3

config ST7789_PANEL_RESET
    string "ST7789 display panel reset pin"
    depends on AIC_PANEL_DBI_ST7789
    default "PD.23"

choice
    prompt "LT9811EXB Resolution List"
    depends on AIC_PANEL_DSI_EDP_LT9811EXB
    default LT9811EXB_1920X1080

    config LT9811EXB_1920X1200
        bool "1920x1200"
    config LT9811EXB_1920X1080
        bool "1920x1080"
    config LT9811EXB_1366X768
        bool "1366x768"
endchoice

config LT9811EXB_RESOLUTION
    depends on AIC_PANEL_DSI_EDP_LT9811EXB
    int
    default 0 if LT9811EXB_1920X1200
    default 1 if LT9811EXB_1920X1080
    default 2 if LT9811EXB_1366X768

if AIC_PANEL_SPI_GENERAL
config SPI_GENERAL_WIDTH
    int "SPI LCD Width"
    default 160

config SPI_GENERAL_HEIGHT
    int "SPI LCD Height"
    default 160
endif

if AIC_PANEL_CUSTOM_RESOLUTION && !AIC_DISP_PQ_TOOL
source "bsp/artinchip/drv/display/panel/Kconfig.timing"
endif

config AIC_SIMPLE_PANEL_POWER_GPIO
    bool "simple panel power control via GPIO"
    depends on AIC_SIMPLE_PANEL
    default n
    help
        Enable simple panel power control using a fixed GPIO pin.
        This GPIO pin does not need to registered in pinmux.c file.
        Say Y if simple panel needs to apply a dedicated power enable GPIO.

if AIC_SIMPLE_PANEL_POWER_GPIO

config AIC_SIMPLE_PANEL_POWER_GPIO_PIN
    string "panel power GPIO pin"
    default "PE.13"
    help
        Specify the GPIO pin used for simple panel power control.
        Format: "PX.NN" (e.g., "PE.20", "PA.5")

config AIC_SIMPLE_PANEL_POWER_GPIO_LOW_ACTIVE
    bool "power control GPIO is low active"
    default n
    help
        Say Y here if the GPIO needs to be driven low to enable LCD power,
        and high to disable. If unsure, say N (default high active).

config AIC_SIMPLE_PANEL_POWER_DELAY_MS
    int "panel power on delay (ms)"
    default 0
    range 0 1000
    help
        Delay in milliseconds after enabling power before
        initializing the panel. Some panels require stabilization time.
endif

endmenu
```

## bsp/peripheral/bt/realtek/Kconfig
```kconfig
#-------------------------------------------
# realtek bluetooth devices local parameter
#-------------------------------------------

# bluetooth parameter

config AIC_USING_REALTEK_BT
    bool
    default n

menu "realtek bluetooth Parameter"

    config AIC_DEV_REALTEK_BT_PWR_GPIO
        string "realtek bt power on gpio"

    config AIC_DEV_REALTEK_BT_RST_GPIO
        string "realtek bt reset gpio"

    config AIC_DEV_REALTEK_BT_CTS_GPIO
        string "realtek bt cts gpio"

    config AIC_DEV_REALTEK_BT_RTS_GPIO
        string "realtek bt rts gpio"

    config AIC_DEV_REALTEK_BT_WAKE_GPIO
        string "realtek bt wake on gpio"

endmenu
```

## bsp/peripheral/codec/alc5616/Kconfig
```kconfig
menu "alc2616 codec options"

config AIC_I2S_CODEC_ALC5616_I2C
    string "alc5616 i2c port select"
    default "i2c0"

config AIC_I2S_CODEC_MCLK_NFS
    int "MCLK NFS"
    default 256

config AIC_I2S_CODEC_SCLK_NFS
    int "SCLK NFS"
    default 32

endmenu
```

## bsp/peripheral/codec/es8311/Kconfig
```kconfig
menu "ES8311 codec options"

config AIC_I2S_CODEC_ES8311_I2C
    string "es8311 i2c port select"
    default "i2c0"

config AIC_I2S_CODEC_MCLK_NFS
    int "MCLK NFS"
    default 256

config AIC_I2S_CODEC_SCLK_NFS
    int "SCLK NFS"
    default 64

endmenu
```

## bsp/peripheral/codec/jy6311/Kconfig
```kconfig
menu "JY6311 codec options"

config AIC_I2S_CODEC_JY6311_I2C
    string "JY6311 i2c port select"
    default "i2c0"

config AIC_I2S_CODEC_MCLK_NFS
    int "MCLK NFS"
    default 256

config AIC_I2S_CODEC_SCLK_NFS
    int "SCLK NFS"
    default 64

endmenu
```

## bsp/peripheral/nftl/Kconfig
```kconfig
menuconfig AIC_NFTL_SUPPORT
    bool "Aic NFTL support"
    default n

if AIC_NFTL_SUPPORT
    config AIC_NFLT_USED_LIB
        depends on AIC_NFTL_SUPPORT
        bool "Aic NFTL use lib"
        default n

    config AIC_NFLT_TEST
        depends on AIC_NFTL_SUPPORT
        bool "Enable NFTL test command"
        default n

    choice
        prompt "Enable NFTL OOB data verify"
        default AIC_NFTL_DISABLE_OOB_VERIFY
        help
            This option has minimal effect on performance since it only validates the OOB data format.
            A disturbance on the SPI signal lines will lock the Flash from writing, requiring a reboot to recover.
        config AIC_NFTL_DISABLE_OOB_VERIFY
            bool "disable"
        config AIC_NFTL_ENABLE_OOB_VERIFY
            bool "enable"
    endchoice

    config AIC_NFTL_OOB_VERIFY
        int
        default 0 if AIC_NFTL_DISABLE_OOB_VERIFY
        default 1 if AIC_NFTL_ENABLE_OOB_VERIFY
endif
```

## bsp/peripheral/rgb_led/Kconfig
```kconfig
if AIC_USING_RGB_LED
    config AIC_RGB_LED_WS2812B
        bool "Using WS2812B RGB LED"
        default n

endif
```

## bsp/peripheral/sensor/Kconfig
```kconfig
if AIC_USING_SENSOR
    config AIC_USE_SENSOR_DHT11
        bool "Using DHT11 Template and humidity sensor"
        default n

    config AIC_USE_SENSOR_PHOTOSENSITIVE
        bool "Using Photosensitive sensor"
        default n

    config AIC_USE_SENSOR_FLAME
        bool "Using Flame sensor"
        default n

    config AIC_USE_SENSOR_BMP180
        bool "Using Bmp180 Air pressure sensor"
        default n

    config AIC_USE_SENSOR_MQ135
        bool "Using MQ-135 Air quality sensor"
        default n
    
    config AIC_USE_SENSOR_US016
        bool "Using US-016 Distance measuring sensor"
        default n
    
endif
```

## bsp/peripheral/spinand_refresh/Kconfig
```kconfig
config AIC_NAND_REFRESH_SUPPORT
    bool "Aic NAND Refresh support"
    default n
```

## bsp/peripheral/touch/Kconfig
```kconfig
choice
    prompt "Select CTP device"
    default AIC_TOUCH_PANEL_GT911
    depends on AIC_USING_CTP

    config AIC_TOUCH_PANEL_AXS15260
        bool "AXS15260"

    config AIC_TOUCH_PANEL_C145HAX01
        bool "C145HAX01"

    config AIC_TOUCH_PANEL_C123HAX022
        bool "C123HAX022"

    config AIC_TOUCH_PANEL_CHSC5XXX
        bool "CHSC5XXX"

    config AIC_TOUCH_PANEL_CHSC6XXX
        bool "CHSC6XXX"

    config AIC_TOUCH_PANEL_CST826
        bool "CST826"

    config AIC_TOUCH_PANEL_CST3240
        bool "CST3240"

    config AIC_TOUCH_PANEL_FT6336
        bool "FT6336"

    config AIC_TOUCH_PANEL_FT7411
        bool "FT7411"

    config AIC_TOUCH_PANEL_GSL1680
        bool "GSL1680"

    config AIC_TOUCH_PANEL_GSL3676
        bool "GSL3676"

    config AIC_TOUCH_PANEL_GT911
        bool "GT911"

    config AIC_TOUCH_PANEL_ILI2511
        bool "ILI2511"

    config AIC_TOUCH_PANEL_ILI21XX
        bool "ILI21XX"

    config AIC_TOUCH_PANEL_ILI23XX
        bool "ILI23XX"

    config AIC_TOUCH_PANEL_ILI2117
        bool "ILI2117"

    config AIC_TOUCH_PANEL_JD9366
        bool "JD9366"

    config AIC_TOUCH_PANEL_ST16XX
        bool "ST16XX"

    config AIC_TOUCH_PANEL_ST77922
        bool "ST77922"

    config AIC_TOUCH_PANEL_TW31XX
        bool "TW31XX"

    config AIC_TOUCH_PANEL_HY4635
        bool "HY4635"
    
    config AIC_TOUCH_PANEL_ST7123
        bool "ST7123"
    
    config AIC_TOUCH_PANEL_IS5328
        bool "IS5328"
endchoice

config AIC_TOUCH_PANEL_I2C_CHAN
    string "Touch using I2C channel index"
    default "i2c3" if AIC_CHIP_D21X
    default "i2c2" if AIC_CHIP_D13X
    depends on AIC_USING_CTP

config AIC_TOUCH_PANEL_RST_PIN
    string "Touch reset pin"
    default "PA.8" if AIC_CHIP_D21X
    default "PA.10" if AIC_CHIP_D13X
    depends on AIC_USING_CTP

config AIC_TOUCH_PANEL_INT_PIN
    string "Touch irq pin"
    default "PA.9" if AIC_CHIP_D21X
    default "PA.11" if AIC_CHIP_D13X
    depends on AIC_USING_CTP

config AIC_TOUCH_PANEL_WAKE_UP
    bool "Touch as wake-up source to wake-up system"
    depends on AIC_USING_PM

config AIC_TOUCH_X_COORDINATE_RANGE
    int "Touch real x coordinate range"
    default 1024
    depends on AIC_USING_CTP

config AIC_TOUCH_Y_COORDINATE_RANGE
    int "Touch real y coordinate range"
    default 600
    depends on AIC_USING_CTP

config AIC_SCREEN_REAL_X_RESOLUTION
    int "Screen real x coordinate range"
    default 1024
    depends on AIC_USING_CTP

config AIC_SCREEN_REAL_Y_RESOLUTION
    int "Screen real y coordinate range"
    default 600
    depends on AIC_USING_CTP

config AIC_TOUCH_X_FLIP
    bool "Touch flip x coordinate"
    default n
    depends on AIC_USING_CTP

config AIC_TOUCH_Y_FLIP
    bool "Touch flip y coordinate"
    default n
    depends on AIC_USING_CTP

config AIC_TOUCH_90_DEGREE_ROTATION
    bool "Touch 90 degrees rotation"
    default n
    depends on AIC_USING_CTP

config AIC_TOUCH_180_DEGREE_ROTATION
    bool "Touch 180 degrees rotation"
    default n
    depends on AIC_USING_CTP
    select AIC_TOUCH_X_FLIP
    select AIC_TOUCH_Y_FLIP

config AIC_TOUCH_270_DEGREE_ROTATION
    bool "Touch 270 degrees rotation"
    default n
    depends on AIC_USING_CTP

config AIC_SCREEN_RELATIVE_ROTATION_DEGREE
    int "Screen rotate degree relative to touch"
    default 0
    depends on AIC_USING_CTP

config AIC_CTP_POLLING_MODE
    bool "Using touch polling mode instead of irq mode"
    default 0
    depends on AIC_USING_CTP

config AIC_TOUCH_CROP
    bool "Enable touch crop"
    default n
    help
        Some Touch need to be cropped, the effective area displayed is less
        than the timing signal.
        If unsure select "N".

if AIC_TOUCH_CROP
    config AIC_TOUCH_CROP_POS_X
        int "Touch crop x position of pixels"
        default 0

    config AIC_TOUCH_CROP_POS_Y
        int "Touch crop y position of pixels"
        default 0

    config AIC_TOUCH_CROP_WIDTH
        int "Touch crop width"
        default 1024

    config AIC_TOUCH_CROP_HEIGHT
        int "Touch crop height"
        default 600
endif

config AIC_TOUCH_REPORT_X_COORDINATE
    int
    default AIC_TOUCH_CROP_HEIGHT if AIC_TOUCH_90_DEGREE_ROTATION && AIC_TOUCH_CROP
    default AIC_TOUCH_CROP_HEIGHT if AIC_TOUCH_270_DEGREE_ROTATION && AIC_TOUCH_CROP
    default AIC_TOUCH_Y_COORDINATE_RANGE if AIC_TOUCH_90_DEGREE_ROTATION
    default AIC_TOUCH_Y_COORDINATE_RANGE if AIC_TOUCH_270_DEGREE_ROTATION
    default AIC_TOUCH_CROP_WIDTH if AIC_TOUCH_CROP
    default AIC_TOUCH_X_COORDINATE_RANGE
    depends on AIC_USING_CTP

config AIC_TOUCH_REPORT_Y_COORDINATE
    int
    default AIC_TOUCH_CROP_WIDTH if AIC_TOUCH_90_DEGREE_ROTATION && AIC_TOUCH_CROP
    default AIC_TOUCH_CROP_WIDTH if AIC_TOUCH_270_DEGREE_ROTATION && AIC_TOUCH_CROP
    default AIC_TOUCH_X_COORDINATE_RANGE if AIC_TOUCH_90_DEGREE_ROTATION
    default AIC_TOUCH_X_COORDINATE_RANGE if AIC_TOUCH_270_DEGREE_ROTATION
    default AIC_TOUCH_CROP_HEIGHT if AIC_TOUCH_CROP
    default AIC_TOUCH_Y_COORDINATE_RANGE
    depends on AIC_USING_CTP

config AIC_TOUCH_PANEL_NAME
    string
    default "axs15260"  if AIC_TOUCH_PANEL_AXS15260
    default "c123hax022" if AIC_TOUCH_PANEL_C123HAX022
    default "c145hax01" if AIC_TOUCH_PANEL_C145HAX01
    default "chsc5xxx"   if AIC_TOUCH_PANEL_CHSC5XXX
    default "chsc6xxx"   if AIC_TOUCH_PANEL_CHSC6XXX
    default "cst826"    if AIC_TOUCH_PANEL_CST826
    default "cst3240"   if AIC_TOUCH_PANEL_CST3240
    default "ft6336"    if AIC_TOUCH_PANEL_FT6336
    default "ft7411"    if AIC_TOUCH_PANEL_FT7411
    default "gsl1680"   if AIC_TOUCH_PANEL_GSL1680
    default "gsl3676"   if AIC_TOUCH_PANEL_GSL3676
    default "gt911"     if AIC_TOUCH_PANEL_GT911
    default "ili2511"   if AIC_TOUCH_PANEL_ILI2511
    default "ili21xx"   if AIC_TOUCH_PANEL_ILI21XX
    default "ili2117"   if AIC_TOUCH_PANEL_ILI2117
    default "ili23xx"   if AIC_TOUCH_PANEL_ILI23XX
    default "jd9366"    if AIC_TOUCH_PANEL_JD9366
    default "st16xx"    if AIC_TOUCH_PANEL_ST16XX
    default "st77922"   if AIC_TOUCH_PANEL_ST77922
    default "tw31xx"    if AIC_TOUCH_PANEL_TW31XX
    default "hy4635"    if AIC_TOUCH_PANEL_HY4635
    default "st7123"    if AIC_TOUCH_PANEL_ST7123
    default "is5328"    if AIC_TOUCH_PANEL_IS5328
    depends on AIC_USING_CTP
```

## bsp/peripheral/wireless/Kconfig
```kconfig
if AIC_WIRELESS_LAN
    menu "Wireless power & reset pin configuration"
        config AIC_WIRELESS_PWR_GPIO
            string "Wlan power on gpio"
            depends on AIC_WIRELESS_LAN

        config AIC_WIRELESS_BT_PWR_GPIO
            string "Bt reset gpio"
            depends on AIC_WIRELESS_LAN
    endmenu
endif

menuconfig AIC_WLAN_REALTEK
    bool "Using Realtek wlan driver"
    default n
    depends on AIC_WIRELESS_LAN
    select RT_USING_TIMER_SOFT
    select AIC_USING_REALTEK_WLAN0

    if AIC_WLAN_REALTEK
    source "bsp/peripheral/wireless/realtek/Kconfig"
    endif

menuconfig WIFI_USING_SDIOWIFI_ATBM
    bool "ATBM603X_WIFI"
    depends on AIC_WIRELESS_LAN
    select RT_USING_TIMER_SOFT
    select RT_USING_WIFI
    select RT_USING_SYSTEM_WORKQUEUE
    default n

menuconfig AIC_WLAN_ASR
    bool "Using ASR wlan driver"
    default n
    depends on AIC_WIRELESS_LAN
    select RT_USING_TIMER_SOFT
    select RT_USING_WIFI
    select RT_USING_SYSTEM_WORKQUEUE
    select LPKG_USING_MBEDTLS

menuconfig AIC_WLAN_AIC8800D40L
    bool "AIC8800 wlan driver"
    default n
    depends on AIC_WIRELESS_LAN
    select LPKG_USING_MBEDTLS
    if AIC_WLAN_AIC8800D40L
    source "bsp/peripheral/wireless/aic8800/Kconfig.dev"
    ##source "bsp/peripheral/wireless/aic8800/Kconfig.drv"
    endif

menuconfig AIC_WLAN_HUGEIC
    bool "HUGEIC wlan driver"
    default n
    depends on AIC_WIRELESS_LAN
    select RT_USING_TIMER_SOFT
    select RT_USING_WIFI
    select RT_USING_SYSTEM_WORKQUEUE
    if AIC_WLAN_HUGEIC
    source "bsp/peripheral/wireless/hugeic/Kconfig"
    endif
```

## bsp/peripheral/wireless/aic8800/Kconfig.dev
```kconfig
#-----------------------------
# aic8800 wlan devices local parameter
#-----------------------------

# wlan0 parameter

menu "Wlan0 Parameter"

    choice
        prompt "Select AIC8800 MODEL"
        default CHIP_SELECT_AIC8800D40L
        config CHIP_SELECT_AIC8800D40L
            bool "select AIC8800D40L"
        config CHIP_SELECT_AIC8800DW
            bool "select AIC8800DW"
        config CHIP_SELECT_AIC8800DL
            bool "select AIC8800DL"
        config CHIP_SELECT_AIC8800M40B
            bool "select AIC8800M40B"
    endchoice

    choice
        prompt "Select AIC8800 power converter"
        default CONFIG_AIC8800_VRF_DCDC_MODE
        config CONFIG_AIC8800_VRF_DCDC_MODE
            bool "select DCDC mode"
        config CONFIG_AIC8800_VRF_LDO_MODE
            bool "select LDO mode"
    endchoice

    choice
        prompt "Select AIC8800 work mode"
        default CONFIG_AIC8800_NORMAL_MODE
        config CONFIG_AIC8800_NORMAL_MODE
            bool "select normal mode"
        config CONFIG_AIC8800_RFTEST_MODE
            bool "select rftest mode"
        config CONFIG_AIC8800_FTTEST_MODE
            bool "select fttest mode"
    endchoice

    config CONFIG_AIC8800_MAC_USE_CHIP_ID
        bool "enable aic8800 mac use chip id"
        default n
        select AIC_USING_SID
        select AIC_MAC_CHIPID_DRV

    config CONFIG_AIC8800_BT_SUPPORT
        bool "enable aic8800 BT support"
        default n

    config AIC_DEV_AIC8800_DEBUG_LOG
        bool "enable aic8800 debug messages"
        default y

endmenu
```

## bsp/peripheral/wireless/asr/Kconfig
```kconfig
#-----------------------------
# asr wlan devices local parameter
#-----------------------------

menu "asr wlan Parameter"

    config AIC_WIRELESS_PWR_GPIO
        string "asr wlan0 reset on gpio"

endmenu
```

## bsp/peripheral/wireless/hugeic/Kconfig
```kconfig
#-----------------------------
# txw901 wlan devices local parameter
#-----------------------------

# wlan0 parameter
menu "Wlan0 Parameter"
    config AIC_WIRELESS_PWR_GPIO
        string "txw901 power on gpio"
        default "PD.17"

    choice
        prompt "txw901 BLE provisioning"
        default TXW901_MANUAL_PROV_MODE
        config TXW901_MANUAL_PROV_MODE
            bool "select manual provisioning mode"
        config TXW901_BLE_BROADCAST_PROV_MODE
            bool "select BLE broadcast provisioning mode"
        config TXW901_BLE_CONNECT_PROV_MODE
            bool "select BLE connect provisioning mode"
    endchoice

    config HUGEIC_TXW901_DEBUG_LOG
        bool "enable txw901 debug messages"
        default y
endmenu
```

## packages/artinchip/aic-profiler/Kconfig
```kconfig
menuconfig AIC_USING_PROFILER
    bool "ArtInChip profiler"
    default n

if AIC_USING_PROFILER
    config AIC_PROFILER_BUF_SIZE
        int "Profiler buffer size (in bytes)"
        default 524288
        help
        Size of the internal buffer used by the profiler to store trace items.
        Default is 512KB (524288 bytes). Must be large enough to hold profiler items.

    config AIC_PROFILER_IRQ_MODE
        bool "Enable IRQ-safe mode for profiler(default using double buffer)"
        default n
        help
        Enable double buffering and background flush thread to support
        calling profiler from interrupt context.

    config AIC_PROFILER_OUTPUT_FILENAME
        string "Profiler output filename"
        default "/udisk/profiler.systrace"
        help
        The file path where profiler logs will be written.
        If not set or cannot be opened, logs may fallback to stdout.
endif
```

## packages/artinchip/aic-spienc-authorization/Kconfig
```kconfig
menuconfig LPKG_USING_AIC_SPIENC_AUTHORIZATION
    bool "aic-spienc-authorization"
    default n

if LPKG_USING_AIC_SPIENC_AUTHORIZATION

config AIC_SPIENC_AUTHORIZATION_TEST
    bool "aic spienc authorization test"
    depends on LPKG_USING_AIC_SPIENC_AUTHORIZATION
    default n

endif
```

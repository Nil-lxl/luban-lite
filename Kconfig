## packages/artinchip/mpp/Kconfig
```kconfig
menuconfig LPKG_MPP
    bool "aic-mpp"
    default y

config AIC_MPP_PLAYER_INTERFACE
    bool "Enable player interface and demo"
    default n
    depends on LPKG_MPP
    select LPKG_USING_MINIMP3
    select AIC_AUDIO_DRV
    select RT_USING_PTHREADS

config AIC_MPP_PLAYER_VIDEO_EXT_RENDER
    bool "Enable player using external video render"
    default n
    depends on LPKG_MPP && AIC_MPP_PLAYER_INTERFACE

config AIC_MPP_PLAYER_AUDIO_RENDER_SHARE_TEST
    bool "Enable player audio render share test"
    default n
    depends on LPKG_MPP && AIC_MPP_PLAYER_INTERFACE

config AIC_MPP_PLAYER_DECODE_DELAY
    bool "Enable player decoder delay decode"
    default n
    depends on LPKG_MPP && AIC_MPP_PLAYER_INTERFACE

if AIC_MPP_PLAYER_DECODE_DELAY
    config AIC_MPP_PLAYER_VIDEO_DECODE_BUF_SIZE
        int "Player video decoder stream buffer size"
        default 3145728

    config AIC_MPP_PLAYER_VIDEO_DECODE_PACKET_NUM
        int "Player video decoder stream packet number"
        default 48

    config AIC_MPP_PLAYER_AUDIO_DECODE_BUF_SIZE
        int "Player audio decoder stream buffer size"
        default 131072

    config AIC_MPP_PLAYER_AUDIO_DECODE_PACKET_NUM
        int "Player audio decoder stream packet number"
        default 96
endif

config AIC_MPP_PLAYER_FILE_CACHE
    bool "Enable player read file using cache"
    default n
    depends on LPKG_MPP && AIC_MPP_PLAYER_INTERFACE

config AIC_MPP_PLAYER_FILE_CACHE_SIZE
    int "Config player file read cache size"
    default 65536
    depends on AIC_MPP_PLAYER_FILE_CACHE

config AIC_MPP_AVI_DEMUX
    bool "Enable avi demux"
    default n
    depends on LPKG_MPP && AIC_MPP_PLAYER_INTERFACE

config AIC_MPP_MKV_DEMUX
    bool "Enable mkv demux"
    default n
    depends on LPKG_MPP && AIC_MPP_PLAYER_INTERFACE

config AIC_MPP_TS_DEMUX
    bool "Enable ts demux"
    default n
    depends on LPKG_MPP && AIC_MPP_PLAYER_INTERFACE

config AIC_MPP_FLV_DEMUX
    bool "Enable flv demux"
    default n
    depends on LPKG_MPP && AIC_MPP_PLAYER_INTERFACE

config AIC_MPP_WMA_DEC
    bool "Enable wma decoder"
    default n
    depends on LPKG_MPP && AIC_MPP_PLAYER_INTERFACE
    select LPKG_USING_FFMPEG

config AIC_MPP_AAC_DEC
    bool "Enable aac decoder"
    default n
    depends on LPKG_MPP && AIC_MPP_PLAYER_INTERFACE
    select LPKG_USING_FAAD2

config AIC_MPP_FLAC_DEC
    bool "Enable flac decoder"
    default n
    depends on LPKG_MPP && AIC_MPP_PLAYER_INTERFACE
    select LPKG_USING_LIBFLAC

config AIC_MPP_APE_DEC
    bool "Enable ape decoder"
    default n
    depends on LPKG_MPP && AIC_MPP_PLAYER_INTERFACE
    select LPKG_USING_LIBAPE

config AIC_MPP_RECORDER_INTERFACE
    bool "Enable recorder interface and demo"
    default n
    depends on LPKG_MPP
    select LPKG_USING_MAD
    select LPKG_USING_CJSON
    select AIC_AUDIO_DRV
    select RT_USING_PTHREADS

config AIC_MPP_RECORDER_USING_EXTRA_FRAME
    bool "Enable recorder using extra frame"
    default y
    depends on AIC_MPP_RECORDER_INTERFACE

config AIC_MPP_VIN
    bool "Enable Video Input interface"
    default n
    depends on LPKG_MPP

config AIC_MPP_VIN_DEV
    bool "Enable Video Input interface of DevMode"
    default n
    depends on LPKG_MPP && !AIC_MPP_VIN && AIC_USING_DE

config AIC_MPP_VIN_BUF_SIZE
    int "Size of Video Input buffer"
    default 1843264
    depends on LPKG_MPP && AIC_MPP_VIN_DEV

config AIC_MPP_FB_TEST
    bool "Enable MPP FB test programs"
    default n
    depends on LPKG_MPP

config AIC_MPP_VE_TEST
    bool "Enable MPP VE test programs"
    default n
    depends on LPKG_MPP

config AIC_MPP_GE_TEST
    bool "Enable MPP GE test programs"
    default n
    depends on LPKG_MPP

config AIC_MPP_PARSER_TEST
    bool "Enable MPP parser test programs"
    default n
    depends on LPKG_MPP

config AIC_MPP_AICP_DEC_ENABLE
    bool "enable aic picture decoder"
    default n
    depends on LPKG_MPP

config AIC_MPP_H264_DEC_ENABLE
    bool "enable H.264 decoder"
    default y
    depends on LPKG_MPP && AIC_VE_DRV_V10
```

## packages/artinchip/ota/Kconfig
```kconfig
menuconfig LPKG_USING_OTA_DOWNLOADER
    bool "aic-ota"
    default n

if LPKG_USING_OTA_DOWNLOADER

    config OTA_DOWNLOADER_DEBUG
        bool "Enable OTA downloader debug"
        default n

    config AIC_OTA_INTERFACE
        bool "Enable OTA interface"
        select AIC_ENV_INTERFACE
        select AIC_AB_SYSTEM_INTERFACE
        default y

    config OTA_DATA_DIRECT
        bool "Use single data partition"
        default n

    config OTA_RODATA_DIRECT
        bool "Use single rodata partition"
        default n
endif
```

## packages/artinchip/thread_stack_trace/Kconfig
```kconfig
config AIC_USING_THREAD_STACK_TRACE
    bool "ArtInChip thread stack trace back"
    default y
    depends on RT_USING_FINSH
```
